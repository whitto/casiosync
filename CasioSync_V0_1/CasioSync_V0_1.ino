// CasioSync_V0_1.ino
// V0.1 R4 - 13 October 2026 (Australia/Brisbane)
// - Complete battery transport test coverage for the remaining transaction deadline.
// - Respect hidden optional-setting controls on unsupported watch profiles.
// - Keep only current compiled packages on main; historical packages stay in immutable tags.
// - No watch protocol, scheduling, Wi-Fi or storage runtime behavior changes.
//
// V0.1 R3 - 13 October 2026 (Australia/Brisbane)
// - Complete host-test mocks for the retained configuration transaction.
// - Hash only publishable sources in board package manifests; exclude ignored builds.
// - Retain README watch/alarm screenshots and immutable board download ZIP tags.
// - No Bluetooth, scheduling, Wi-Fi or storage runtime behavior changes.
//
// V0.1 R2 - 13 October 2026 (Australia/Brisbane)
//   - Fix watch-options test syntax; match the unavailable-feature UI test to hidden controls.
//   - Board-specific GitHub ZIP tags provide compiled downloads when asset upload is rejected.
//   - Firmware behavior/dependencies unchanged; both target packages rebuilt for R2 labels.
// V0.1 R1 - 13 October 2026 (Australia/Brisbane)
//   - Casio-only fork of time-transmitter V4.16 R1; all LF transmitters removed.
//   - Preserve GW-BX5600 packet exchanges, font/battery reads and watch binding.
//   - Preserve independent BT and Wi-Fi schedules, checked provisioning and NTP trust.
//   - Keep fixed RAM history, BT-only 24-hour LED and optional first-success daily snapshot.
//   - Casio-only CRC settings and separate files never interpret transmitter settings.
//   - Bounded BLE scan/client shutdown, HTTP parsing and loop progress supervision.
//   - 122 model protocol candidates; 119 optional-setting capability templates.
//   - Opt-in per-watch alarms, chime, countdown, basic settings and auto adjustment.
//   - Apply selective merges/readback before TIME; saved choices bound to watch identity.
//   - Compiled Node32s/C3 SuperMini; core 3.3.12, CrashDumpGate 1.0.1 adds C3 metadata.
// Original project ancestry credits: (c) 2021 taroh (sasaki.taroh@gmail.com),
// (c) 2025 5Breeze (bitshen@qq.com); CasioSync development by whitto.
// Casio BLE protocol sources and licenses are documented in README.md/CREDITS.md.
//   - Exact Casio model catalogue; corrected Standard 11-byte TIME framing from captures.
// Project: https://github.com/whitto/casiosync

// Arduino's board variant supplies RGB_BUILTIN/LED_BUILTIN for ESP32-C3.
// The generic ESP32-C3 target uses an addressable RGB LED; drive only blue.
#if defined(CONFIG_IDF_TARGET_ESP32C3) && defined(CASIOSYNC_C3_SUPERMINI)
  #define PIN_ONBOARD_LED (8) // ESP32-C3 SuperMini discrete blue LED.
  #define ACTIVITY_LED_ACTIVE_LOW 1
#elif defined(CONFIG_IDF_TARGET_ESP32C3) && defined(RGB_BUILTIN)
  #define ACTIVITY_LED_RGB_PIN RGB_BUILTIN
#elif defined(CONFIG_IDF_TARGET_ESP32C3) && defined(LED_BUILTIN)
  #define PIN_ONBOARD_LED LED_BUILTIN
#elif defined(CONFIG_IDF_TARGET_ESP32C3)
  #define ACTIVITY_LED_UNAVAILABLE 1 // No guessed GPIO is driven.
#else
  #define PIN_ONBOARD_LED (2) // Node32s blue activity LED, active HIGH.
#endif

// Library Includes
#include <WiFi.h>           // WiFi connectivity
#include <RadioBoundedWebServer.h> // Pinned 3.3.12 parser with request size/time bounds
#if !defined(RADIO_HTTP_BOUNDS_VERSION) || RADIO_HTTP_BOUNDS_VERSION != 1
#error "Install the included RadioBoundedWebServer library for bounded HTTP request parsing"
#endif
#include <LittleFS.h>        // File system for configuration storage (see initFilesystem())
#include <RadioCrashDumpGate.h> // Saved, default-Off control of SDK panic dumps.
// BLE central stack. NimBLE-Arduino 2.5.1+ substantially reduces
// flash/RAM use while retaining the Casio client protocols.
#include <NimBLEDevice.h>
#if !defined(NIMBLE_RADIOCLOCK_RELIABILITY_PATCH) || NIMBLE_RADIOCLOCK_RELIABILITY_PATCH != 1
#error "Install the bundled NimBLE-Arduino 2.5.1-radioclock.1 source library; ordinary 2.5.1 has an unsafe host-stop timer."
#endif
#include <NimBLEUtils.h>
#ifdef USING_NIMBLE_ARDUINO_HEADERS
#include "nimble/porting/nimble/include/nimble/nimble_port.h"
#else
#include "nimble/nimble_port.h"
#endif

#include "CasioBleScanControl.h"
#include "CasioBxProtocol.h"
#include "CasioWatchSettings.h"
#include "CasioWatchBattery.h"
#include "BtSyncLed.h"
#include "BtSyncHistory.h"
#include "BtRecentSyncs.h"
#include "CasioWifiAccessWindow.h"
#include "CasioJsonWriter.h"
#include "CasioConfigWriter.h"
#include "esp_bt.h"
#include "esp_system.h"
#include "esp_heap_caps.h"
#include "esp_mac.h"
#include <atomic>
#include <string>
#include "CasioModelCatalog.h"
#include "CasioStandardProtocol.h"
#include "CasioWatchFeatures.h"
#include "CasioWatchOptions.h"
#include <strings.h>
#include <ArduinoJson.h>    // JSON parsing and generation
#include <time.h>
#include <sys/time.h>
#include "esp_sntp.h"
#include "esp_timer.h"
#include <math.h>

// Global Objects
RadioBoundedWebServer server(80); // Existing routes, bounded HTTP receive on port 80
bool webRoutesRegistered=false;
bool webServerStarted=false;

// Configuration Constants
#define DEVICENAME_PREFIX "CasioSync"     // Device name prefix for WiFi AP mode
#define FIRMWARE_VERSION "V0.1"
#define FIRMWARE_BUILD "R4"

#define DEFAULT_TZ_NAME "Australia/Brisbane"
#define CONFIG_FILE "/casiosync-config.txt"           // WiFi and timezone configuration file
#define CONFIG_TEMP_FILE "/casiosync-config.tmp"

// WiFi Configuration Variables
char ssid[64] = "";                          // WiFi SSID (network name)
char passwd[64] = "";                        // WiFi password
String timezone_name = DEFAULT_TZ_NAME;           // IANA timezone name
#define DEFAULT_BT_TIMEZONE "Australia/Brisbane"
String btTimezoneName = DEFAULT_BT_TIMEZONE;     // Independent civil time zone used only for BLE watch writes.
int btTimeOffsetMinutes = 0;                     // Additional offset applied to watch time and BT schedules.
unsigned long wifi_connect_start = 0;        // Timestamp when WiFi connection started
#define WIFI_CONNECT_TIMEOUT 30000           // WiFi connection timeout: 30 seconds
#define WIFI_CONNECT_CHECK_INTERVAL 250      // Nonblocking association supervision: 250 ms

// LoopTask owns settings, API responses and Bluetooth work. Only fixed snapshots
// cross to SDK callbacks; the monitor observes a 64-bit monotonic heartbeat.
static void applyTimezone(void);
static void sendIndexPage(void);
void updateWifiPowerManagement(void);
static bool configureNtpClient(void);
static void beginWifiCredentialConnection(void);
static void flushNtpLogs(void);
bool writeConfigNow(void);
void normalizeBluetoothSlots(void);
std::atomic<int> ntpsync{0};
portMUX_TYPE progressMux = portMUX_INITIALIZER_UNLOCKED;
uint64_t applicationLoopLastUs = 0;
std::atomic<uint32_t> loopStackMinimum{UINT32_MAX};
std::atomic<uint32_t> monitorStackMinimum{UINT32_MAX};
TaskHandle_t safetyMonitorTaskHandle = nullptr;
std::atomic<bool> safetyMonitorReady{false};
static constexpr uint64_t LOOP_PROGRESS_DEADLINE_US = 70000000ULL;
void applicationForceSafeRestart(void) { esp_restart(); }
static uint32_t progressAgeMs(uint64_t lastUs) {
  const uint64_t nowUs = (uint64_t)esp_timer_get_time();
  if (!lastUs || nowUs < lastUs) return UINT32_MAX;
  const uint64_t ageMs = (nowUs - lastUs) / 1000ULL;
  return ageMs > UINT32_MAX ? UINT32_MAX : (uint32_t)ageMs;
}
uint32_t applicationLoopAgeMs(void) {
  portENTER_CRITICAL(&progressMux);
  const uint64_t last = applicationLoopLastUs;
  portEXIT_CRITICAL(&progressMux);
  return progressAgeMs(last);
}
uint32_t applicationLoopStackMinimum(void) { const uint32_t n=loopStackMinimum.load(); return n==UINT32_MAX?0:n; }
uint32_t safetyMonitorStackMinimum(void) { const uint32_t n=monitorStackMinimum.load(); return n==UINT32_MAX?0:n; }
void applicationProgressCheckpoint(void) {
  const uint64_t nowUs = (uint64_t)esp_timer_get_time();
  portENTER_CRITICAL(&progressMux);
  applicationLoopLastUs = nowUs;
  portEXIT_CRITICAL(&progressMux);
  static uint64_t lastStackCheckUs = 0;
  if (nowUs - lastStackCheckUs >= 1000000ULL) {
    lastStackCheckUs = nowUs;
    const uint32_t available = (uint32_t)uxTaskGetStackHighWaterMark(nullptr);
    if (available < loopStackMinimum) loopStackMinimum = available;
  }
}

// --- Adaptive NTP resync interval ---
// Rather than resyncing on a fixed schedule, this measures how much the
// board's own clock actually drifts between syncs and shortens/lengthens
// the resync interval to match - a board with a more accurate crystal gets
// resynced less often (saving a WiFi/NTP round-trip), a drifty one gets
// resynced more often, and either way the clock stays within roughly
// NTP_ERROR_BUDGET_SEC seconds of correct between syncs. See onNtpSync()
// (measures the drift on every successful sync) and configureAdaptiveNtp()
// (sets the interval before SNTP schedules its next request).
portMUX_TYPE clockMux = portMUX_INITIALIZER_UNLOCKED;
uint64_t ntpLastMonoUs = 0;         // esp_timer (monotonic) time at the previous sync, microseconds
int64_t ntpLastEpochUs = 0;         // Wall-clock (epoch) time at the previous sync, microseconds
double ntpDriftPpm = 0.0;           // Smoothed clock drift estimate, parts-per-million
double ntpDriftAbsSecPerHour = 0.0; // Same drift, expressed as seconds/hour (for logging/diagnostics)
// Validity comes ONLY from the SNTP callback, not a plausible clock year.
// A conservative 50 ppm estimate is used until real drift samples exist.
static const double CLOCK_INITIAL_PPM = 50.0;
static const uint32_t CLOCK_MAX_HOLDOVER_SEC = 21600UL;
static const double CLOCK_INITIAL_UNCERTAINTY_SEC = 0.20;
std::atomic<uint32_t> ntpIntervalSec{3600};
static bool clockNtpEverSynced = false;
static uint32_t clockNtpSyncCount = 0;
static bool clockDriftSampleAvailable = false;
static double clockDriftBoundPpm = CLOCK_INITIAL_PPM; // Absolute envelope: opposite signs cannot cancel.
static bool clockNtpRejected = false;
static uint32_t clockNtpRejectedCount = 0;
static const double CLOCK_DRIFT_FLOOR_PPM = 5.0;
static const double CLOCK_MAX_PLAUSIBLE_PPM = 1000.0;
// Provisional acquisition is RAM only. A single plausible year is never a
// time anchor: require three advancing replies over at least 30 seconds.
static uint64_t ntpCandidateMonoUs = 0, ntpCandidateLastMonoUs = 0;
static int64_t ntpCandidateEpochUs = 0;
static uint8_t ntpCandidateReplies = 0;
static uint8_t clockNtpCandidateReplyCount = 0; // clockMux-protected diagnostic snapshot.
static uint32_t clockNtpReacquisitionCount = 0;
static uint64_t ntpDriftAnchorMonoUs = 0;
static int64_t ntpDriftAnchorEpochUs = 0;
static const uint64_t NTP_CANDIDATE_MIN_STEP_US = 10000000ULL;
static const uint64_t NTP_CANDIDATE_MIN_SPAN_US = 30000000ULL;
static const uint64_t NTP_CANDIDATE_MAX_SPAN_US = 600000000ULL;
uint64_t monotonicUptimeSeconds() { return (uint64_t)esp_timer_get_time() / 1000000ULL; }
uint32_t clockAgeSeconds() {
  portENTER_CRITICAL(&clockMux);
  bool valid=clockNtpEverSynced;
  uint64_t snapshot=ntpLastMonoUs;
  portEXIT_CRITICAL(&clockMux);
  if (!valid || !snapshot) return UINT32_MAX;
  int64_t age = esp_timer_get_time() - (int64_t)snapshot;
  if (age < 0 || (uint64_t)age / 1000000ULL >= UINT32_MAX) return UINT32_MAX;
  return (uint32_t)((uint64_t)age / 1000000ULL);
}
double clockEstimatedError() {
  uint32_t age = clockAgeSeconds();
  if (age == UINT32_MAX) return 9999.0;
  portENTER_CRITICAL(&clockMux);
  const double ppm=clockDriftBoundPpm;
  portEXIT_CRITICAL(&clockMux);
  return CLOCK_INITIAL_UNCERTAINTY_SEC + ppm * (double)age / 1000000.0;
}
const char *clockConfidence() {
  uint32_t age = clockAgeSeconds();
  portENTER_CRITICAL(&clockMux);
  const bool rejected=clockNtpRejected;
  portEXIT_CRITICAL(&clockMux);
  if (rejected || age == UINT32_MAX || age > CLOCK_MAX_HOLDOVER_SEC || clockEstimatedError() > 0.90) return "Unsynchronized";
  return age <= ntpIntervalSec ? "Synchronized" : "Holdover";
}
bool clockTrusted() { return strcmp(clockConfidence(), "Unsynchronized") != 0; }
#define NTP_INITIAL_INTERVAL_SEC 3600UL   // Resync interval before any drift has been measured yet
#define NTP_MIN_INTERVAL_SEC 15UL         // SNTP/RFC minimum; large drift must not force a 15-minute loss of trust
#define NTP_ERROR_BUDGET_SEC 0.90          // Total error budget, including initial sync uncertainty
#define NTP_RESYNC_MARGIN 0.90            // Request again before either the error or six-hour trust limit
#define NTP_DRIFT_EMA_ALPHA 0.35          // Smoothing factor (0-1) for the drift estimate; higher = reacts faster to new measurements, lower = more stable against noisy single measurements

//...................................................................
// Casio BLE time-only profiles. Values are persisted: do not reorder.
// 0: GW-BX5600 MIP with the model-specific four-step SP handshake.
// 1: Standard digital / hybrid (11-byte current-time write).
// 2: Analogue/MT-G experimental time-only (same inherited standard time write;
//    motor/second-dial setup is intentionally never written).
// Do not send MIP packets to other MIP models without validating their handshake.
enum CasioBleProtocol : uint8_t {
  BT_PROTOCOL_BX5600_MIP = 0,
  BT_PROTOCOL_STANDARD = 1,
  BT_PROTOCOL_ANALOGUE = 2,
  BT_PROTOCOL_COUNT = 3
};
static bool validBtProtocol(int p) { return p >= 0 && p < BT_PROTOCOL_COUNT; }
static const char *btProtocolName(int p) {
  switch (p) {
    case BT_PROTOCOL_BX5600_MIP: return "GW-BX5600 MIP";
    case BT_PROTOCOL_STANDARD: return "Standard digital/hybrid";
    case BT_PROTOCOL_ANALOGUE: return "Analogue time-only (experimental)";
    default: return "Unknown Casio protocol";
  }
}

// Casio GW-BX5600 BLE time synchronization
// Watch-initiated connection model: the ESP32 opens a scan window and
// waits for the watch to advertise its Casio Bluetooth service.
#define CASIO_ADVERTISEMENT_SERVICE "1804"
#define CASIO_WATCH_FEATURES_SERVICE "26eb000d-b012-49a8-b1f8-394fb2032b0f"
#define CASIO_SP_REQUEST_CHAR       "26eb002e-b012-49a8-b1f8-394fb2032b0f"
#define CASIO_SP_DATA_CHAR          "26eb002f-b012-49a8-b1f8-394fb2032b0f"
#define CASIO_SET_CHAR              "26eb002d-b012-49a8-b1f8-394fb2032b0f"
#define CASIO_BASIC_REQUEST_CHAR    "26eb002c-b012-49a8-b1f8-394fb2032b0f"

#define BT_SYNC_SLOT_COUNT 4
#define BT_PREPARE_MINUTES 5
#define BT_WINDOW_AFTER_MINUTES 5
#define BT_MANUAL_WINDOW_MINUTES 7
#define BT_REQUEST_TIMEOUT_MS 5000UL
#define BT_SCAN_SLICE_MS 1000UL

int btSyncTimes[BT_SYNC_SLOT_COUNT] = {30, 390, 750, 1110}; // 00:30, 06:30, 12:30, 18:30
bool btSyncEnabled[BT_SYNC_SLOT_COUNT] = {true, true, true, true};
uint8_t btSyncProtocol[BT_SYNC_SLOT_COUNT] = {BT_PROTOCOL_BX5600_MIP, BT_PROTOCOL_BX5600_MIP,
                                            BT_PROTOCOL_BX5600_MIP, BT_PROTOCOL_BX5600_MIP};
uint8_t btManualProtocol = BT_PROTOCOL_BX5600_MIP;
uint8_t btActiveProtocol = BT_PROTOCOL_BX5600_MIP;
#define BT_WATCH_PROFILE_COUNT 4
uint8_t btSyncProfile[BT_SYNC_SLOT_COUNT] = {0,0,0,0};
uint8_t btManualProfile = 0;
uint8_t btActiveProfile = 0;
int btProfileSuccessYear[BT_WATCH_PROFILE_COUNT] = {-1,-1,-1,-1};
int btProfileSuccessYday[BT_WATCH_PROFILE_COUNT] = {-1,-1,-1,-1};
String btProfileAddress[BT_WATCH_PROFILE_COUNT]; // Learned watch address; may change with BLE privacy.
String btProfileName[BT_WATCH_PROFILE_COUNT];
uint8_t btProfileProtocol[BT_WATCH_PROFILE_COUNT] = {0,0,0,0};
uint8_t btFontMode[BT_WATCH_PROFILE_COUNT] = {0,0,0,0}; // 0=keep, 1=Standard/new, 2=Classic
uint8_t btLastWatchAddressType = 0xFF;
uint32_t btConnectionAttempts = 0;
uint32_t btWriteAcknowledgements = 0;
std::atomic<uint32_t> btNotifications{0};
std::atomic<uint32_t> btResponseErrors{0};
const char *btDeliveryEvidence = "No delivery yet";
static void bluetoothLocalTime(time_t utc, struct tm &out);
bool btProfileDoneToday(int profile) {
  if (profile < 0 || profile >= BT_WATCH_PROFILE_COUNT) return false;
  time_t now = time(nullptr); struct tm day; bluetoothLocalTime(now, day);
  return btProfileSuccessYear[profile] == day.tm_year + 1900 &&
         btProfileSuccessYday[profile] == day.tm_yday;
}
// Circular distance between two clock times: handles midnight rollover.
int btCircularDistance(int a, int b) { int d = abs(a-b); return d < 720 ? d : 1440-d; }
bool btOverlapsOtherEnabledSlot(int slot,int minute) {
  for (int i=0;i<BT_SYNC_SLOT_COUNT;++i)
    if (i!=slot && btSyncEnabled[i] && btCircularDistance(btSyncTimes[i],minute) <=
        BT_PREPARE_MINUTES + BT_WINDOW_AFTER_MINUTES + 1) return true;
  return false;
}
// Delivery history is per protocol/profile and informational. Each enabled
// automatic slot listens every day, including after an earlier delivery.
int btSuccessYear[BT_PROTOCOL_COUNT] = {-1, -1, -1};
int btSuccessYday[BT_PROTOCOL_COUNT] = {-1, -1, -1};
bool btSyncDayComplete = false;
int btSyncLastYear = -1;
int btSyncLastYday = -1;
int btSyncActiveSlot = -1;
unsigned long btWindowEndMillis = 0;
int btSlotAttemptYear[BT_SYNC_SLOT_COUNT] = {-1,-1,-1,-1};
int btSlotAttemptYday[BT_SYNC_SLOT_COUNT] = {-1,-1,-1,-1};
std::atomic<bool> btWindowActive{false};
bool btManualSyncRequested = false;
// When enabled, CasioSync continuously scans for the already-paired selected
// watch whenever listening is enabled. Pairing itself always remains an explicit action.
bool btAlwaysWaitEnabled = true;
bool btIdlePowerSaveEnabled = false;
bool btPersistentWaitActive = false;
// This flag represents failed/required BLE shutdown only. SDK callbacks and
// synchronous GATT cancellation share it without touching settings or Strings.
std::atomic<bool> btShutdownRequested{false};
std::atomic<bool> btControllerStarted{false}; // Remains true until the controller is verified idle.
// Pair mode deliberately ignores the currently learned address for the selected
// profile, but does not erase that binding until the new watch has completed a
// successful connection/time write. This makes a failed re-pair attempt safe.
bool btPairRequested = false;
bool btPairModeActive = false;
bool btBleInitialized = false;
std::atomic<bool> btBleBusy{false};
String btLastWatchName = "";
String btLastWatchAddress = "";
String btLastSyncStatus = "Never synced";
String btLastSyncDate = "";
String btFontLastStatus = "No font override requested";
// Battery samples are runtime status only: never serialize them to LittleFS.
CasioWatchBattery::Reading btBatteryReadings[BT_WATCH_PROFILE_COUNT];
static_assert(BtRecentSyncs::ProfileCount == BT_WATCH_PROFILE_COUNT, "Recent sync profile count mismatch");
static_assert(BtRecentSyncs::ProtocolCount == BT_PROTOCOL_COUNT, "Recent sync protocol count mismatch");
BtRecentSyncs::Store btRecentSyncs; // Fixed four attempts per watch; RAM-only, cleared at boot.
const char *btBatteryStatuses[BT_WATCH_PROFILE_COUNT] = {
  "Not read since boot", "Not read since boot", "Not read since boot", "Not read since boot"
};
CasioWatchBattery::Reading btPendingBattery;
const char *btPendingBatteryStatus = "Not read during this sync";
std::atomic<uint32_t> btLastSyncEpoch{0};
std::atomic<bool> btLastOutcomeSuccessful{false};
uint32_t btProtocolLastSyncEpoch[BT_PROTOCOL_COUNT] = {};
uint32_t btProfileLastSyncEpoch[BT_WATCH_PROFILE_COUNT] = {};
uint8_t btProfileLastSyncProtocol[BT_WATCH_PROFILE_COUNT] = {};
String btProfileLastSyncAddress[BT_WATCH_PROFILE_COUNT];
bool btHistoryPersistEnabled = true;
uint32_t btHistoryGeneration = 0;
int64_t btHistorySavedDay = -1;
int64_t btHistoryAttemptDay = -1;
uint32_t btHistorySavedEpoch = 0;
uint32_t btHistorySnapshotGeneration = 0;
String btHistorySaveStatus = "No daily snapshot saved yet";
#define BT_HISTORY_FILE "/casiosync-bt-status.bin"
#define BT_HISTORY_TEMP_FILE "/casiosync-bt-status.tmp"
// User choices survive reboot; actual feature results remain RAM-only.
CasioWatchFeatures::Desired btFeatureDesired[BT_WATCH_PROFILE_COUNT];
char btFeatureBoundAddress[BT_WATCH_PROFILE_COUNT][18] = {};
uint8_t btFeatureBoundProtocol[BT_WATCH_PROFILE_COUNT] = {};
const char *btFeatureStatus[BT_WATCH_PROFILE_COUNT] = {
  "Off: time synchronization only", "Off: time synchronization only",
  "Off: time synchronization only", "Off: time synchronization only"
};
#define WATCH_OPTIONS_FILE "/casiosync-watch-options.bin"
#define WATCH_OPTIONS_TEMP_FILE "/casiosync-watch-options.tmp"
static void loadWatchOptions(void);
static bool saveWatchOptions(void);
static void applyBluetoothWatchFeatures(void);

NimBLEScan *btScan = nullptr;
NimBLEClient *btClient = nullptr;
NimBLERemoteService *btService = nullptr;
NimBLERemoteCharacteristic *btSpRequest = nullptr;
NimBLERemoteCharacteristic *btSpData = nullptr;
NimBLERemoteCharacteristic *btSetChar = nullptr;

// Scan callbacks run on the NimBLE host task. Never mutate shared Arduino
// String objects there: publish a fixed-size discovery snapshot and let loop() consume it.
volatile bool btDiscoveryReady = false;
char btDiscoveredName[48] = {};
char btDiscoveredAddress[18] = {};
char btExpectedProfileAddress[18] = {};
uint8_t btDiscoveredAddressType = 0xFF;
portMUX_TYPE btDiscoveryMux = portMUX_INITIALIZER_UNLOCKED;
uint32_t btDiscoveryGeneration = 0;
uint8_t btDiscoveryProtocol = BT_PROTOCOL_BX5600_MIP;

volatile bool btResponseActive = false;
volatile uint8_t btExpectedHeader = 0;
volatile size_t btResponseLength = 0;
#define BT_RESPONSE_CAPACITY 512
uint8_t btResponseBuffer[BT_RESPONSE_CAPACITY];
volatile unsigned long btLastFragmentMillis = 0;
volatile bool btResponseOverflow = false;
portMUX_TYPE btResponseMux = portMUX_INITIALIZER_UNLOCKED;

void initBluetoothSync(void);
void serviceBluetoothSync(void);
bool performGShockBX5600Sync(void);
bool performCasioStandardTimeSync(int protocol);
static bool btWatchNameMatches(int protocol, const String &name);
void resetBluetoothDayIfNeeded(void);
void startBluetoothWindow(int slot, bool persistent = false);
void stopBluetoothWindow(void);
static void recoverBluetoothControllerShutdown(void);
static void disconnectGShock(void);
static bool btClientQuiescent(void);
static void releaseBtClientBarrier(void);
static bool bleOperationCancelled() { return btShutdownRequested.load(std::memory_order_acquire); }
static const char *btPhase = "Idle"; // loopTask owns UI state; callbacks only publish flags.
static void setBluetoothPhase(const char *phase) { btPhase = phase; }
static bool bluetoothSettingsMutable(void);
static bool bluetoothControllerNeeded(void);
static bool shutdownIdleBluetooth(void);
static void loadBluetoothHistory(void);
static bool saveBluetoothHistoryNow(time_t epoch);


// Saved blue GPIO2 LED preference. A dedicated low-priority task owns the
// output at runtime, including while loop() blocks on a Bluetooth GATT write.
// Default on also applies to configurations from versions before V4.6.
std::atomic<bool> activityLedEnabled{true};
TaskHandle_t activityLedTaskHandle = nullptr;

//...................................................................
// WiFi Access Point Mode Configuration

bool ap_mode = false;              // WiFi mode flag: true = AP mode, false = STA mode
bool wifiConnectionAccessGrace = true; // Explicit setup/recovery grants five-minute access.
bool wifiCredentialsReconnectPending = false; // Apply after the HTTP response has returned.
bool wifiConnectionPending = false; // An explicit credential attempt may keep AP+STA active.
bool wifiRecoveryWindowActive = false;
unsigned long wifiRecoveryStarted = 0;
unsigned long last_wifi_check = 0; // Timestamp of last WiFi connection check

//...................................................................
// WiFi power management ("Always on" vs "Scheduled/power-save")
//
// Scheduled mode keeps WiFi off outside startup/recovery access, the optional
// daily web-access window and existing short NTP/lead-time wakes. These access
// daily Bluetooth preparation wakes. All exceptions use RAM-only window state.
#define WIFI_POWER_ALWAYS_ON  0
#define WIFI_POWER_SCHEDULED  1
int wifiPowerMode = WIFI_POWER_ALWAYS_ON;   // persisted config value
bool wifiAccessEnabled = false;
bool crashDumpEnabled = false; // Only user-enabled panics may write a crash dump.
int wifiAccessStart = 1080; // 18:00, disabled until explicitly enabled.
int wifiAccessEnd = 1200;   // 20:00
String wifiAccessTimezone = "Australia/Brisbane";

#define WIFI_BOOT_ON_DURATION_MS      (5UL * 60UL * 1000UL)   // 5 minutes

bool wifiRadioEnabled = true;       // Desired state; WiFi.getMode() is the observed state.
bool wifiPowerFault = false;        // RAM only: desired Off could not be reached.
uint32_t wifiPowerFaultCount = 0;
bool wifiPowerShutdownPending = false;
uint64_t wifiPowerRetryAtMs = 0;
uint32_t wifiPowerRetryDelayMs = 1000;
static const uint32_t WIFI_POWER_RETRY_MAX_MS = 60000;
unsigned long bootMillis = 0;       // Set once in setup(); anchors the post-boot on-window
bool wifiBootAccessComplete = false; // Latch prevents re-opening at each millis() rollover.
uint64_t wifiStaRetryAtMs = 0;
uint32_t wifiStaRetryDelayMs = 30000;
bool wifiClockWakeActive = false;
uint64_t wifiClockWakeStartedMs = 0;
uint64_t wifiClockRetryAtMs = 0;
uint32_t wifiClockRetryDelayMs = 30000;
uint32_t wifiClockWakeSyncCount = 0;
uint64_t wifiNtpConfigureRetryAtMs = 0;
uint32_t wifiNtpConfigureRetryDelayMs = 5000;
static const uint32_t WIFI_RETRY_MAX_MS = 15UL * 60UL * 1000UL;
static const uint32_t WIFI_CLOCK_WAKE_TIMEOUT_MS = 120000;
static const uint32_t WIFI_CLOCK_WAKE_LEAD_SEC = 60;
bool apStartPending = false;        // Configuration requested, but AP startup failed.
unsigned long apStartAttemptMillis = 0;
#define AP_START_RETRY_MS 5000UL

//...................................................................
// Debounced config persistence (flash-wear mitigation). Declared here,
// before loop(), because loop() reads these directly - unlike functions,
// plain variables/#defines are not auto-forward-declared by the Arduino
// build system, so they must appear in the file before first use. See the
// full explanation next to writeConfigNow()/saveConfig().
#define CONFIG_SAVE_DEBOUNCE_MS  3000
bool configDirty = false;
unsigned long configDirtyBecause = 0;
bool filesystemAvailable = false;
bool configStorageFault = false; // RAM only; a successful explicit save clears it.
// Web/config/schedule mutations run on loopTask, never concurrently. Share a
// fixed serialization buffer to avoid both heap fragmentation and large stack
// frames during low-memory saves. No record is committed after overflow.
static char storageSerializationBuffer[2048];

// Unsigned elapsed arithmetic keeps the flash cadence correct through
// millis() rollover. Off clears the output at the next task poll. A Bluetooth
// transaction starts with an immediate ON phase; idle holds eligible success
// steady for 24 hours and is otherwise dark.
static void writeActivityLed(bool on) {
#if defined(ACTIVITY_LED_RGB_PIN)
  rgbLedWrite(ACTIVITY_LED_RGB_PIN, 0, 0, on ? 32 : 0);
#elif !defined(ACTIVITY_LED_UNAVAILABLE)
#if defined(ACTIVITY_LED_ACTIVE_LOW)
  digitalWrite(PIN_ONBOARD_LED, on ? LOW : HIGH);
#else
  digitalWrite(PIN_ONBOARD_LED, on ? HIGH : LOW);
#endif
#else
  (void)on;
#endif
}
static void initializeActivityLed(void) {
#if !defined(ACTIVITY_LED_RGB_PIN) && !defined(ACTIVITY_LED_UNAVAILABLE)
  pinMode(PIN_ONBOARD_LED, OUTPUT);
#endif
  writeActivityLed(false);
}

static bool activityLedLevel(uint32_t nowMs, bool enabled, bool active, bool successEligible,
                             uint32_t &phaseStartMs, bool &level, bool &wasActive)
{
  return BtSyncLed::output(nowMs, enabled, active, successEligible,
                           phaseStartMs, level, wasActive);
}

static bool activityLedSyncActive(void)
{
  // Scanning/Always Wait alone are idle. Busy covers connecting and the
  // actual acknowledged time-delivery transaction, which may block loop().
  return btBleBusy.load();
}

static bool activityLedSuccessEligible(void) {
  const bool successful = btLastOutcomeSuccessful.load(std::memory_order_acquire);
  const uint32_t epoch = btLastSyncEpoch.load(std::memory_order_acquire);
  return BtSyncLed::successEligible((int64_t)time(nullptr), epoch, successful);
}

static void activityLedTask(void *)
{
  uint32_t phaseStartMs = millis();
  bool level = false;
  bool wasActive = false;
  bool writtenLevel = false;
  for (;;) {
    const bool nextLevel = activityLedLevel(millis(), activityLedEnabled.load(),
                                           activityLedSyncActive(), activityLedSuccessEligible(),
                                           phaseStartMs, level, wasActive);
    if (nextLevel != writtenLevel) {
      writeActivityLed(nextLevel);
      writtenLevel = nextLevel;
    }
    vTaskDelay(pdMS_TO_TICKS(50));
  }
}

uint32_t activityLedStackMinimum(void) {
  return activityLedTaskHandle ? (uint32_t)uxTaskGetStackHighWaterMark(activityLedTaskHandle) : 0;
}

static void safetyMonitorTask(void *) {
  for (;;) {
    vTaskDelay(pdMS_TO_TICKS(100));
    if (!safetyMonitorReady.load(std::memory_order_acquire)) continue;
    const uint64_t nowUs = (uint64_t)esp_timer_get_time();
    portENTER_CRITICAL(&progressMux);
    const uint64_t last = applicationLoopLastUs;
    portEXIT_CRITICAL(&progressMux);
    const uint32_t available = (uint32_t)uxTaskGetStackHighWaterMark(nullptr);
    if (available < monitorStackMinimum) monitorStackMinimum = available;
    if (last && nowUs >= last && nowUs-last > LOOP_PROGRESS_DEADLINE_US &&
        applicationLoopAgeMs() > LOOP_PROGRESS_DEADLINE_US / 1000ULL)
      applicationForceSafeRestart();
  }
}

static bool startSafetyMonitor(void) {
  if (safetyMonitorTaskHandle && safetyMonitorReady.load()) return true;
  applicationProgressCheckpoint();
  BaseType_t created;
#if CONFIG_FREERTOS_UNICORE
  created = xTaskCreate(safetyMonitorTask, "safetyMonitor", 2048, nullptr, 1, &safetyMonitorTaskHandle);
#else
  created = xTaskCreatePinnedToCore(safetyMonitorTask, "safetyMonitor", 2048, nullptr, 1,
                                    &safetyMonitorTaskHandle, 0);
#endif
  if (created != pdPASS || !safetyMonitorTaskHandle) {
    safetyMonitorTaskHandle = nullptr;
    Serial.println("ERROR: progress monitor unavailable; Bluetooth startup disabled");
    return false;
  }
  safetyMonitorReady.store(true, std::memory_order_release);
  return true;
}

// extern


//...................................................................
void setup(void) {
  Serial.begin(115200);
  delay(100);
  Serial.printf("started... (CasioSync firmware %s build %s)\n", FIRMWARE_VERSION, FIRMWARE_BUILD);
  Serial.printf("Reset reason: %d (4=panic, 5/6/7=watchdog, 9=brownout)\n", (int)esp_reset_reason());
  bootMillis = millis();
  WiFi.persistent(false); // Credentials are saved only in our checked config.
  initializeActivityLed();
  initFilesystem();
  loadConfig();
  applyTimezone();
  normalizeBluetoothSlots();
  if (startSafetyMonitor()) initBluetoothSync();
  else Serial.println("Bluetooth startup skipped: progress monitor unavailable");
  BaseType_t ledCreated;
#if CONFIG_FREERTOS_UNICORE
  ledCreated = xTaskCreate(activityLedTask, "activityLed", 2048, nullptr, 1, &activityLedTaskHandle);
#else
  ledCreated = xTaskCreatePinnedToCore(activityLedTask, "activityLed", 2048, nullptr, 1,
                                      &activityLedTaskHandle, 1);
#endif
  if (ledCreated != pdPASS || !activityLedTaskHandle) {
    activityLedTaskHandle = nullptr;
    Serial.println("Activity LED task unavailable; blue LED left off");
  }
  if (!filesystemAvailable || !strlen(ssid)) {
    Serial.println("No CasioSync WiFi config found, starting AP mode for configuration...");
    startAPMode();
  } else ntpstart();
  Serial.println("CasioSync watch scheduler started.");
}

void loop() {
  applicationProgressCheckpoint();
  if (wifiCredentialsReconnectPending) {
    wifiCredentialsReconnectPending=false;
    beginWifiCredentialConnection();
  }
  flushNtpLogs();
  const bool wifiConnectedNow = WiFi.status() == WL_CONNECTED;
  if (millis() - last_wifi_check > WIFI_CONNECT_CHECK_INTERVAL) {
    last_wifi_check = millis();
    checkWiFiConnection();
  }
  serviceAPStartup();
  updateWifiPowerManagement();
  if (safetyMonitorReady.load()) serviceBluetoothSync();
  servicePendingConfigSave();
  if (webServerStarted && (ap_mode || wifiConnectedNow)) server.handleClient();
  applicationProgressCheckpoint();
  delay(btIdlePowerSaveEnabled && !btWindowActive && !btBleBusy ? 10 : 1);
}


// Arduino-ESP32's newlib does not ship the IANA zoneinfo database, so
// setting TZ to an IANA name like "Asia/Tokyo" does NOT apply the correct
// UTC offset or DST rule - tzset() silently falls back to UTC when it can't
// parse the TZ string as a POSIX rule. To make the "Time zone" selector in
// the UI actually control both the displayed clock AND the transmitted
// time, each zone offered in the UI is mapped here to an equivalent POSIX
// TZ rule, which tzset()/localtime_r() parse natively (DST transitions
// included).
static bool validTimezoneName(const String &zoneName)
{
  return zoneName == "Australia/Brisbane" || zoneName == "Australia/Sydney" ||
         zoneName == "Asia/Tokyo" || zoneName == "Asia/Shanghai" ||
         zoneName == "Europe/London" || zoneName == "America/New_York" ||
         zoneName == "America/Los_Angeles" || zoneName == "UTC";
}

// Watch and Wi-Fi-access civil times never mutate the process-wide display TZ.
// Their supported zones use explicit UTC-offset/DST calculations.
static int btWeekday(int year, int month, int day)
{
  static const int table[] = {0, 3, 2, 5, 0, 3, 5, 1, 4, 6, 2, 4};
  if (month < 3) --year;
  return (year + year / 4 - year / 100 + year / 400 + table[month - 1] + day) % 7;
}

static int btNthSunday(int year, int month, int ordinal)
{
  const int firstWeekday = btWeekday(year, month, 1);
  return 1 + ((7 - firstWeekday) % 7) + (ordinal - 1) * 7;
}

static int btLastSunday(int year, int month)
{
  int days = 31;
  if (month == 4 || month == 6 || month == 9 || month == 11) days = 30;
  else if (month == 2) {
    const bool leap = (year % 4 == 0 && year % 100 != 0) || (year % 400 == 0);
    days = leap ? 29 : 28;
  }
  return days - ((btWeekday(year, month, days)) % 7);
}

static int btDayOfYear(int year, int month, int day)
{
  static const int beforeMonth[] = {0, 31, 59, 90, 120, 151, 181, 212, 243, 273, 304, 334};
  const bool leap = (year % 4 == 0 && year % 100 != 0) || (year % 400 == 0);
  return beforeMonth[month - 1] + day - 1 + (month > 2 && leap ? 1 : 0);
}

static bool btDstAtUtc(const String &zoneName, const struct tm &utc)
{
  const int year = utc.tm_year + 1900;
  const int month = utc.tm_mon + 1;
  const int day = utc.tm_mday;
  const int hour = utc.tm_hour;
  if (zoneName == "Australia/Sydney") {
    // 02:00 AEST / 03:00 AEDT on Sunday are both 16:00 UTC on
    // Saturday. Day-of-year arithmetic also handles a Sunday on the
    // first of April/October, whose UTC transition is in March/September.
    const int startDay = btDayOfYear(year, 10, btNthSunday(year, 10, 1)) - 1;
    const int endDay = btDayOfYear(year, 4, btNthSunday(year, 4, 1)) - 1;
    const int utcSeconds = ((btDayOfYear(year, month, day) * 24 + hour) * 60 + utc.tm_min) * 60 + utc.tm_sec;
    return utcSeconds >= startDay * 86400 + 16 * 3600 ||
           utcSeconds < endDay * 86400 + 16 * 3600;
  }
  if (zoneName == "Europe/London") {
    const int start = btLastSunday(year, 3);
    const int end = btLastSunday(year, 10);
    if (month > 3 && month < 10) return true;
    if (month == 3) return day > start || (day == start && hour >= 1);
    if (month == 10) return day < end || (day == end && hour < 1);
    return false;
  }
  if (zoneName == "America/New_York" || zoneName == "America/Los_Angeles") {
    const int start = btNthSunday(year, 3, 2);
    const int end = btNthSunday(year, 11, 1);
    const int startHour = zoneName == "America/New_York" ? 7 : 10;
    const int endHour = zoneName == "America/New_York" ? 6 : 9;
    if (month > 3 && month < 11) return true;
    if (month == 3) return day > start || (day == start && hour >= startHour);
    if (month == 11) return day < end || (day == end && hour < endHour);
  }
  return false;
}

static int btBaseOffsetSeconds(const String &zoneName)
{
  if (zoneName == "Australia/Brisbane" || zoneName == "Australia/Sydney") return 10 * 3600;
  if (zoneName == "Asia/Tokyo") return 9 * 3600;
  if (zoneName == "Asia/Shanghai") return 8 * 3600;
  if (zoneName == "America/New_York") return -5 * 3600;
  if (zoneName == "America/Los_Angeles") return -8 * 3600;
  return 0; // UTC and Europe/London standard time
}

static void bluetoothLocalTime(time_t utc, struct tm &out)
{
  struct tm utcTm;
  gmtime_r(&utc, &utcTm);
  const bool dst = btDstAtUtc(btTimezoneName, utcTm);
  int offset = btBaseOffsetSeconds(btTimezoneName) + (dst ? 3600 : 0) + btTimeOffsetMinutes * 60;
  time_t adjusted = utc + offset;
  gmtime_r(&adjusted, &out);
  out.tm_isdst = dst ? 1 : 0;
}

static String posixTzFor(const String &zoneName)
{
  if (zoneName == "Australia/Brisbane")  return "AEST-10";                                  // no DST
  if (zoneName == "Australia/Sydney")    return "AEST-10AEDT,M10.1.0/2,M4.1.0/3";
  if (zoneName == "Asia/Tokyo")          return "JST-9";                                    // no DST
  if (zoneName == "Asia/Shanghai")       return "CST-8";                                    // no DST
  if (zoneName == "Europe/London")       return "GMT0BST,M3.5.0/1,M10.5.0/2";
  if (zoneName == "America/New_York")    return "EST5EDT,M3.2.0/2,M11.1.0/2";
  if (zoneName == "America/Los_Angeles") return "PST8PDT,M3.2.0/2,M11.1.0/2";
  if (zoneName == "UTC")                 return "UTC0";
  return "UTC0";  // unknown zone: fall back safely rather than using a wrong display offset
}

// Applies the independent display clock timezone; BT uses its own conversion.
static void applyTimezone(void)
{
  setenv("TZ", posixTzFor(timezone_name).c_str(), 1);
  tzset();
}

// SNTP library callback, fired automatically every time a sync completes
// (see sntp_set_time_sync_notification_cb() in ntpstart()). Compares how
// far the wall clock had drifted from what it "should" say (based on the
// board's own monotonic timer) since the previous sync, and folds that
// into a smoothed drift estimate. Only clock bookkeeping and inexpensive
// interval arithmetic run here. The SDK calls this notification BEFORE
// scheduling its next request, so setting the interval here changes that
// timeout without restarting SNTP or requesting another immediate reply.
void configureAdaptiveNtp(void);
static bool ntpReplyPlausible(const struct timeval *tv)
{
  if (!tv || tv->tv_usec < 0 || tv->tv_usec >= 1000000 ||
      tv->tv_sec < 1577836800LL || tv->tv_sec >= 4102444800LL) return false;
  const uint64_t mono = (uint64_t)esp_timer_get_time();
  portENTER_CRITICAL(&clockMux);
  const bool known=clockNtpEverSynced;
  const uint64_t anchorMono=ntpLastMonoUs;
  const int64_t anchorEpoch=ntpLastEpochUs;
  portEXIT_CRITICAL(&clockMux);
  if (!known) return true;
  if (mono < anchorMono) return false;
  const uint64_t elapsed=mono-anchorMono;
  const int64_t epochUs=(int64_t)tv->tv_sec*1000000LL+tv->tv_usec;
  const int64_t expected=anchorEpoch+(int64_t)elapsed;
  const double allowedUs=2000000.0 + (double)elapsed*CLOCK_MAX_PLAUSIBLE_PPM/1000000.0;
  return fabs((double)(epochUs-expected)) <= allowedUs;
}

static void rejectNtpReply(bool countRejection)
{
  portENTER_CRITICAL(&clockMux);
  clockNtpRejected=true;
  if (countRejection && clockNtpRejectedCount != UINT32_MAX) ++clockNtpRejectedCount;
  portEXIT_CRITICAL(&clockMux);
  ntpsync=0;
  ntpIntervalSec=NTP_MIN_INTERVAL_SEC;
  sntp_set_sync_interval(NTP_MIN_INTERVAL_SEC*1000UL);
}

static bool admitNtpReply(const struct timeval *tv, bool &reacquired)
{
  reacquired = false;
  const bool valid = tv && tv->tv_usec >= 0 && tv->tv_usec < 1000000 &&
      tv->tv_sec >= 1577836800LL && tv->tv_sec < 4102444800LL;
  const uint64_t mono = (uint64_t)esp_timer_get_time();
  portENTER_CRITICAL(&clockMux);
  const bool known = clockNtpEverSynced;
  const bool rejected = clockNtpRejected;
  portEXIT_CRITICAL(&clockMux);
  if (known && !rejected && ntpReplyPlausible(tv)) return true;
  // Reacquire after ANY rejected correction, even if the next reply matches
  // the old anchor. Otherwise one stray reply could promote a bad anchor.
  // Candidate state is used only by the serialized lwIP SNTP callback.
  if (!valid) {
    ntpCandidateReplies = 0;
    portENTER_CRITICAL(&clockMux);
    clockNtpCandidateReplyCount = 0;
    portEXIT_CRITICAL(&clockMux);
    rejectNtpReply(true);
    return false;
  }
  const int64_t epochUs = (int64_t)tv->tv_sec * 1000000LL + tv->tv_usec;
  bool consistent = ntpCandidateReplies && mono >= ntpCandidateMonoUs &&
      mono >= ntpCandidateLastMonoUs &&
      mono - ntpCandidateMonoUs <= NTP_CANDIDATE_MAX_SPAN_US;
  if (consistent) {
    const uint64_t elapsed = mono - ntpCandidateMonoUs;
    const int64_t expected = ntpCandidateEpochUs + (int64_t)elapsed;
    const double allowance = 2.0 * CLOCK_INITIAL_UNCERTAINTY_SEC * 1000000.0 +
        (double)elapsed * CLOCK_MAX_PLAUSIBLE_PPM / 1000000.0;
    consistent = fabs((double)(epochUs - expected)) <= allowance;
  }
  if (!consistent) {
    ntpCandidateMonoUs = ntpCandidateLastMonoUs = mono;
    ntpCandidateEpochUs = epochUs;
    ntpCandidateReplies = 1;
  } else if (mono - ntpCandidateLastMonoUs >= NTP_CANDIDATE_MIN_STEP_US) {
    ntpCandidateLastMonoUs = mono;
    if (ntpCandidateReplies < 3) ++ntpCandidateReplies;
  }
  portENTER_CRITICAL(&clockMux);
  clockNtpCandidateReplyCount = ntpCandidateReplies;
  portEXIT_CRITICAL(&clockMux);
  if (ntpCandidateReplies >= 3 &&
      mono - ntpCandidateMonoUs >= NTP_CANDIDATE_MIN_SPAN_US) {
    // Keep the rejection latch set until wall-clock commit and bookkeeping
    // finish. BT cannot sample the new time while it is being established.
    reacquired = true;
    return true;
  }
  // Provisional consistent replies are acquisition progress, not a server
  // error. Count the initial rejected old-anchor correction separately.
  rejectNtpReply(known && !rejected);
  return false;
}

static void recordAcceptedNtpReply(struct timeval *tv, bool reacquired)
{
  const uint64_t mono = (uint64_t)esp_timer_get_time();
  const int64_t epochUs = (int64_t)tv->tv_sec * 1000000LL + tv->tv_usec;
  portENTER_CRITICAL(&clockMux);
  const uint64_t previousMono = ntpDriftAnchorMonoUs;
  const int64_t previousEpoch = ntpDriftAnchorEpochUs;
  const bool previouslySynced = clockNtpEverSynced;
  if (reacquired) {
    // A civil-time correction is not oscillator drift. Begin a fresh
    // measurement window and retain the conservative initial envelope.
    ntpDriftPpm = ntpDriftAbsSecPerHour = 0.0;
    clockDriftSampleAvailable = false;
    clockDriftBoundPpm = CLOCK_INITIAL_PPM;
    if (previouslySynced && clockNtpReacquisitionCount != UINT32_MAX)
      ++clockNtpReacquisitionCount;
  }
  portEXIT_CRITICAL(&clockMux);
  const uint64_t elapsed = mono >= previousMono ? mono - previousMono : 0;
  const int64_t expected = previousEpoch + (int64_t)elapsed;
  const int64_t correction = epochUs - expected;
  const bool measurement = previouslySynced && !reacquired && previousMono &&
      elapsed >= 300000000ULL;
  if (measurement) {
    const double ppm = (double)correction * 1000000.0 / (double)elapsed;
    // Bound measurement uncertainty at both ends. Retain recent absolute
    // peaks with slow decay; signed diagnostic EMA cannot hide reversal.
    const double measurementBound = fabs(ppm) +
         2.0 * CLOCK_INITIAL_UNCERTAINTY_SEC * 1000000000000.0 / (double)elapsed;
    portENTER_CRITICAL(&clockMux);
    ntpDriftPpm = clockDriftSampleAvailable
      ? ntpDriftPpm * (1.0 - NTP_DRIFT_EMA_ALPHA) + ppm * NTP_DRIFT_EMA_ALPHA : ppm;
    clockDriftBoundPpm = fmax(CLOCK_DRIFT_FLOOR_PPM,
        fmax(measurementBound, clockDriftBoundPpm * 0.95));
    ntpDriftAbsSecPerHour = clockDriftBoundPpm * 3600.0 / 1000000.0;
    clockDriftSampleAvailable = true;
    portEXIT_CRITICAL(&clockMux);
  }
  portENTER_CRITICAL(&clockMux);
  // Short accepted intervals accumulate against this independent anchor.
  // Resetting it after every 210-second reply would freeze uncertainty.
  if (!previouslySynced || reacquired || measurement || !previousMono) {
    ntpDriftAnchorMonoUs = mono;
    ntpDriftAnchorEpochUs = epochUs;
  }
  ntpLastMonoUs = mono;
  ntpLastEpochUs = epochUs;
  clockNtpEverSynced = true;
  clockNtpRejected = false;
  clockNtpCandidateReplyCount = 0;
  ++clockNtpSyncCount;
  portEXIT_CRITICAL(&clockMux);
  ntpCandidateReplies = 0;
  ntpsync = 1;
  configureAdaptiveNtp();
}

void onNtpSync(struct timeval *tv)
{
  // Defensive notification entry for a direct SDK callback. The strong
  // pre-commit hook below records acceptance directly, so admission runs
  // exactly once per actual received reply.
  bool reacquired = false;
  if (admitNtpReply(tv, reacquired)) recordAcceptedNtpReply(tv, reacquired);
}

// esp_sntp.h explicitly permits replacing this weak SDK function. Gate
// BEFORE settimeofday: Bluetooth cannot briefly sample a rejected time.
// This project uses immediate sync only; accepted replies preserve that mode
// and the SDK completion status, followed by our registered bookkeeping.
extern "C" void sntp_sync_time(struct timeval *tv)
{
  bool reacquired = false;
  if (!admitNtpReply(tv, reacquired)) {
    sntp_set_sync_status(SNTP_SYNC_STATUS_RESET);
    return;
  }
  const int commitResult = settimeofday(tv, nullptr);
  if (commitResult != 0) {
    rejectNtpReply(true);
    sntp_set_sync_status(SNTP_SYNC_STATUS_RESET);
    return;
  }
  sntp_set_sync_status(SNTP_SYNC_STATUS_COMPLETED);
  recordAcceptedNtpReply(tv, reacquired);
}

// Recalculates ntpIntervalSec from the current drift estimate and applies
// it from the notification callback before the next SNTP timer is armed.
// Reserve initial sync uncertainty and leave a margin before the same
// error/six-hour limits used by clockConfidence(). Unknown drift keeps
// the initial one-hour interval and the conservative 50 ppm error bound.
void configureAdaptiveNtp(void)
{
  portENTER_CRITICAL(&clockMux);
  bool measured=clockDriftSampleAvailable;
  double samplePpm=clockDriftBoundPpm;
  portEXIT_CRITICAL(&clockMux);
  uint32_t interval = NTP_INITIAL_INTERVAL_SEC;
  if (measured) {
    double seconds = CLOCK_MAX_HOLDOVER_SEC * NTP_RESYNC_MARGIN;
    const double drift = fabs(samplePpm) / 1000000.0;
    if (drift > 0.0) {
      const double errorSeconds = (NTP_ERROR_BUDGET_SEC - CLOCK_INITIAL_UNCERTAINTY_SEC) * NTP_RESYNC_MARGIN / drift;
      if (seconds > errorSeconds) seconds = errorSeconds;
    }
    if (seconds < NTP_MIN_INTERVAL_SEC) seconds = NTP_MIN_INTERVAL_SEC;
    interval = (uint32_t)seconds;
  }
  ntpIntervalSec = interval;
  sntp_set_sync_interval(interval * 1000UL);
}

static void flushNtpLogs(void)
{
  static uint32_t lastLoggedSyncCount = 0;
  portENTER_CRITICAL(&clockMux);
  const uint32_t completed = clockNtpSyncCount;
  portEXIT_CRITICAL(&clockMux);
  if (completed != lastLoggedSyncCount) {
    lastLoggedSyncCount = completed;
    Serial.println("NTP synchronized (confirmed server reply)");
  }
}

static bool configureNtpClient(void) {
  if (WiFi.status() != WL_CONNECTED) return false;
  sntp_set_time_sync_notification_cb(onNtpSync);
  sntp_set_sync_mode(SNTP_SYNC_MODE_IMMED);
  const String tzRule = posixTzFor(timezone_name);
  if (!tzRule.length()) {
    Serial.println("ERROR: NTP timezone allocation failed; retaining previous clock");
    return false;
  }
  sntp_set_sync_interval(ntpIntervalSec.load() * 1000UL);
  ntpsync = 0;
  configTzTime(tzRule.c_str(), "pool.ntp.org", "time.nist.gov");
  Serial.println("NTP client started; awaiting a confirmed server reply");
  return esp_sntp_enabled();
}

void ntpstart(void)
{
  // Start association once. checkWiFiConnection() handles completion,
  // deadlines and SNTP startup without blocking loopTask with delay loops.
  if (wifiConnectionPending) return;
  wifiPowerShutdownPending = false;
  wifiPowerRetryAtMs = 0;
  wifiPowerRetryDelayMs = 1000;
  if (!filesystemAvailable || strlen(ssid) == 0) { startAPMode(); return; }
  Serial.printf("Attempting to connect to Network named: %s\n", ssid);
  const bool recoveringFromAP = ap_mode;
  beginWifiCredentialConnection();
  if (wifiConnectionPending && !recoveringFromAP) wifiConnectionAccessGrace = false;
}

// Cleanly shuts down networking: stops the SNTP client, disconnects WiFi,
// and powers the radio off entirely (WIFI_OFF, not just disconnected - this
// actually powers down the WiFi hardware for real power savings). Used by
// updateWifiPowerManagement() to end a scheduled sync window in Power-save
// mode.
bool ntpstop(void)
{
  // Wi-Fi sleep does not invalidate a previously synchronized holdover clock.
  // Stopping an unstarted client can post to an uninitialized TCP/IP mailbox.
  const uint64_t nowMs = (uint64_t)esp_timer_get_time() / 1000ULL;
  if (wifiPowerShutdownPending && nowMs < wifiPowerRetryAtMs) return false;
  if (esp_sntp_enabled()) esp_sntp_stop();
  if (webServerStarted) { server.stop(); webServerStarted=false; }
  const bool disconnected = WiFi.disconnect(true);
  const bool disabled = WiFi.mode(WIFI_OFF);
  const bool observedOff = WiFi.getMode() == WIFI_OFF && WiFi.status() != WL_CONNECTED;
  if (!disconnected || !disabled || !observedOff) {
    if (wifiPowerFaultCount != UINT32_MAX) ++wifiPowerFaultCount;
    Serial.println("ERROR: WiFi shutdown was not fully acknowledged; checking observed mode");
  }
  if (observedOff) {
    wifiPowerFault = wifiPowerShutdownPending = false;
    wifiPowerRetryAtMs = 0;
    wifiPowerRetryDelayMs = 1000;
    return true;
  }
  wifiPowerFault = wifiPowerShutdownPending = true;
  wifiPowerRetryAtMs = nowMs + wifiPowerRetryDelayMs;
  wifiPowerRetryDelayMs = wifiPowerRetryDelayMs < WIFI_POWER_RETRY_MAX_MS / 2
      ? wifiPowerRetryDelayMs * 2 : WIFI_POWER_RETRY_MAX_MS;
  // A failed Off must not strand a still-connected station with no web
  // server or clock service. Preserve access while bounded retries run.
  if (WiFi.status() == WL_CONNECTED) {
    if (!webServerStarted) initWebServer();
    if (!esp_sntp_enabled()) (void)configureNtpClient();
  }
  return false;
}


//...................................................................
// New functions for web UI and configuration

// Flash-wear mitigation #2: uses LittleFS rather than SPIFFS. SPIFFS is
// deprecated by Espressif for exactly the reasons relevant here - it has
// weaker wear-leveling than LittleFS, and a write interrupted by power loss
// (e.g. someone unplugs the board mid-save) can corrupt the whole file
// rather than just losing the in-progress write. LittleFS is a drop-in
// replacement in modern Arduino-ESP32 with the same File/open()/read API
// used below, so no other code needed to change.

//...................................................................
// GW-BX5600 BLE protocol implementation

static bool btWatchNameMatches(int protocol, const String &advertisedName) {
  if (!validBtProtocol(protocol)) return false;
  return CasioModelCatalog::matches(static_cast<CasioModelCatalog::Protocol>(protocol),
                                    advertisedName.c_str(),advertisedName.length());
}

class GShockScanCallbacks : public NimBLEScanCallbacks {
public:
  void onResult(const NimBLEAdvertisedDevice *advertisedDevice) override {
    if (!advertisedDevice || !btWindowActive || btBleBusy) return;
    if (!advertisedDevice->haveServiceUUID() ||
        !advertisedDevice->isAdvertisingService(NimBLEUUID(CASIO_ADVERTISEMENT_SERVICE))) return;

    const bool hasName=advertisedDevice->haveName();
    const std::string name=hasName?advertisedDevice->getName():std::string();
    portENTER_CRITICAL(&btDiscoveryMux);
    uint8_t protocol = btDiscoveryProtocol;
    uint32_t generation = btDiscoveryGeneration;
    portEXIT_CRITICAL(&btDiscoveryMux);
    const bool nameMatches=CasioModelCatalog::matches(static_cast<CasioModelCatalog::Protocol>(protocol),name.data(),name.size());
    const bool unnamedBx=protocol==BT_PROTOCOL_BX5600_MIP && !hasName;
    if (!nameMatches && !unnamedBx) return;
    const std::string address=advertisedDevice->getAddress().toString();

    portENTER_CRITICAL(&btDiscoveryMux);
    bool expectedMatches = !btExpectedProfileAddress[0] ||
                           strcasecmp(btExpectedProfileAddress, address.c_str()) == 0;
    const bool identified = nameMatches || (unnamedBx && btExpectedProfileAddress[0] && expectedMatches);
    if (generation == btDiscoveryGeneration && btWindowActive && expectedMatches && identified && !btDiscoveryReady) {
      strlcpy(btDiscoveredName, name.c_str(), sizeof(btDiscoveredName));
      strlcpy(btDiscoveredAddress, address.c_str(), sizeof(btDiscoveredAddress));
      btDiscoveredAddressType = advertisedDevice->getAddressType();
      btDiscoveryReady = true;
    }
    portEXIT_CRITICAL(&btDiscoveryMux);
  }
};

// NimBLE calls onDisconnect before its GAP handler clears the connection
// handle and releases any blocked GATT procedure. Publish the reuse barrier
// from a subsequent host event, rather than from inside that callback.
static std::atomic<bool> btClientConnected{false};
static std::atomic<bool> btClientConnectionPending{false};
static std::atomic<bool> btClientQuiescentReady{true};
static ble_npl_event btClientTeardownBarrierEvent{};
static ble_npl_callout btClientPreemptionCallout{};
static bool btClientBarrierEventInitialized = false;
static bool btClientPreemptionInitialized = false;
static std::atomic<bool> btClientPreemptionEnabled{false};
static std::atomic<bool> btClientTerminationRequested{false};
static std::atomic<uint32_t> btHostStackMinimumBytes{UINT32_MAX};

uint32_t bluetoothHostStackMinimum(void) {
  const uint32_t sample = btHostStackMinimumBytes.load(std::memory_order_acquire);
  return sample == UINT32_MAX ? 0 : sample;
}

static void sampleBluetoothHostStack(void) {
  // ESP-IDF reports stack high-water marks in bytes, unlike generic FreeRTOS.
  const uint32_t sample = uxTaskGetStackHighWaterMark(nullptr);
  uint32_t previous = btHostStackMinimumBytes.load(std::memory_order_relaxed);
  while (sample < previous && !btHostStackMinimumBytes.compare_exchange_weak(previous, sample,
           std::memory_order_release, std::memory_order_relaxed)) {}
}
static std::atomic<bool> btTransactionActive{false};
static std::atomic<uint32_t> btTransactionStartedMillis{0};
static constexpr uint32_t BT_TRANSACTION_DEADLINE_MS = 45000;
static bool btClientQuarantineActive = false;
static uint32_t btClientQuarantineStartedMillis = 0;
static uint32_t btClientQuarantineLastRetryMillis = 0;

// Admission checks reduce pressure before SDK allocations; the two retained
// singleton allocations also use nothrow in the pinned library. The SDK's
// other STL allocations still require a reserve rather than a null check.
static bool bluetoothMemoryAvailable(bool initializing = false) {
  const uint32_t freeBytes = heap_caps_get_free_size(MALLOC_CAP_INTERNAL | MALLOC_CAP_8BIT);
  const uint32_t largest = heap_caps_get_largest_free_block(MALLOC_CAP_INTERNAL | MALLOC_CAP_8BIT);
  return freeBytes >= (initializing ? 65536U : 32768U) &&
         largest >= (initializing ? 24576U : 12288U);
}

static bool btTransactionDeadlineReached(void) {
  return btTransactionActive.load(std::memory_order_acquire) &&
         static_cast<uint32_t>(millis() - btTransactionStartedMillis.load(std::memory_order_acquire)) >=
           BT_TRANSACTION_DEADLINE_MS;
}

static uint32_t btTransactionRemainingMs(void) {
  if (!btTransactionActive.load(std::memory_order_acquire)) return 0;
  const uint32_t elapsed=millis()-btTransactionStartedMillis.load(std::memory_order_acquire);
  return elapsed<BT_TRANSACTION_DEADLINE_MS?BT_TRANSACTION_DEADLINE_MS-elapsed:0;
}
static uint32_t optionalReplyTimeoutMs(uint32_t maximum=1200) {
  const uint32_t remaining=btTransactionRemainingMs();
  constexpr uint32_t finalTimeReserve=5000;
  if (remaining<=finalTimeReserve) return 0;
  const uint32_t available=remaining-finalTimeReserve;
  return available<maximum?available:maximum;
}

static bool btTransactionCancelled(void) {
  return bleOperationCancelled() || btTransactionDeadlineReached() ||
         (btTransactionActive.load(std::memory_order_acquire) && !clockTrusted());
}

// Both loop() and the host monitor can request termination. Only one submits
// the GAP operation per connection state; no caller destroys client objects.
static bool requestBtClientTermination(void) {
  if (!btClient) return true;
  bool expected = false;
  if (!btClientTerminationRequested.compare_exchange_strong(expected, true)) return true;
  bool requested = true;
  if (btClient->getConnHandle() != BLE_HS_CONN_HANDLE_NONE)
    requested = btClient->disconnect();
  else if (btClientConnectionPending.load(std::memory_order_acquire))
    requested = btClient->cancelConnect();
  if (!requested) btClientTerminationRequested.store(false, std::memory_order_release);
  return requested;
}

static void drainBtClientPreemption(void) {
  if (!btClientPreemptionInitialized) return;
  ble_npl_callout_stop(&btClientPreemptionCallout);
#if !CONFIG_BT_LE_CONTROLLER_NPL_OS_PORTING_SUPPORT
  // The classic ESP32's NPL callout exposes its event. Stop its timer and
  // remove a previously queued expiry before teardown/cache reuse.
  ble_npl_eventq_remove(nimble_port_get_dflt_eventq(), &btClientPreemptionCallout.ev);
#endif
}

static void btClientPreemptionCheck(ble_npl_event *event) {
  (void)event;
  sampleBluetoothHostStack();
  if (!btClientPreemptionEnabled.load(std::memory_order_acquire)) return;
  if (btTransactionCancelled()) {
    // Executed on the NimBLE host, so a loopTask blocked in synchronous GATT
    // is released by the normal GAP disconnect/ATT cancellation path.
    if (!requestBtClientTermination())
      Serial.println("BT: deadline/clock-trust host disconnect failed; retrying");
  }
  if (btClientPreemptionEnabled.load(std::memory_order_acquire) &&
      ble_npl_callout_reset(&btClientPreemptionCallout, ble_npl_time_ms_to_ticks32(20)) != BLE_NPL_OK) {
    btClientPreemptionEnabled.store(false, std::memory_order_release);
    Serial.println("BT: transaction deadline monitor stopped; terminating connection safely");
    requestBtClientTermination();
  }
}

static void btClientTeardownBarrier(ble_npl_event *event) {
  (void)event;
  // This host event runs after GAP teardown; any queued monitor expiry can no
  // longer initiate a connection or touch a characteristic cache.
  drainBtClientPreemption();
  btClientQuiescentReady.store(true, std::memory_order_release);
}

static bool initializeBtClientBarrier(void) {
  if (!btClientBarrierEventInitialized) {
    ble_npl_event_init(&btClientTeardownBarrierEvent, btClientTeardownBarrier, nullptr);
    btClientBarrierEventInitialized = true;
  }
  if (!btClientPreemptionInitialized) {
    if (NIMBLE_RADIOCLOCK_CALLOUT_INIT(&btClientPreemptionCallout, nimble_port_get_dflt_eventq(),
                            btClientPreemptionCheck, nullptr) != 0) {
      Serial.println("BT: transaction deadline monitor allocation failed; connection disabled");
      return false;
    }
    btClientPreemptionInitialized = true;
  }
  return true;
}

// Call only while the host is running and after btClientQuiescent(). Events
// and timers must not retain the old host event queue across deinit/reinit.
static void releaseBtClientBarrier(void) {
  btClientPreemptionEnabled.store(false, std::memory_order_release);
  drainBtClientPreemption();
  if (btClientPreemptionInitialized) {
    ble_npl_callout_deinit(&btClientPreemptionCallout);
    btClientPreemptionInitialized = false;
    btClientPreemptionCallout = {};
  }
  if (btClientBarrierEventInitialized) {
    ble_npl_event_deinit(&btClientTeardownBarrierEvent);
    btClientBarrierEventInitialized = false;
    btClientTeardownBarrierEvent = {};
  }
}

static bool btClientQuiescent(void) {
  return !btClient ||
         (btClientQuiescentReady.load(std::memory_order_acquire) &&
          !btClientConnectionPending.load(std::memory_order_acquire) &&
          !btClientConnected.load(std::memory_order_acquire) &&
          btClient->getConnHandle() == BLE_HS_CONN_HANDLE_NONE);
}

// A late GAP/barrier completion can recover without deleting any retained
// callback storage. If teardown never completes, use controlled recovery
// rather than deleting live objects or remaining blocked indefinitely.
static bool serviceBtClientQuarantine(void) {
  if (!btBleBusy || btClientQuiescent()) {
    btClientQuarantineActive = false;
    return true;
  }
  const uint32_t now = millis();
  if (!btClientQuarantineActive) {
    btClientQuarantineActive = true;
    btClientQuarantineStartedMillis = now;
    btClientQuarantineLastRetryMillis = now;
  }
  if (static_cast<uint32_t>(now - btClientQuarantineStartedMillis) >= 60000U) {
    Serial.println("BT: teardown did not recover within 60 seconds; restarting safely");
    applicationForceSafeRestart();
    return false;
  }
  if (static_cast<uint32_t>(now - btClientQuarantineLastRetryMillis) >= 1000U) {
    btClientQuarantineLastRetryMillis = now;
    requestBtClientTermination();
  }
  return false;
}

class GShockClientCallbacks : public NimBLEClientCallbacks {
public:
  void onConnect(NimBLEClient *client) override {
    (void)client;
    sampleBluetoothHostStack();
    // A cancel-connect racing with successful establishment must be followed
    // by an actual disconnect; let the monitor/loop submit the new operation.
    btClientTerminationRequested.store(false, std::memory_order_release);
    btClientConnected.store(true, std::memory_order_release);
    btClientConnectionPending.store(false, std::memory_order_release);
    Serial.println("BT: Casio watch connected");
  }
  void onConnectFail(NimBLEClient *client, int reason) override {
    (void)client;
    sampleBluetoothHostStack();
    Serial.printf("BT: Casio connection failed (reason=%d)\n", reason);
    publishDisconnected();
  }
  void onDisconnect(NimBLEClient *client, int reason) override {
    (void)client;
    sampleBluetoothHostStack();
    Serial.printf("BT: Casio watch disconnected (reason=%d)\n", reason);
    publishDisconnected();
  }
  void onMTUChange(NimBLEClient *client, uint16_t mtu) override {
    (void)client;
    Serial.printf("BT: negotiated ATT MTU=%u\n", mtu);
  }
private:
  static void publishDisconnected(void) {
    // Never delete the client, its services or characteristics in a callback.
    btClientPreemptionEnabled.store(false, std::memory_order_release);
    if (btClientPreemptionInitialized) ble_npl_callout_stop(&btClientPreemptionCallout);
    btClientConnected.store(false, std::memory_order_release);
    btClientConnectionPending.store(false, std::memory_order_release);
    btClientQuiescentReady.store(false, std::memory_order_release);
    ble_npl_eventq_put(nimble_port_get_dflt_eventq(), &btClientTeardownBarrierEvent);
  }
};
static GShockClientCallbacks gshockClientCallbacks;

static void gshockNotifyCallback(NimBLERemoteCharacteristic *characteristic,
                                 uint8_t *data, size_t length, bool isNotify) {
  (void)isNotify;
  if (!characteristic || !data || !length) return;
  const bool fromSpData = characteristic->getUUID() == NimBLEUUID(CASIO_SP_DATA_CHAR);
  const bool fromBasicSettings = characteristic->getUUID() == NimBLEUUID(CASIO_SET_CHAR);
  if (!fromSpData && !fromBasicSettings) return;
  portENTER_CRITICAL(&btResponseMux);
  // First packet has the response header; continuation packets need not.
  // Buffer bounds are strict: never pass silently truncated watch data back.
  // Basic settings and watch condition arrive on TIME/all-features;
  // SP replies arrive on SP_DATA.
  // Reject unrelated time notifications and interleaved responses.
  const bool correctChannel = (btExpectedHeader == CasioWatchFeatures::kBasicHeader ||
                               btExpectedHeader == CasioWatchFeatures::kFirstAlarmHeader ||
                               btExpectedHeader == CasioWatchFeatures::kOtherAlarmsHeader ||
                               btExpectedHeader == CasioWatchFeatures::kTimerHeader ||
                               btExpectedHeader == CasioWatchFeatures::kAutoAdjustHeader ||
                               btExpectedHeader == CasioWatchBattery::kHeader)
                                ? fromBasicSettings : fromSpData;
  if (btResponseActive && correctChannel && (btResponseLength != 0 || data[0] == btExpectedHeader)) {
    if (length > sizeof(btResponseBuffer) - btResponseLength) {
      btResponseOverflow = true;
      ++btResponseErrors;
      btResponseActive = false;
    } else {
      memcpy(btResponseBuffer + btResponseLength, data, length);
      btResponseLength += length;
      btLastFragmentMillis = millis();
      ++btNotifications;
    }
  }
  portEXIT_CRITICAL(&btResponseMux);
}

static void clearBtDiscovery(void) {
  portENTER_CRITICAL(&btDiscoveryMux);
  ++btDiscoveryGeneration;
  btDiscoveryReady = false;
  btDiscoveredName[0] = '\0';
  btDiscoveredAddress[0] = '\0';
  btDiscoveredAddressType = 0xFF;
  portEXIT_CRITICAL(&btDiscoveryMux);
}

static bool consumeBtDiscovery(String &name, String &address, uint8_t &addressType) {
  char nameCopy[sizeof(btDiscoveredName)];
  char addressCopy[sizeof(btDiscoveredAddress)];
  bool ready;
  portENTER_CRITICAL(&btDiscoveryMux);
  ready = btDiscoveryReady;
  if (ready) {
    memcpy(nameCopy, btDiscoveredName, sizeof(nameCopy));
    memcpy(addressCopy, btDiscoveredAddress, sizeof(addressCopy));
    addressType = btDiscoveredAddressType;
    btDiscoveryReady = false;
  }
  portEXIT_CRITICAL(&btDiscoveryMux);
  if (!ready) return false;
  nameCopy[sizeof(nameCopy)-1] = '\0';
  addressCopy[sizeof(addressCopy)-1] = '\0';
  name = nameCopy;
  address = addressCopy;
  return address.length() == 17;
}

static void cancelBtResponse(void) {
  portENTER_CRITICAL(&btResponseMux);
  btResponseActive = false;
  portEXIT_CRITICAL(&btResponseMux);
}

static unsigned long btShutdownRetryMillis = 0;
static CasioBleScanControl btScanControl;
static bool btShutdownRecoveryActive = false; // loopTask owns this common shutdown budget.
static uint32_t btShutdownRecoveryStartedMillis = 0;
static constexpr uint32_t BT_SHUTDOWN_RECOVERY_DEADLINE_MS = 60000;

// Each individual queue/deinit attempt is bounded, but successful loop returns
// do not prove host progress. Keep one deadline across scanner, client and
// controller failures, including when there is no connected client. Preserve
// every event/callback until physical controller-off is confirmed.
static bool serviceBtShutdownProgress(void) {
  const uint32_t now = millis();
  if (!btShutdownRecoveryActive) {
    btShutdownRecoveryActive = true;
    btShutdownRecoveryStartedMillis = now;
  }
  if (static_cast<uint32_t>(now - btShutdownRecoveryStartedMillis) >=
      BT_SHUTDOWN_RECOVERY_DEADLINE_MS) {
    Serial.println("BT: host/controller shutdown made no safe progress within 60 seconds; restarting safely");
    applicationForceSafeRestart();
    return false;
  }
  return true;
}

static void completeBtShutdownProgress(void) {
  btShutdownRecoveryActive = false;
  btShutdownRecoveryStartedMillis = 0;
}

static bool bluetoothScanMayStart(void) {
  return btBleInitialized && btWindowActive && !btBleBusy &&
         !bleOperationCancelled() && btControllerStarted && bluetoothMemoryAvailable();
}

// In NimBLE 2.5.1, init() may return false after enabling the controller but
// before starting the host. deinit() is then a no-op. Clean up that exact
// partial-init case using Espressif's controller API, preserving all checks.
static bool stopPartiallyInitializedBluetooth(void) {
  if (NimBLEDevice::isInitialized()) return false;
  if (esp_bt_controller_get_status() == ESP_BT_CONTROLLER_STATUS_ENABLED &&
      esp_bt_controller_disable() != ESP_OK) return false;
  if (esp_bt_controller_get_status() == ESP_BT_CONTROLLER_STATUS_INITED &&
      esp_bt_controller_deinit() != ESP_OK) return false;
  return esp_bt_controller_get_status() == ESP_BT_CONTROLLER_STATUS_IDLE;
}


void initBluetoothSync(void) {
  if (btIdlePowerSaveEnabled && !bluetoothControllerNeeded()) return;
  if (btBleInitialized || (btShutdownRetryMillis && (long)(millis()-btShutdownRetryMillis)<0) ||
      bleOperationCancelled()) return;
  if (!bluetoothMemoryAvailable(true)) {
    btLastSyncStatus = "Bluetooth deferred: insufficient internal memory";
    btShutdownRetryMillis = millis() + 1000;
    return;
  }
  if (btControllerStarted) return;
  btControllerStarted = true;
  if (!NimBLEDevice::init("CasioSync")) {
    // An unsuccessful init may still leave the controller enabled. Keep the
    // ownership gate closed unless the physical controller is verified off.
    bool off = stopPartiallyInitializedBluetooth();
    if (off) btControllerStarted = false;
    btLastSyncStatus = "Bluetooth initialization failed";
    btShutdownRequested = !off;
    btShutdownRetryMillis = millis() + 1000;
    Serial.println("ERROR: BLE initialization failed; controller shutdown must complete before reuse");
    return;
  }
  btShutdownRetryMillis = 0;
  btBleInitialized = true;
  btScan = NimBLEDevice::getScan();
  if (!btScan) {
    btLastSyncStatus = "Bluetooth scanner allocation failed";
    btShutdownRequested = true;
    Serial.println("ERROR: BLE scanner unavailable; shutting down before reuse");
    return;
  }
  static GShockScanCallbacks scanCallbacks;
  btScan->setScanCallbacks(&scanCallbacks, false);
  btScan->setActiveScan(true);
  btScan->setInterval(80);
  btScan->setWindow(60);
  btScan->setMaxResults(0);
  // One-second scan completion reports advertisers lacking a response. Avoid
  // a second timeout callout that could outlive a controller restart.
  btScan->setScanResponseTimeout(0);
  if (!btScanControl.initialize(btScan, BT_SCAN_SLICE_MS, bluetoothScanMayStart)) {
    btLastSyncStatus = "Bluetooth scan control initialization failed";
    btShutdownRequested = true;
    Serial.println("ERROR: Bluetooth scan control unavailable; shutdown pending");
    return;
  }
  Serial.println("BT: NimBLE Casio time-only service ready");
}

static void recoverBluetoothControllerShutdown(void) {
  // Capture the window once before cancelling. Failed automatic windows can
  // reopen inside the same civil-time occurrence after recovery.
  static bool captured = false;
  if (!captured) {
    captured = true;
    if (btPairModeActive) btPairRequested = true;
    else if (btSyncActiveSlot >= 0) {
      btSlotAttemptYear[btSyncActiveSlot] = -1;
      btSlotAttemptYday[btSyncActiveSlot] = -1;
    } else if (btWindowActive && !btPersistentWaitActive) btManualSyncRequested = true;
    stopBluetoothWindow();
    cancelBtResponse();
  }
  disconnectGShock();
  if (shutdownIdleBluetooth()) captured = false;
}


void resetBluetoothDayIfNeeded(void) {
  time_t epoch;
  time(&epoch);
  struct tm day;
  bluetoothLocalTime(epoch, day);
  btSyncDayComplete = false; // Informational: any watch profile delivered today.
  for (int i = 0; i < BT_WATCH_PROFILE_COUNT; ++i)
    if (btProfileDoneToday(i)) btSyncDayComplete = true;
}

static int btMinutesOfDay(const struct tm &t) {
  return t.tm_hour * 60 + t.tm_min;
}

static bool btMinuteInBluetoothWindow(int currentMinute, int slotMinute) {
  const int start = (slotMinute - BT_PREPARE_MINUTES + 1440) % 1440;
  const int elapsed = (currentMinute - start + 1440) % 1440;
  return elapsed <= BT_PREPARE_MINUTES + BT_WINDOW_AFTER_MINUTES;
}

// One occurrence belongs to the scheduled target's BT calendar day, even
// when its preparation or trailing listening minutes cross midnight.
static void btSlotOccurrenceDate(int slot, const struct tm &local, int &year, int &yday) {
  year = local.tm_year + 1900;
  yday = local.tm_yday;
  const int delta = btSyncTimes[slot] - btMinutesOfDay(local);
  auto daysInYear = [](int y) { return 365 + ((y % 4 == 0 && y % 100 != 0) || y % 400 == 0); };
  if (delta < -720) {
    if (++yday >= daysInYear(year)) { ++year; yday = 0; }
  } else if (delta > 720) {
    if (--yday < 0) { --year; yday = daysInYear(year) - 1; }
  }
}


static bool bluetoothProfileBindingReady(uint8_t profile, uint8_t protocol) {
  return profile < BT_WATCH_PROFILE_COUNT && validBtProtocol(protocol) &&
         btProfileAddress[profile].length() == 17 && btProfileProtocol[profile] == protocol;
}

void startBluetoothWindow(int slot, bool persistent) {
  if (!btBleInitialized || bleOperationCancelled() || btBleBusy || btWindowActive) return;
  if (slot >= 0) {
    btPairModeActive = false;
    if (slot >= BT_SYNC_SLOT_COUNT || !btSyncEnabled[slot]) return;
    btSyncActiveSlot = slot;
    btActiveProtocol = btSyncProtocol[slot];
    btActiveProfile = btSyncProfile[slot];
  } else {
    btSyncActiveSlot = -1;
    btActiveProtocol = btManualProtocol;
    btActiveProfile = btManualProfile;
  }
  // Only explicit pairing may accept an unbound/replacement watch, in every
  // window type (manual, automatic and Always Wait).
  if (btActiveProfile >= BT_WATCH_PROFILE_COUNT || !validBtProtocol(btActiveProtocol) ||
      (!btPairModeActive && !bluetoothProfileBindingReady(btActiveProfile, btActiveProtocol))) {
    btLastSyncStatus = "Pair Watch first for the selected profile and protocol";
    setBluetoothPhase("No watch paired");
    btSyncActiveSlot = -1;
    return;
  }
  btPersistentWaitActive = persistent;
  btLastWatchAddress = "";
  btLastWatchAddressType = 0xFF;
  clearBtDiscovery();
  portENTER_CRITICAL(&btDiscoveryMux);
  btDiscoveryProtocol = btActiveProtocol;
  if (!btPairModeActive)
    strlcpy(btExpectedProfileAddress, btProfileAddress[btActiveProfile].c_str(), sizeof(btExpectedProfileAddress));
  else btExpectedProfileAddress[0] = '\0';
  btWindowActive = true;
  portEXIT_CRITICAL(&btDiscoveryMux);
  unsigned long remainingSeconds = (unsigned long)BT_MANUAL_WINDOW_MINUTES * 60UL;
  if (slot>=0) {
    time_t epoch=time(nullptr); struct tm local; bluetoothLocalTime(epoch,local);
    const int start=(btSyncTimes[slot]-BT_PREPARE_MINUTES+1440)%1440;
    const int finish=(btSyncTimes[slot]+BT_WINDOW_AFTER_MINUTES)%1440;
    const int elapsedMinutes=(btMinutesOfDay(local)-start+1440)%1440;
    const int windowSeconds=(BT_PREPARE_MINUTES+BT_WINDOW_AFTER_MINUTES+1)*60;
    const int elapsedSeconds=elapsedMinutes*60+local.tm_sec;
    if (elapsedSeconds >= windowSeconds) { stopBluetoothWindow(); return; }
    remainingSeconds=(unsigned long)(windowSeconds-elapsedSeconds);
    // Count only an opened window with a valid watch binding. A rejected
    // opening must remain eligible if pairing completes during this window.
    btSlotOccurrenceDate(slot, local, btSlotAttemptYear[slot], btSlotAttemptYday[slot]);
    Serial.printf("BT SCHED: Watch %u target %02d:%02d %s; listen window %02d:%02d-%02d:%02d; entered at %02d:%02d:%02d\n",
                  btActiveProfile+1, btSyncTimes[slot]/60, btSyncTimes[slot]%60,
                  btTimezoneName.c_str(), start/60, start%60, finish/60, finish%60,
                  local.tm_hour, local.tm_min, local.tm_sec);
  }
  btWindowEndMillis = millis()+remainingSeconds*1000UL;
  if (!persistent && WiFi.status() == WL_CONNECTED) sntp_restart();
  setBluetoothPhase(btPairModeActive ? "Pairing" :
                    slot >= 0 ? "Automatic sync window active" : "Waiting for watch");
  Serial.printf("BT: %s for Watch %u using %s protocol\n",
                persistent ? "Always Wait listening" : btPhase,
                btActiveProfile+1, btProtocolName(btActiveProtocol));
}

void stopBluetoothWindow(void) {
  btWindowActive = false;
  if (btBleInitialized && !btScanControl.stop()) {
    btShutdownRequested = true;
    serviceBtShutdownProgress();
    Serial.println("BT: scan stop not acknowledged; retaining host/controller ownership");
  }
  clearBtDiscovery();
  btSyncActiveSlot = -1;
  btPairModeActive = false;
  btPersistentWaitActive = false;
  setBluetoothPhase("Idle");
}

// Changing one automatic slot must make that slot eligible again without
// interrupting a manual request, passive listening, or another slot. The next
// service pass opens it only inside its BT-time window and after the scanner is ready.
static void resetBluetoothSlotAttempt(int slot) {
  btSlotAttemptYear[slot] = -1;
  btSlotAttemptYday[slot] = -1;
  if (btSyncActiveSlot == slot) stopBluetoothWindow();
}

// Arm notification reception BEFORE sending the BLE request; otherwise a fast
// response can arrive while writeValue() is still returning and be discarded.
static void prepareBtResponse(uint8_t header) {
  portENTER_CRITICAL(&btResponseMux);
  btResponseActive = false;
  btExpectedHeader = header;
  btResponseLength = 0;
  btResponseOverflow = false;
  btLastFragmentMillis = millis();
  btResponseActive = true;
  portEXIT_CRITICAL(&btResponseMux);
}

// Dynamic response assembly: first fragment identifies the request; collect
// continuations until an idle gap, with a minimum size and hard overflow guard.
static bool waitBt(size_t minimum, uint32_t timeoutMs = BT_REQUEST_TIMEOUT_MS) {
  uint32_t started = millis();
  while (millis() - started < timeoutMs) {
    if (btTransactionCancelled() || !btClientPreemptionEnabled.load(std::memory_order_acquire) ||
        !btClientConnected.load(std::memory_order_acquire)) {
      cancelBtResponse();
      Serial.println("BT: response wait cancelled (shutdown, deadline or watch disconnected)");
      return false;
    }
    portENTER_CRITICAL(&btResponseMux);
    size_t n = btResponseLength;
    unsigned long last = btLastFragmentMillis;
    bool overflow = btResponseOverflow;
    portEXIT_CRITICAL(&btResponseMux);
    if (overflow) { cancelBtResponse(); return false; }
    if (n >= minimum && millis() - last >= 300UL) {
      cancelBtResponse();
      return true;
    }
    delay(5);
  }
  cancelBtResponse();
  ++btResponseErrors;
  Serial.printf("BT: response timeout (expected header=0x%02x, minimum=%u bytes)\n",
                btExpectedHeader, (unsigned)minimum);
  return false;
}

static size_t copyBt(uint8_t *dst, size_t maxLen) {
  portENTER_CRITICAL(&btResponseMux);
  size_t n = btResponseLength < maxLen ? btResponseLength : maxLen;
  memcpy(dst, btResponseBuffer, n);
  portEXIT_CRITICAL(&btResponseMux);
  return n;
}

// Write mode is a protocol requirement, not a capability fallback: SP_REQUEST
// is a command without an ATT response; SP_DATA and TIME require ATT responses.
static const char *btGattStage = "idle";

static int btWriteComplete(uint16_t connection, const ble_gatt_error *error,
                           ble_gatt_attr *attribute, void *arg) {
  (void)connection;
  (void)attribute;
  auto *task = static_cast<NimBLETaskData *>(arg);
  *static_cast<uint16_t *>(task->m_pBuf) = error->att_handle;
  NimBLEUtils::taskRelease(*task, error->status);
  return 0;
}

static bool writeBt(NimBLERemoteCharacteristic *c, const uint8_t *d, size_t n,
                    bool withResponse) {
  if (!c || !d || !n || btTransactionCancelled() ||
      !btClientPreemptionEnabled.load(std::memory_order_acquire) ||
      !btClientConnected.load(std::memory_order_acquire)) return false;
  if (withResponse ? !c->canWrite() : !c->canWriteNoResponse()) return false;
  const uint16_t mtu = btClient->getMTU();
  Serial.printf("BT: %s %s header=0x%02x bytes=%u MTU=%u\n", btGattStage,
                withResponse ? "write-response" : "write-no-response", d[0], (unsigned)n, mtu);
  // These protocol packets are single ATT writes. NimBLE's writeValue() can
  // fall back to a truncated prefix when a peer rejects Prepare/Execute Write.
  // Never report delivery of a partial packet or silently change its write mode.
  if (mtu < 3 || n > (size_t)(mtu - 3)) {
    Serial.printf("BT: %s rejected: %u-byte packet requires MTU >= %u\n",
                  btGattStage, (unsigned)n, (unsigned)(n + 3));
    return false;
  }
  int status = BLE_HS_ENOTCONN;
  uint16_t errorHandle = 0;
  for (unsigned attempt = 0; attempt < 2; ++attempt) {
    if (btTransactionCancelled() || !btClientPreemptionEnabled.load(std::memory_order_acquire) ||
        !btClientConnected.load(std::memory_order_acquire)) return false;
    if (!withResponse) {
      status = ble_gattc_write_no_rsp_flat(btClient->getConnHandle(), c->getHandle(), d, n);
    } else {
      NimBLETaskData task(nullptr, 0, &errorHandle);
      status = ble_gattc_write_flat(btClient->getConnHandle(), c->getHandle(), d, n,
                                   btWriteComplete, &task);
      if (status == 0) {
        // Keep callback storage alive until ATT completes or GAP cancels it.
        // The independent host monitor requests GAP disconnect for deadline or loss of clock trust
        // or the total transaction deadline. Do not return on a local timeout:
        // the library callback still references this stack-local task.
        NimBLEUtils::taskWait(task, BLE_NPL_TIME_FOREVER);
        status = task.m_flags;
      }
      if (status == BLE_HS_EDONE) status = 0;
    }
    if (status == 0) {
      // WNR success confirms local submission only; WR success is an ATT ack.
      if (withResponse) ++btWriteAcknowledgements;
      return true;
    }
    const bool needsSecurity = status == BLE_HS_ATT_ERR(BLE_ATT_ERR_INSUFFICIENT_AUTHEN) ||
                               status == BLE_HS_ATT_ERR(BLE_ATT_ERR_INSUFFICIENT_AUTHOR) ||
                               status == BLE_HS_ATT_ERR(BLE_ATT_ERR_INSUFFICIENT_ENC);
    if (attempt == 0 && withResponse && needsSecurity && !btTransactionCancelled() &&
        btClientPreemptionEnabled.load(std::memory_order_acquire) &&
        btClientConnected.load(std::memory_order_acquire) && btClient->secureConnection()) {
      Serial.printf("BT: %s retrying full packet after securing connection\n", btGattStage);
      continue;
    }
    break;
  }
  Serial.printf("BT: %s GATT %s failed (UUID=%s status=%d/0x%04x error-handle=0x%04x)\n",
                btGattStage, withResponse ? "write-response" : "write-no-response",
                c->getUUID().toString().c_str(), status, (unsigned)status, errorHandle);
  if (status >= 0x100 && status < 0x200)
    Serial.printf("BT: ATT error=0x%02x\n", status - 0x100);
  return false;
}

static void disconnectGShock(void) {
  cancelBtResponse();
  btClientPreemptionEnabled.store(false, std::memory_order_release);
  if (btClient && !btClientQuiescent()) {
    if (!requestBtClientTermination())
      Serial.println("BT: client termination request failed; retaining client");
    const uint32_t started = millis();
    while (!btClientQuiescent() && millis() - started < 2000UL) {
      // A late onConnect after cancelConnect resets the request guard, allowing
      // this wait to terminate the established connection safely as well.
      requestBtClientTermination();
      delay(5);
    }
    if (!btClientQuiescent())
      Serial.println("BT: teardown barrier timeout; reconnect remains blocked");
  }
  // These aliases are owned by loop(); clearing them never destroys NimBLE's
  // retained service objects. Cache destruction happens only on a later safe
  // reconnect, after the host barrier and all synchronous GATT calls returned.
  btService = nullptr;
  btSpRequest = nullptr;
  btSpData = nullptr;
  btSetChar = nullptr;
  btBleBusy = !btClientQuiescent();
  if (!btBleBusy) btTransactionActive.store(false, std::memory_order_release);
  serviceBtClientQuarantine();
  applicationProgressCheckpoint();
}

static bool validateBtCharacteristic(const char *label, const char *uuid,
                                     NimBLERemoteCharacteristic *c, bool withResponse) {
  if (!c) {
    Serial.printf("BT: %s missing (UUID=%s)\n", label, uuid);
    return false;
  }
  String properties;
  if (c->canWriteNoResponse()) properties += "write-no-response ";
  if (c->canWrite()) properties += "write-response ";
  if (c->canNotify()) properties += "notify ";
  if (c->canIndicate()) properties += "indicate ";
  properties.trim();
  if (!properties.length()) properties = "no supported properties";
  Serial.printf("BT: %s found [%s]\n", label, properties.c_str());
  if (withResponse ? !c->canWrite() : !c->canWriteNoResponse()) {
    Serial.printf("BT: %s wrong properties (requires %s; UUID=%s)\n", label,
                  withResponse ? "write-response" : "write-no-response", uuid);
    return false;
  }
  return true;
}

static bool connectGShock(int protocol) {
  if (btLastWatchAddress.length() != 17 || !btBleInitialized || bleOperationCancelled()) return false;
  if (btClient && !btClientQuiescent()) {
    disconnectGShock();
    if (!btClientQuiescent()) return false;
  }
  if (!bluetoothMemoryAvailable()) {
    Serial.println("BT: connection deferred: insufficient internal memory");
    return false;
  }
  applicationProgressCheckpoint();
  btTransactionStartedMillis.store(millis(), std::memory_order_relaxed);
  btTransactionActive.store(true, std::memory_order_release);
  btBleBusy = true;
  setBluetoothPhase("Connecting");
  if (!btClient) {
    btClient = NimBLEDevice::createClient();
    if (!btClient) {
      btBleBusy = false;
      btTransactionActive.store(false, std::memory_order_release);
      Serial.println("BT: NimBLE client allocation failed");
      return false;
    }
    btClient->setClientCallbacks(&gshockClientCallbacks, false);
    btClient->setSelfDelete(false, false);
    btClient->setConnectTimeout(5000);
    btClient->setConnectRetries(0); // Cancellation and each attempt stay bounded.
  }
  if (!initializeBtClientBarrier()) {
    btBleBusy = false;
    btTransactionActive.store(false, std::memory_order_release);
    return false;
  }
  if (protocol == BT_PROTOCOL_BX5600_MIP && !NimBLEDevice::setMTU(517)) {
    Serial.println("BT: preferred ATT MTU setup failed");
    disconnectGShock();
    return false;
  }
  btClientTerminationRequested.store(false, std::memory_order_release);
  ++btConnectionAttempts;
  btClientQuiescentReady.store(false, std::memory_order_release);
  btClientConnectionPending.store(true, std::memory_order_release);
  NimBLEAddress peer(std::string(btLastWatchAddress.c_str()), btLastWatchAddressType);
  // Start asynchronously so deadline/clock loss can cancel promptly.
  // deleteAttributes=true refreshes the cache only after the previous barrier.
  if (!btClient->connect(peer, true, true)) {
    btClientConnectionPending.store(false, std::memory_order_release);
    btClientQuiescentReady.store(true, std::memory_order_release);
    Serial.println("BT: connection could not be started");
    disconnectGShock();
    return false;
  }
  btClientPreemptionEnabled.store(true, std::memory_order_release);
  if (ble_npl_callout_reset(&btClientPreemptionCallout, ble_npl_time_ms_to_ticks32(20)) != BLE_NPL_OK) {
    Serial.println("BT: transaction deadline monitor could not start; connection cancelled");
    disconnectGShock();
    return false;
  }
  const uint32_t started = millis();
  while (btClientConnectionPending.load(std::memory_order_acquire) &&
         !btTransactionCancelled() && millis() - started < 5500UL) delay(5);
  if (btTransactionCancelled() || !btClientPreemptionEnabled.load(std::memory_order_acquire) ||
      !btClientConnected.load(std::memory_order_acquire)) {
    Serial.println("BT: connection cancelled, timed out or failed");
    disconnectGShock();
    return false;
  }
  if (protocol == BT_PROTOCOL_BX5600_MIP) {
    // onConnect may precede asynchronous MTU completion. Largest SP packet is
    // 133 bytes and must fit in a single Write Request (MTU >= 136).
    const uint32_t mtuStarted = millis();
    while (btClient->getMTU() < CasioBxProtocol::kMinimumMtu &&
           !btTransactionCancelled() && btClientConnected.load(std::memory_order_acquire) &&
           btClientPreemptionEnabled.load(std::memory_order_acquire) &&
           millis() - mtuStarted < 2000UL) delay(5);
    Serial.printf("BT: GW-BX5600 ATT MTU=%u (required >= %u)\n",
                  btClient->getMTU(), (unsigned)CasioBxProtocol::kMinimumMtu);
    if (btClient->getMTU() < CasioBxProtocol::kMinimumMtu) {
      Serial.println("BT: MTU exchange insufficient; no SP handshake sent");
      disconnectGShock();
      return false;
    }
  }
  btService = btClient->getService(NimBLEUUID(CASIO_WATCH_FEATURES_SERVICE));
  if (btTransactionCancelled() || !btService) {
    Serial.println("BT: Casio feature service missing or discovery cancelled");
    disconnectGShock();
    return false;
  }
  btSetChar = btService->getCharacteristic(NimBLEUUID(CASIO_SET_CHAR));
  bool valid = validateBtCharacteristic("TIME", CASIO_SET_CHAR, btSetChar, true);
  // Only the BX5600 MIP path needs SP request/response characteristics.
  if (protocol == BT_PROTOCOL_BX5600_MIP && !btTransactionCancelled()) {
    btSpRequest = btService->getCharacteristic(NimBLEUUID(CASIO_SP_REQUEST_CHAR));
    if (!btTransactionCancelled())
      btSpData = btService->getCharacteristic(NimBLEUUID(CASIO_SP_DATA_CHAR));
    const bool requestValid = validateBtCharacteristic("SP_REQUEST", CASIO_SP_REQUEST_CHAR, btSpRequest, false);
    const bool dataValid = validateBtCharacteristic("SP_DATA", CASIO_SP_DATA_CHAR, btSpData, true);
    valid = valid && requestValid && dataValid;
    // Subscribe before sending any request so a fast response cannot be lost.
    bool subscribed = false;
    if (valid && !btTransactionCancelled()) {
      if (btSpData->canNotify()) subscribed = btSpData->subscribe(true, gshockNotifyCallback, true);
      else if (btSpData->canIndicate()) subscribed = btSpData->subscribe(false, gshockNotifyCallback, true);
      if (!subscribed) Serial.println("BT: SP_DATA notification/indication subscription failed");
    }
    valid = valid && subscribed;
  }
  if (!valid || btTransactionCancelled() || !btClientPreemptionEnabled.load(std::memory_order_acquire) ||
      !btClientConnected.load(std::memory_order_acquire)) {
    disconnectGShock();
    return false;
  }
  Serial.println("BT: protocol characteristics OK");
  setBluetoothPhase("Syncing");
  return true;
}

static size_t bxRequest(const uint8_t *req, size_t reqLen, uint8_t header,
                        size_t minimum, uint8_t *out, size_t maxOut) {
  if (!out || maxOut < minimum || btTransactionCancelled()) return 0;
  prepareBtResponse(header);
  if (!writeBt(btSpRequest, req, reqLen, false)) {
    cancelBtResponse();
    ++btResponseErrors;
    return 0;
  }
  if (!waitBt(minimum)) return 0;
  // Do not accept a valid-looking prefix of a response that would be truncated.
  portENTER_CRITICAL(&btResponseMux);
  const size_t received = btResponseLength;
  portEXIT_CRITICAL(&btResponseMux);
  if (received > maxOut || btTransactionCancelled()) {
    ++btResponseErrors;
    return 0;
  }
  size_t len = copyBt(out, maxOut);
  Serial.printf("BT: %s response header=0x%02x bytes=%u\n", btGattStage,
                len ? out[0] : 0, (unsigned)len);
  if (len < minimum || out[0] != header) {
    ++btResponseErrors;
    return 0;
  }
  return len;
}

static bool requestBluetoothBasicSettings(NimBLERemoteCharacteristic *request,
                                          uint8_t *reply, size_t &size) {
  size = 0;
  if (!request || !reply || btTransactionCancelled() ||
      !btClientPreemptionEnabled.load(std::memory_order_acquire) ||
      !btClientConnected.load(std::memory_order_acquire)) return false;
  const uint8_t command[] = {CasioWatchSettings::kBasicHeader};
  prepareBtResponse(command[0]);
  if (!writeBt(request, command, sizeof(command), request->canWrite())) {
    cancelBtResponse(); return false;
  }
  const uint32_t timeout=optionalReplyTimeoutMs(BT_REQUEST_TIMEOUT_MS);
  if (!timeout || !waitBt(CasioWatchSettings::kBxBasicSize,timeout)) return false;
  // Both observed layouts are complete packets. Reject excess bytes before
  // copying so a truncated prefix can never pass as a valid settings reply.
  portENTER_CRITICAL(&btResponseMux);
  const size_t received = btResponseLength;
  const bool overflow = btResponseOverflow;
  portEXIT_CRITICAL(&btResponseMux);
  if (overflow || !CasioWatchSettings::validBasicSize(received) ||
      btTransactionCancelled() ||
      !btClientPreemptionEnabled.load(std::memory_order_acquire) ||
      !btClientConnected.load(std::memory_order_acquire)) return false;
  size = copyBt(reply, BT_RESPONSE_CAPACITY);
  Serial.printf("BT: %s response header=0x%02x bytes=%u\n", btGattStage,
                size ? reply[0] : 0, (unsigned)size);
  return size == received && reply[0] == command[0];
}

static bool readBluetoothWatchBattery(void) {
  if (btTransactionRemainingMs()<20000) {
    btPendingBatteryStatus="Battery read skipped: reserving required handshake/time budget";
    return false;
  }
  String name = btLastWatchName.length() ? btLastWatchName :
                btPairModeActive ? String("") : btProfileName[btActiveProfile];
  name.toUpperCase();
  if (btActiveProtocol != BT_PROTOCOL_BX5600_MIP || name.indexOf("GW-BX5600") < 0 ||
      btLastWatchAddress.length() != 17) {
    btPendingBatteryStatus = "Unavailable: battery reading supports identified GW-BX5600 watches";
    return false;
  }
  const auto ready = []() {
    return !btTransactionCancelled() &&
           btClientPreemptionEnabled.load(std::memory_order_acquire) &&
           btClientConnected.load(std::memory_order_acquire);
  };
  const auto failed = [](const char *reason) {
    btPendingBatteryStatus = reason;
    Serial.printf("BT: battery read unavailable: %s\n", reason);
    return false;
  };
  btGattStage = "BX battery discovery";
  if (!ready() || !btService || !btSetChar)
    return failed("Watch disconnected or shutdown cancelled the battery read");
  auto request = btService->getCharacteristic(NimBLEUUID(CASIO_BASIC_REQUEST_CHAR));
  if (!ready()) return failed("Watch disconnected or shutdown cancelled the battery read");
  if (!request || !request->canWriteNoResponse())
    return failed("Watch-condition request characteristic unavailable");
  btGattStage = "BX battery subscription";
  bool subscribed = false;
  if (btSetChar->canNotify()) subscribed = btSetChar->subscribe(true, gshockNotifyCallback, true);
  else if (btSetChar->canIndicate()) subscribed = btSetChar->subscribe(false, gshockNotifyCallback, true);
  if (!ready()) return failed("Watch disconnected or shutdown cancelled the battery read");
  if (!subscribed) return failed("Watch-condition notification subscription rejected");
  const uint8_t command[] = {CasioWatchBattery::kHeader};
  btGattStage = "BX battery request";
  prepareBtResponse(command[0]);
  // Captures use GET with a Write Command, never an ATT Write Request.
  if (!writeBt(request, command, sizeof(command), false)) {
    cancelBtResponse();
    return failed("Watch-condition request could not be sent");
  }
  if (!waitBt(CasioWatchBattery::kBxResponseSize, CasioWatchBattery::kReplyTimeoutMs))
    return failed("No complete battery reply (timeout, disconnect or shutdown cancellation)");
  portENTER_CRITICAL(&btResponseMux);
  const size_t received = btResponseLength;
  const bool overflow = btResponseOverflow;
  portEXIT_CRITICAL(&btResponseMux);
  uint8_t reply[CasioWatchBattery::kBxResponseSize], percent = 0;
  if (overflow || received != sizeof(reply) || !ready() ||
      copyBt(reply, sizeof(reply)) != received ||
      !CasioWatchBattery::decodeBx(reply, received, percent))
    return failed("Invalid or incomplete watch-condition reply");
  btPendingBattery.available = true;
  btPendingBattery.percent = percent;
  btPendingBattery.sampledUtc = time(nullptr);
  strlcpy(btPendingBattery.address, btLastWatchAddress.c_str(), sizeof(btPendingBattery.address));
  btPendingBatteryStatus = "Read during sync";
  Serial.printf("BT: Watch %u battery estimate %u%% (raw=%u)\n",
                (unsigned)btActiveProfile + 1, percent, reply[1]);
  return true;
}

static void commitBluetoothBattery(void) {
  auto &reading = btBatteryReadings[btActiveProfile];
  // A replacement becomes bound only after TIME succeeds. Do not attach an
  // old watch's reading to a newly paired device when its battery read failed.
  if (btActiveProtocol != BT_PROTOCOL_BX5600_MIP ||
      !reading.matches(btProfileAddress[btActiveProfile].c_str())) reading = {};
  if (btPendingBattery.matches(btProfileAddress[btActiveProfile].c_str()) &&
      btActiveProtocol == BT_PROTOCOL_BX5600_MIP) reading = btPendingBattery;
  btBatteryStatuses[btActiveProfile] = btPendingBatteryStatus;
}

static bool applyBluetoothWatchFont(void) {
  const uint8_t mode = btFontMode[btActiveProfile];
  if (!mode) { btFontLastStatus = "No font override requested"; return true; }
  if (btTransactionRemainingMs()<15000) {
    btFontLastStatus="Font skipped: reserving final TIME write budget";
    return false;
  }
  String name = btLastWatchName.length() ? btLastWatchName :
                btPairModeActive ? String("") : btProfileName[btActiveProfile];
  name.toUpperCase();
  if (name.indexOf("GW-BX5600") < 0 || !btService || !btSetChar) {
    btFontLastStatus = "Font skipped: a GW-BX5600 must be identified";
    Serial.println(btFontLastStatus);
    return false;
  }
  const auto ready = []() {
    return !btTransactionCancelled() &&
           btClientPreemptionEnabled.load(std::memory_order_acquire) &&
           btClientConnected.load(std::memory_order_acquire);
  };
  const auto failed = [](const char *reason) {
    btFontLastStatus = String("Font update failed at ") + btGattStage + ": " + reason;
    Serial.println(btFontLastStatus);
    return false;
  };
  btGattStage = "BX font discovery";
  if (!ready()) return failed("watch disconnected or shutdown cancelled the operation");
  auto request = btService->getCharacteristic(NimBLEUUID(CASIO_BASIC_REQUEST_CHAR));
  if (!ready()) return failed("watch disconnected or shutdown cancelled the operation");
  if (!request || (!request->canWrite() && !request->canWriteNoResponse()))
    return failed("basic-settings request characteristic unavailable");
  btGattStage = "BX font subscription";
  bool subscribed = false;
  if (btSetChar->canNotify()) subscribed = btSetChar->subscribe(true, gshockNotifyCallback, true);
  else if (btSetChar->canIndicate()) subscribed = btSetChar->subscribe(false, gshockNotifyCallback, true);
  if (!ready()) return failed("watch disconnected or shutdown cancelled the operation");
  if (!subscribed) return failed("settings notification subscription rejected");
  uint8_t reply[BT_RESPONSE_CAPACITY], packet[CasioWatchSettings::kBasicSize];
  size_t size = 0;
  btGattStage = "BX font read settings";
  if (!requestBluetoothBasicSettings(request, reply, size) ||
      !CasioWatchSettings::buildFont(reply, size, mode, packet, sizeof(packet)))
    return failed("missing, incomplete or unsupported settings reply");
  if (memcmp(reply, packet, size) != 0) {
    const size_t writtenSize = size;
    btGattStage = "BX font write settings";
    if (!writeBt(btSetChar, packet, writtenSize, true))
      return failed("settings write was not acknowledged");
    btGattStage = "BX font readback";
    if (!requestBluetoothBasicSettings(request, reply, size) ||
        size != writtenSize || memcmp(reply, packet, writtenSize) != 0)
      return failed("settings readback did not match the requested font packet");
  }
  btFontLastStatus = String("Watch ") + (btActiveProfile + 1) + ": " +
                     (mode == 2 ? "Classic" : "Standard (new)") +
                     " font confirmed by settings readback; display unverified";
  Serial.println(btFontLastStatus);
  return true;
}

static bool readWatchFeature(NimBLERemoteCharacteristic *request,uint8_t header,
                             uint8_t *reply,size_t &size) {
  size=0;
  const uint32_t timeout=optionalReplyTimeoutMs();
  if (!request || !reply || !timeout || btTransactionCancelled()) return false;
  prepareBtResponse(header);
  if (!writeBt(request,&header,1,false)) { cancelBtResponse(); return false; }
  const size_t minimum=header==CasioWatchFeatures::kFirstAlarmHeader?5:
                       header==CasioWatchFeatures::kOtherAlarmsHeader?17:
                       header==CasioWatchFeatures::kTimerHeader?6:
                       header==CasioWatchFeatures::kBasicHeader?12:15;
  if (!waitBt(minimum,timeout)) return false;
  portENTER_CRITICAL(&btResponseMux);
  const size_t received=btResponseLength; const bool overflow=btResponseOverflow;
  portEXIT_CRITICAL(&btResponseMux);
  if (overflow || received>CasioWatchFeatures::kMaxPacketSize || btTransactionCancelled()) return false;
  size=copyBt(reply,CasioWatchFeatures::kMaxPacketSize);
  return size==received && size>=minimum && reply[0]==header;
}
static bool featureReplyMatches(uint8_t header,const uint8_t *reply,size_t size,
                                const CasioWatchFeatures::Caps &caps,const CasioWatchFeatures::Desired &d) {
  switch (header) {
    case CasioWatchFeatures::kFirstAlarmHeader: return CasioWatchFeatures::firstAlarmMatches(reply,size,d);
    case CasioWatchFeatures::kOtherAlarmsHeader: return CasioWatchFeatures::otherAlarmsMatch(reply,size,caps.alarmCount,d);
    case CasioWatchFeatures::kTimerHeader: return CasioWatchFeatures::timerMatches(reply,size,d);
    case CasioWatchFeatures::kBasicHeader: return CasioWatchFeatures::basicMatches(reply,size,caps.basicMask,d);
    case CasioWatchFeatures::kAutoAdjustHeader: return CasioWatchFeatures::autoAdjustMatches(reply,size,d);
    default: return false;
  }
}
static bool mergeFeatureReply(uint8_t header,const uint8_t *reply,size_t size,
                              const CasioWatchFeatures::Caps &caps,const CasioWatchFeatures::Desired &d,uint8_t *packet) {
  switch (header) {
    case CasioWatchFeatures::kFirstAlarmHeader: return CasioWatchFeatures::mergeFirstAlarm(reply,size,d,packet,CasioWatchFeatures::kMaxPacketSize);
    case CasioWatchFeatures::kOtherAlarmsHeader: return CasioWatchFeatures::mergeOtherAlarms(reply,size,caps.alarmCount,d,packet,CasioWatchFeatures::kMaxPacketSize);
    case CasioWatchFeatures::kTimerHeader: return CasioWatchFeatures::mergeTimer(reply,size,d,packet,CasioWatchFeatures::kMaxPacketSize);
    case CasioWatchFeatures::kBasicHeader: return CasioWatchFeatures::mergeBasic(reply,size,caps.basicMask,d,packet,CasioWatchFeatures::kMaxPacketSize);
    case CasioWatchFeatures::kAutoAdjustHeader: return CasioWatchFeatures::mergeAutoAdjust(reply,size,d,packet,CasioWatchFeatures::kMaxPacketSize);
    default: return false;
  }
}
static void applyBluetoothWatchFeatures(void) {
  const int profile=btActiveProfile;
  if (profile < 0 || profile >= BT_WATCH_PROFILE_COUNT) return;
  const auto &desired=btFeatureDesired[profile];
  if (!desired.enabled) { btFeatureStatus[profile]="Off: time synchronization only"; return; }
  if (btFeatureBoundProtocol[profile]!=btActiveProtocol ||
      !btLastWatchAddress.equalsIgnoreCase(btFeatureBoundAddress[profile])) {
    btFeatureStatus[profile]="Skipped: choices belong to another watch binding"; return;
  }
  const String &name=btLastWatchName.length()?btLastWatchName:btProfileName[profile];
  const auto caps=CasioWatchFeatures::capabilities(name.c_str(),name.length());
  if (!CasioWatchFeatures::validDesired(desired) ||
      (desired.alarmsEnabled && caps.alarmCount!=CasioWatchFeatures::kAlarmCount) ||
      (desired.hourlyChime>=0 && !caps.hourlyChime) || (desired.basicMask & ~caps.basicMask) ||
      (desired.timerEnabled && (!caps.timer || desired.timerSeconds>caps.timerMaxSeconds)) ||
      (desired.autoAdjustEnabled && !caps.autoAdjust)) {
    btFeatureStatus[profile]="Skipped: model does not support the saved feature selection"; return;
  }
  const bool selected[]={desired.alarmsEnabled || desired.hourlyChime>=0,desired.alarmsEnabled,
                         desired.timerEnabled,desired.basicMask!=0,desired.autoAdjustEnabled};
  const uint8_t headers[]={CasioWatchFeatures::kFirstAlarmHeader,CasioWatchFeatures::kOtherAlarmsHeader,
      CasioWatchFeatures::kTimerHeader,CasioWatchFeatures::kBasicHeader,CasioWatchFeatures::kAutoAdjustHeader};
  unsigned requested=0; for (bool enabled:selected) if (enabled) ++requested;
  if (!requested) { btFeatureStatus[profile]="No optional feature changes selected"; return; }
  // Admit optional groups only while an explicit reserve remains for font and
  // TIME. A hung ATT operation is cancelled by the independent host deadline;
  // no stack-local callback storage is abandoned to pretend TIME succeeded.
  const uint32_t reserve=btFontMode[profile]?15000:5000;
  if (!btService || !btSetChar || btTransactionRemainingMs()<reserve+6500) {
    btFeatureStatus[profile]="Deferred: reserving final TIME write budget"; return;
  }
  auto request=btService->getCharacteristic(NimBLEUUID(CASIO_BASIC_REQUEST_CHAR));
  if (!request || !request->canWriteNoResponse() || btTransactionCancelled()) {
    btFeatureStatus[profile]="Optional settings unavailable: read-request characteristic missing"; return;
  }
  bool subscribed=false;
  if (btSetChar->canNotify()) subscribed=btSetChar->subscribe(true,gshockNotifyCallback,true);
  else if (btSetChar->canIndicate()) subscribed=btSetChar->subscribe(false,gshockNotifyCallback,true);
  if (!subscribed || btTransactionCancelled()) {
    btFeatureStatus[profile]="Optional settings unavailable: notifications not subscribed"; return;
  }
  unsigned confirmed=0,failed=0,deferred=0;
  for (size_t group=0;group<sizeof(headers);++group) {
    if (!selected[group]) continue;
    if (btTransactionCancelled() || btTransactionRemainingMs()<reserve+6500) { ++deferred; continue; }
    uint8_t reply[CasioWatchFeatures::kMaxPacketSize], packet[CasioWatchFeatures::kMaxPacketSize];
    size_t size=0;
    btGattStage="watch features read";
    if (!readWatchFeature(request,headers[group],reply,size) ||
        !mergeFeatureReply(headers[group],reply,size,caps,desired,packet)) {
      ++failed; Serial.printf("BT features: header0x%02x missing or unsupported reply; no write\n",headers[group]); continue;
    }
    if (!featureReplyMatches(headers[group],reply,size,caps,desired)) {
      // Recheck before each ATT submission/readback, since preceding work may
      // have consumed the reserve. Keep all unknown watch bytes untouched.
      if (btTransactionRemainingMs()<reserve+4000) { ++deferred; continue; }
      btGattStage="watch features write";
      if (!writeBt(btSetChar,packet,size,true)) { ++failed; continue; }
      if (btTransactionRemainingMs()<reserve+1500) { ++deferred; continue; }
      btGattStage="watch features readback";
      size_t readbackSize=0;
      if (!readWatchFeature(request,headers[group],reply,readbackSize) || readbackSize!=size ||
          !featureReplyMatches(headers[group],reply,readbackSize,caps,desired)) {
        ++failed; Serial.printf("BT features: header0x%02x readback failed; TIME remains separate\n",headers[group]); continue;
      }
    }
    ++confirmed;
  }
  btFeatureStatus[profile]=confirmed==requested?"Requested settings confirmed by watch readback; display unverified":
    failed?"Some settings failed or were unconfirmed; time result is separate":
    confirmed?"Some settings confirmed; remaining changes deferred by time budget":
              "Deferred: reserving final TIME write budget";
  Serial.printf("BT features: Watch%u confirmed%u failed%u deferred%u of%u groups\n",
                profile+1,confirmed,failed,deferred,requested);
}

bool performGShockBX5600Sync(void) {
  if (!connectGShock(BT_PROTOCOL_BX5600_MIP)) return false;
  // The manual D-button captures read condition before the SP handshake.
  // A battery failure is optional; the required time handshake still runs.
  readBluetoothWatchBattery();
  uint8_t r[BT_RESPONSE_CAPACITY];
  uint8_t cities[CasioBxProtocol::kCitiesSize];
  uint8_t settings[CasioBxProtocol::kSettingsWriteSize];
  uint8_t dst[CasioBxProtocol::kDstWriteSize];
  bool ok = false;

  do {
    btGattStage = "BX step 1 settings";
    const uint8_t req1[] = {0x05,0x1D,0x00,0x1D,0x00,0x24,0x00,0x24,0x01,0x24,0x02};
    size_t n1 = bxRequest(req1, sizeof(req1), 0x05, 101, r, sizeof(r));
    if (!n1) break;
    if (!CasioBxProtocol::splitSettings(r, n1, settings, sizeof(settings), cities, sizeof(cities))) {
      Serial.println("BT: BX step 1 malformed settings/city records");
      ++btResponseErrors;
      break;
    }
    // Send only the two 0x1D records; save the three 0x24 city records for step 2.
    if (!writeBt(btSpData, settings, sizeof(settings), true)) break;

    btGattStage = "BX step 2 DST/cities";
    const uint8_t req2[] = {0x03,0x1E,0x00,0x1E,0x00,0x1E,0x00};
    size_t n2 = bxRequest(req2, sizeof(req2), 0x03, 28, r, sizeof(r));
    if (!n2) break;
    if (!CasioBxProtocol::buildDst(r, n2, cities, sizeof(cities), dst, sizeof(dst))) {
      Serial.println("BT: BX step 2 malformed DST/city records");
      ++btResponseErrors;
      break;
    }
    if (!writeBt(btSpData, dst, sizeof(dst), true)) break;

    btGattStage = "BX step 3 alarms";
    uint8_t req3[13] = {0x06};
    for (int i = 0; i < 6; ++i) {
      int idx = (i / 2) + ((i % 2) ? 6 : 0);
      req3[1 + i * 2] = 0x1F;
      req3[2 + i * 2] = (uint8_t)idx;
    }
    size_t n3 = bxRequest(req3, sizeof(req3), 0x06, 133, r, sizeof(r));
    if (!n3) break;
    if (!CasioBxProtocol::validAlarms(r, n3)) {
      Serial.println("BT: BX step 3 malformed alarm records");
      ++btResponseErrors;
      break;
    }
    if (!writeBt(btSpData, r, n3, true)) break;

    // A watch-triggered time session can close immediately after TIME is
    // acknowledged. Apply optional settings first; a font failure alone must
    // not prevent a time attempt. Sample time only after this optional work.
    applyBluetoothWatchFeatures();
    applyBluetoothWatchFont();
    if (!clockTrusted() || btTransactionCancelled()) break;
    struct timeval tv;
    gettimeofday(&tv, nullptr);
    time_t epoch = tv.tv_sec;
    struct tm local;
    bluetoothLocalTime(epoch, local);
    int year = local.tm_year + 1900;
    uint8_t tc[11] = {
      0x09,(uint8_t)(year&255),(uint8_t)((year>>8)&255),
      (uint8_t)(local.tm_mon+1),(uint8_t)local.tm_mday,
      (uint8_t)local.tm_hour,(uint8_t)local.tm_min,(uint8_t)local.tm_sec,
      (uint8_t)(local.tm_wday==0?7:local.tm_wday),
      (uint8_t)((tv.tv_usec/1000UL*256UL)/1000UL),0x01
    };
    btGattStage = "BX step 4 TIME";
    if (!writeBt(btSetChar, tc, sizeof(tc), true)) break;

    ok = true;
    btDeliveryEvidence = "ATT write acknowledged; watch display unverified";
    Serial.printf("BT: GW-BX5600 time command delivered %04d-%02d-%02d %02d:%02d:%02d\n",
                  year, local.tm_mon+1, local.tm_mday,
                  local.tm_hour, local.tm_min, local.tm_sec);
  } while (false);

  disconnectGShock();
  btGattStage = "idle";
  return ok;
}

bool performCasioStandardTimeSync(int protocol) {
  if (protocol != BT_PROTOCOL_STANDARD && protocol != BT_PROTOCOL_ANALOGUE) return false;
  if (!connectGShock(protocol)) return false;
  applyBluetoothWatchFeatures();
  if (!clockTrusted() || btTransactionCancelled()) {
    disconnectGShock();
    btGattStage = "idle";
    return false;
  }
  struct timeval tv;
  gettimeofday(&tv, nullptr);
  time_t epoch = tv.tv_sec;
  struct tm local;
  bluetoothLocalTime(epoch, local);
  int year = local.tm_year + 1900;
  uint8_t tc[CasioStandardProtocol::PacketSize];
  if (!CasioStandardProtocol::encode(local, tv.tv_usec, tc)) {
    Serial.println("BT: invalid civil time sample; TIME write cancelled");
    disconnectGShock();
    return false;
  }
  btGattStage = "Casio TIME";
  bool ok = writeBt(btSetChar, tc, sizeof(tc), true);
  if (ok) btDeliveryEvidence = "ATT write acknowledged; watch display unverified";
  if (ok) Serial.printf("BT: %s time write acknowledged, %04d-%02d-%02d %02d:%02d:%02d\n",
                        btProtocolName(protocol), year, local.tm_mon + 1, local.tm_mday,
                        local.tm_hour, local.tm_min, local.tm_sec);
  disconnectGShock();
  btGattStage = "idle";
  return ok;
}

bool attemptBluetoothSync(void) {
  btPendingBattery = {};
  btPendingBatteryStatus = btActiveProtocol == BT_PROTOCOL_BX5600_MIP
                            ? "Not read during this sync"
                            : "Unavailable: selected protocol has no validated battery reading";
  btFontLastStatus = btFontMode[btActiveProfile] && btActiveProtocol != BT_PROTOCOL_BX5600_MIP
                    ? "Font skipped: selected protocol does not support this option"
                    : "No font override requested";
  if (!clockTrusted()) {
    btLastSyncStatus = "Blocked: NTP clock not trusted; awaiting a confirmed SNTP update";
    return false;
  }
  if (bleOperationCancelled() || !btControllerStarted) {
    btLastSyncStatus = "Deferred: Bluetooth shutdown/recovery pending";
    return false;
  }
  const int protocol = btActiveProtocol;
  Serial.printf("BT: connecting with %s time-only protocol\n", btProtocolName(protocol));
  bool ok = (protocol == BT_PROTOCOL_BX5600_MIP)
              ? performGShockBX5600Sync() : performCasioStandardTimeSync(protocol);
  if (ok) {
    time_t syncEpoch=time(nullptr); struct tm syncLocal; bluetoothLocalTime(syncEpoch,syncLocal);
    bool bindingChanged = false;
    btSuccessYear[protocol] = syncLocal.tm_year + 1900;
    btSuccessYday[protocol] = syncLocal.tm_yday;
    btProfileSuccessYear[btActiveProfile] = syncLocal.tm_year + 1900;
    btProfileSuccessYday[btActiveProfile] = syncLocal.tm_yday;
    if (btPairModeActive) {
      bindingChanged = btProfileAddress[btActiveProfile] != btLastWatchAddress ||
                       btProfileName[btActiveProfile] != btLastWatchName ||
                       btProfileProtocol[btActiveProfile] != btActiveProtocol;
      btProfileAddress[btActiveProfile] = btLastWatchAddress;
      btProfileName[btActiveProfile] = btLastWatchName;
      btProfileProtocol[btActiveProfile] = btActiveProtocol;
    }
    commitBluetoothBattery();
    btSyncDayComplete = true;
    if (protocol == BT_PROTOCOL_BX5600_MIP) {
      btSyncLastYear = btSuccessYear[protocol];
      btSyncLastYday = btSuccessYday[protocol];
    }
    char d[24]; strftime(d,sizeof(d),"%Y-%m-%d %H:%M:%S",&syncLocal);
    btLastSyncDate = d;
    btLastSyncStatus = String("Watch ") + (btActiveProfile+1) + ": " + btProtocolName(protocol) + " - time write delivered (watch unverified)";
    btLastSyncEpoch.store((uint32_t)syncEpoch, std::memory_order_release);
    btLastOutcomeSuccessful.store(true, std::memory_order_release);
    btProtocolLastSyncEpoch[protocol] = (uint32_t)syncEpoch;
    btProfileLastSyncEpoch[btActiveProfile] = (uint32_t)syncEpoch;
    btProfileLastSyncProtocol[btActiveProfile] = btActiveProtocol;
    btProfileLastSyncAddress[btActiveProfile] = btLastWatchAddress;
    btRecentSyncs.bind(btActiveProfile, btProfileAddress[btActiveProfile].c_str(), btProfileProtocol[btActiveProfile]);
    btRecentSyncs.record(btActiveProfile, btLastWatchAddress.c_str(), btActiveProtocol,
                        static_cast<uint32_t>(syncEpoch), true);
    // Binding changes remain required configuration; routine history is not.
    if (bindingChanged) saveConfig();
    saveBluetoothHistoryNow(syncEpoch);
  } else {
    btLastSyncStatus = String(btProtocolName(protocol)) + " - sync attempt failed";
    btLastOutcomeSuccessful.store(false, std::memory_order_release);
    if (!bleOperationCancelled()) {
      // Shutdown deferrals and an unconfirmed replacement watch are not failures
      // belonging to the bound watch. An untrusted timestamp is shown unknown.
      const uint32_t failedEpoch = clockTrusted() ? static_cast<uint32_t>(time(nullptr)) : 0;
      btRecentSyncs.bind(btActiveProfile, btProfileAddress[btActiveProfile].c_str(), btProfileProtocol[btActiveProfile]);
      btRecentSyncs.record(btActiveProfile, btLastWatchAddress.c_str(), btActiveProtocol, failedEpoch, false);
    }
  }
  return ok;
}

static bool bluetoothControllerNeeded(void) {
  if (btAlwaysWaitEnabled || btPairRequested || btManualSyncRequested ||
      btWindowActive || btBleBusy || btPairModeActive) return true;
  time_t epoch = time(nullptr); struct tm local; bluetoothLocalTime(epoch, local);
  for (int i = 0; i < BT_SYNC_SLOT_COUNT; ++i) {
    if (!btSyncEnabled[i] || !btMinuteInBluetoothWindow(btMinutesOfDay(local), btSyncTimes[i])) continue;
    int year, yday; btSlotOccurrenceDate(i, local, year, yday);
    if (btSlotAttemptYear[i] != year || btSlotAttemptYday[i] != yday) return true;
  }
  return false;
}

static bool shutdownIdleBluetooth(void) {
  if (!btControllerStarted) {
    btShutdownRequested.store(false, std::memory_order_release);
    completeBtShutdownProgress();
    setBluetoothPhase("Bluetooth idle power saving");
    return true;
  }
  if (!serviceBtShutdownProgress()) return false;
  if (btBleBusy || !btClientQuiescent() ||
      (btShutdownRetryMillis && (long)(millis() - btShutdownRetryMillis) < 0)) return false;
  stopBluetoothWindow();
  if (!btScanControl.quiescent()) {
    btShutdownRetryMillis = millis() + 1000;
    setBluetoothPhase("Bluetooth scan shutdown pending");
    return false;
  }
  releaseBtClientBarrier();
  const bool stopped = NimBLEDevice::isInitialized() ? NimBLEDevice::deinit(false)
                                                    : stopPartiallyInitializedBluetooth();
  const bool off = stopped && !NimBLEDevice::isInitialized() &&
                   esp_bt_controller_get_status() == ESP_BT_CONTROLLER_STATUS_IDLE;
  btBleInitialized = NimBLEDevice::isInitialized();
  if (!off) {
    btShutdownRetryMillis = millis() + 1000;
    setBluetoothPhase("Bluetooth idle shutdown failed");
    return false; // Retain ownership until the physical controller is off.
  }
  btShutdownRetryMillis = 0;
  btScanControl.releaseAfterHostStop();
  completeBtShutdownProgress();
  btControllerStarted = false;
  btShutdownRequested.store(false, std::memory_order_release);
  setBluetoothPhase("Bluetooth idle power saving");
  Serial.println("BT: host/controller OFF between listening windows");
  return true;
}

void serviceBluetoothSync(void) {
  if (btShutdownRequested.load() || (!btBleInitialized && btControllerStarted)) {
    recoverBluetoothControllerShutdown();
    return;
  }
  // Settings/explicit requests can change while a failed idle shutdown is
  // recovering. Finish that same bounded episode before admitting new work.
  if (btShutdownRecoveryActive) {
    shutdownIdleBluetooth();
    return;
  }
  if (btIdlePowerSaveEnabled && !bluetoothControllerNeeded()) {
    shutdownIdleBluetooth();
    return;
  }
  if (!btBleInitialized) initBluetoothSync();
  if (!btBleInitialized || bleOperationCancelled()) return;
  resetBluetoothDayIfNeeded();
  if (!serviceBtClientQuarantine()) {
    setBluetoothPhase("Bluetooth disconnect recovery pending");
    return;
  }
  // A previously timed-out host teardown may finish later. Only loopTask can
  // clear the quarantine, after the queued GAP barrier completes.
  if (btBleBusy && btClientQuiescent()) disconnectGShock();
  if (!btBleBusy && !bluetoothMemoryAvailable()) {
    if (!btScanControl.stop()) {
      btShutdownRequested = true;
      serviceBtShutdownProgress();
    }
    setBluetoothPhase("Bluetooth deferred: low internal memory");
    return;
  }

  if (btPairRequested && !btBleBusy) {
    stopBluetoothWindow();
    btPairRequested = false;
    btManualSyncRequested = false;
    btPairModeActive = true;
    btLastSyncStatus = String("Pairing Watch ") + (btManualProfile + 1);
    startBluetoothWindow(-1);
  } else if (btManualSyncRequested && !btBleBusy) {
    // Serialized on loopTask: stop callbacks, discard stale discovery, and
    // reopen the window. Repeated HTTP requests never delete a client.
    stopBluetoothWindow();
    btManualSyncRequested = false;
    btLastSyncStatus = "Waiting for watch";
    startBluetoothWindow(-1);
  }

  // Scheduled windows can preempt passive Always Wait, preserving the selected
  // manual profile. They cannot preempt an explicit manual/pairing window.
  if (!btBleBusy && (!btWindowActive || btPersistentWaitActive)) {
    time_t epoch=time(nullptr); struct tm local; bluetoothLocalTime(epoch,local);
    int nm = btMinutesOfDay(local);
    for (int i=0;i<BT_SYNC_SLOT_COUNT;++i) {
      if (!btMinuteInBluetoothWindow(nm, btSyncTimes[i])) {
        continue;
      }
      if (!btSyncEnabled[i]) continue;
      int occurrenceYear, occurrenceYday;
      btSlotOccurrenceDate(i, local, occurrenceYear, occurrenceYday);
      if (btSlotAttemptYear[i]==occurrenceYear && btSlotAttemptYday[i]==occurrenceYday) continue;
      // Invalid automatic slots stay retryable without repeatedly stopping
      // passive listening for a different, correctly paired watch.
      if (!bluetoothProfileBindingReady(btSyncProfile[i], btSyncProtocol[i])) {
        if (!btWindowActive) {
          btLastSyncStatus = "Pair Watch first for the scheduled profile and protocol";
          setBluetoothPhase("No watch paired");
        }
        continue;
      }
      stopBluetoothWindow();
      startBluetoothWindow(i);
      if (btWindowActive) break;
    }
  }

  if (btPersistentWaitActive && !btAlwaysWaitEnabled) stopBluetoothWindow();
  if (!btWindowActive && !btBleBusy && btAlwaysWaitEnabled &&
      btProfileAddress[btManualProfile].length() == 17 &&
      btProfileProtocol[btManualProfile] == btManualProtocol) startBluetoothWindow(-1, true);

  if (btWindowActive && !btBleBusy) {
    if (!btPersistentWaitActive && (long)(millis()-btWindowEndMillis) >= 0) {
      stopBluetoothWindow();
      btLastSyncStatus = String(btProtocolName(btActiveProtocol)) + " - no watch connection";
      setBluetoothPhase("Idle");
      return;
    }
    String discoveredName, discoveredAddress; uint8_t discoveredType = 0xFF;
    if (consumeBtDiscovery(discoveredName, discoveredAddress, discoveredType)) {
      if (!btScanControl.stop()) {
        btShutdownRequested = true;
        serviceBtShutdownProgress();
        btLastSyncStatus = "Bluetooth scan teardown pending; connection deferred";
        return;
      }
      btLastWatchName = discoveredName;
      btLastWatchAddress = discoveredAddress;
      btLastWatchAddressType = discoveredType;
      btWindowActive = false;
      bool ok = attemptBluetoothSync();
      if (bleOperationCancelled()) {
        // Preserve interrupted request state until shutdown capture.
        btWindowActive = true;
        recoverBluetoothControllerShutdown();
      } else if (!ok) {
        btLastWatchAddress = "";
        clearBtDiscovery();
        btWindowActive = true;
        setBluetoothPhase(btPairModeActive ? "Pairing" : "Waiting for watch");
      } else {
        stopBluetoothWindow();
        setBluetoothPhase("Idle");
      }
      return;
    }
    if (btScan && !bleOperationCancelled() && !btScan->isScanning()) {
      if (!btScanControl.start()) {
        if (!btScanControl.quiescent()) {
          btShutdownRequested = true;
          serviceBtShutdownProgress();
        }
        btLastSyncStatus = "Bluetooth scan start failed";
        setBluetoothPhase("Waiting for watch");
      } else if (!btPairModeActive && btSyncActiveSlot < 0) setBluetoothPhase("Scanning");
    }
  }
}


void initFilesystem(void)
{
  filesystemAvailable = LittleFS.begin(false);
  configStorageFault = !filesystemAvailable;
  if (!filesystemAvailable) {
    Serial.println("LittleFS mount failed; saved settings preserved. Setup AP provides explicit storage recovery.");
    return;
  }
  Serial.println("LittleFS Mounted Successfully");
}

static const char* configTimezoneName(const char *name)
{
  const char *zones[] = {"Asia/Tokyo", "Australia/Brisbane", "Australia/Sydney", "Asia/Shanghai",
                         "Europe/London", "America/New_York", "America/Los_Angeles", "UTC"};
  for (const char *zone : zones) if (!strcmp(name,zone)) return zone;
  return nullptr;
}


static bool validateSavedConfig(const CasioConfigRecord &candidate) {
  static_assert(BT_SYNC_SLOT_COUNT==4 && BT_WATCH_PROFILE_COUNT==4 && BT_PROTOCOL_COUNT==3,
                "Update CasioSync schema before changing saved field counts");
  if (!candidate.versioned() || candidate.count()!=CasioConfigFormat::FIELD_COUNT ||
      strlen(candidate.text(0))>32 || strlen(candidate.text(1))>63 ||
      !configTimezoneName(candidate.text(2))) return false;
  auto numeric = [&candidate](size_t index, int32_t lo, int32_t hi) {
    int32_t value; return CasioConfigRecord::signedInteger(candidate.text(index),lo,hi,value);
  };
  auto boolean = [&candidate](size_t index) { return CasioConfigRecord::boolean(candidate.text(index)); };
  if (!numeric(3,0,1)) return false;
  for (size_t i=4;i<=7;++i) if (!boolean(i)) return false;
  for (size_t i=8;i<=12;++i) if (!numeric(i,0,BT_PROTOCOL_COUNT-1)) return false;
  for (size_t i=13;i<=16;++i) if (!numeric(i,0,1439)) return false;
  for (size_t i=17;i<=21;++i) if (!numeric(i,0,BT_WATCH_PROFILE_COUNT-1)) return false;
  for (size_t i=22;i<=25;++i) {
    const char *address=candidate.text(i);
    if (!*address) continue;
    if (strlen(address)!=17) return false;
    for (size_t pos=0;pos<17;++pos) {
      const char c=address[pos];
      if (pos%3==2) { if (c!=':') return false; }
      else if (!((c>='0'&&c<='9')||(c>='A'&&c<='F')||(c>='a'&&c<='f'))) return false;
    }
  }
  for (size_t i=26;i<=29;++i) if (strlen(candidate.text(i))>=48) return false;
  if (!boolean(30)) return false;
  for (size_t i=31;i<=34;++i) if (!numeric(i,0,BT_PROTOCOL_COUNT-1)) return false;
  if (!configTimezoneName(candidate.text(35)) || !numeric(36,-720,840) || !boolean(37)) return false;
  for (size_t i=38;i<=41;++i) if (!numeric(i,0,2)) return false;
  if (!boolean(42)||!boolean(43)||!boolean(45)||!boolean(49)) return false;
  uint32_t generation;
  if (!CasioConfigRecord::unsignedInteger(candidate.text(44),generation) ||
      !numeric(46,0,1439)||!numeric(47,0,1439)||!configTimezoneName(candidate.text(48)) ||
      !CasioWifiAccessWindow::validMinutes(candidate.number(46,1080),candidate.number(47,1200))) return false;
  return true;
}

static bool configFileLayoutValid(File &file, CasioConfigRecord &candidate)
{
  const size_t size = file.size();
  if (!size || size >= sizeof(storageSerializationBuffer) ||
      file.read(reinterpret_cast<uint8_t *>(storageSerializationBuffer),size) != size) return false;
  storageSerializationBuffer[size] = '\0';
  return candidate.parse(storageSerializationBuffer,size) && validateSavedConfig(candidate);
}

static bool configStringsAvailable(const CasioConfigRecord &candidate) {
  if (!timezone_name.reserve(strlen(candidate.text(2))) ||
      !btTimezoneName.reserve(strlen(candidate.text(35))) ||
      !wifiAccessTimezone.reserve(strlen(candidate.text(48)))) return false;
  for (int i=0;i<BT_WATCH_PROFILE_COUNT;++i)
    if (!btProfileAddress[i].reserve(strlen(candidate.text(22+i))) ||
        !btProfileName[i].reserve(strlen(candidate.text(26+i)))) return false;
  return true;
}

static void configDefaults(void) {
  ssid[0]=passwd[0]='\0'; timezone_name=DEFAULT_TZ_NAME;
  wifiPowerMode=WIFI_POWER_ALWAYS_ON;
  activityLedEnabled=true; btAlwaysWaitEnabled=true; btIdlePowerSaveEnabled=false;
  btHistoryPersistEnabled=true; btHistoryGeneration=0; crashDumpEnabled=false;
  RadioCrashDumpGate::setEnabled(false);
  wifiAccessEnabled=false; wifiAccessStart=1080; wifiAccessEnd=1200;
  wifiAccessTimezone="Australia/Brisbane"; btTimezoneName=DEFAULT_BT_TIMEZONE; btTimeOffsetMinutes=0;
  btManualProtocol=BT_PROTOCOL_BX5600_MIP; btManualProfile=0;
  const int defaultTimes[]={30,390,750,1110};
  for (int i=0;i<BT_SYNC_SLOT_COUNT;++i) {
    btSyncEnabled[i]=true; btSyncTimes[i]=defaultTimes[i];
    btSyncProtocol[i]=BT_PROTOCOL_BX5600_MIP; btSyncProfile[i]=0;
  }
  for (int i=0;i<BT_WATCH_PROFILE_COUNT;++i) {
    btFontMode[i]=0; btProfileAddress[i]=""; btProfileName[i]="";
    btProfileProtocol[i]=BT_PROTOCOL_BX5600_MIP;
  }
}

void loadConfig(void) {
  CasioConfigRecord candidate;
  File file;
  if (filesystemAvailable) file=LittleFS.open(CONFIG_FILE,"r");
  const bool exists=(bool)file;
  const bool valid=exists && configFileLayoutValid(file,candidate) && configStringsAvailable(candidate);
  if (file) file.close();
  configDefaults();
  if (!valid) {
    if (exists) {
      configStorageFault=true;
      Serial.println("CasioSync config failed integrity/validation; preserved file, safe defaults and setup AP selected");
    }
    loadBluetoothHistory(); loadWatchOptions(); return;
  }
  configStorageFault=false;
  strlcpy(ssid,candidate.text(0),sizeof(ssid)); strlcpy(passwd,candidate.text(1),sizeof(passwd));
  timezone_name=configTimezoneName(candidate.text(2)); wifiPowerMode=candidate.number(3,0);
  for (int i=0;i<BT_SYNC_SLOT_COUNT;++i) {
    btSyncEnabled[i]=candidate.flag(4+i,true); btSyncProtocol[i]=candidate.number(8+i,0);
    btSyncTimes[i]=candidate.number(13+i,btSyncTimes[i]); btSyncProfile[i]=candidate.number(17+i,0);
  }
  btManualProtocol=candidate.number(12,0); btManualProfile=candidate.number(21,0);
  for (int i=0;i<BT_WATCH_PROFILE_COUNT;++i) {
    btProfileAddress[i]=candidate.text(22+i); btProfileName[i]=candidate.text(26+i);
    btProfileProtocol[i]=candidate.number(31+i,0); btFontMode[i]=candidate.number(38+i,0);
  }
  btAlwaysWaitEnabled=candidate.flag(30,true); btTimezoneName=configTimezoneName(candidate.text(35));
  btTimeOffsetMinutes=candidate.number(36,0); activityLedEnabled=candidate.flag(37,true);
  btIdlePowerSaveEnabled=candidate.flag(42,false); btHistoryPersistEnabled=candidate.flag(43,true);
  CasioConfigRecord::unsignedInteger(candidate.text(44),btHistoryGeneration);
  wifiAccessEnabled=candidate.flag(45,false); wifiAccessStart=candidate.number(46,1080);
  wifiAccessEnd=candidate.number(47,1200); wifiAccessTimezone=configTimezoneName(candidate.text(48));
  crashDumpEnabled=RadioCrashDumpGate::available() && candidate.flag(49,false);
  RadioCrashDumpGate::setEnabled(crashDumpEnabled);
  loadBluetoothHistory(); loadWatchOptions();
  Serial.printf("Loaded CRC-verified CasioSync config: SSID=%s, BT TZ=%s, WiFi mode=%s\n",
                ssid,btTimezoneName.c_str(),wifiPowerMode==WIFI_POWER_SCHEDULED?"Scheduled":"Always on");
}


static void clearBluetoothRuntimeHistory(void) {
  btLastSyncEpoch.store(0);
  btLastOutcomeSuccessful.store(false);
  btLastSyncDate = ""; btLastSyncStatus = "Never synced";
  btLastWatchName = ""; btLastWatchAddress = "";
  btFontLastStatus = "No font result retained across reboot";
  btDeliveryEvidence = "No delivery yet";
  btSyncLastYear = btSyncLastYday = -1; btSyncDayComplete = false;
  btConnectionAttempts = btWriteAcknowledgements = 0;
  btNotifications.store(0); btResponseErrors.store(0);
  for (int i=0;i<BT_PROTOCOL_COUNT;++i) {
    btSuccessYear[i] = btSuccessYday[i] = -1;
    btProtocolLastSyncEpoch[i] = 0;
  }
  for (int i=0;i<BT_WATCH_PROFILE_COUNT;++i) {
    btProfileSuccessYear[i] = btProfileSuccessYday[i] = -1;
    btProfileLastSyncEpoch[i] = 0; btProfileLastSyncProtocol[i] = 0;
    btProfileLastSyncAddress[i] = "";
    btBatteryReadings[i] = {};
    btBatteryStatuses[i] = "Not read since boot";
  }
}

static void loadBluetoothHistory(void) {
  clearBluetoothRuntimeHistory();
  btHistorySavedDay = btHistoryAttemptDay = -1;
  btHistorySavedEpoch = 0; btHistorySnapshotGeneration = 0;
  if (!filesystemAvailable) {
    btHistorySaveStatus = "Storage unavailable; Bluetooth history stays in RAM";
    return;
  }
  BtSyncHistory::Snapshot snapshot{};
  File file = LittleFS.open(BT_HISTORY_FILE, "r");
  const bool exists = (bool)file;
  const bool valid = exists && file.size() == sizeof(snapshot) &&
                     file.read(reinterpret_cast<uint8_t *>(&snapshot), sizeof(snapshot)) == sizeof(snapshot) &&
                     BtSyncHistory::valid(snapshot);
  if (file) file.close();
  if (valid) {
    // Read quota metadata even when retention is Off or the generation was
    // invalidated. Toggling/rebooting cannot buy another save on the same day.
    btHistorySavedDay = snapshot.savedDay;
    btHistorySavedEpoch = (uint32_t)snapshot.successEpoch;
    btHistorySnapshotGeneration = snapshot.generation;
  }
  if (!btHistoryPersistEnabled) {
    btHistorySaveStatus = "Off: Bluetooth history stays in RAM only";
    return;
  }
  if (!valid) {
    btHistorySaveStatus = exists ? "Invalid daily snapshot ignored; no startup write" : "No daily snapshot saved yet";
    return;
  }
  if (snapshot.generation != btHistoryGeneration) {
    btHistorySaveStatus = "Previous snapshot disabled; waiting for an eligible successful sync";
    return;
  }
  btLastSyncEpoch.store((uint32_t)snapshot.successEpoch);
  btLastOutcomeSuccessful.store(true);
  struct tm local; bluetoothLocalTime((time_t)snapshot.successEpoch, local);
  char date[24]; strftime(date, sizeof(date), "%Y-%m-%d %H:%M:%S", &local);
  btLastSyncDate = date;
  btLastSyncStatus = String("Watch ") + ((int)snapshot.lastProfile + 1) + ": " +
                     btProtocolName(snapshot.lastProtocol) + " - time write delivered (saved daily snapshot; watch unverified)";
  btDeliveryEvidence = "Saved daily ATT-acknowledged delivery snapshot; watch display unverified";
  btLastWatchAddress = snapshot.profileAddress[snapshot.lastProfile];
  if (btProfileAddress[snapshot.lastProfile].equalsIgnoreCase(btLastWatchAddress.c_str()))
    btLastWatchName = btProfileName[snapshot.lastProfile];
  btConnectionAttempts = snapshot.connections; btWriteAcknowledgements = snapshot.ackedWrites;
  btNotifications.store(snapshot.notifications); btResponseErrors.store(snapshot.responseErrors);
  for (int i=0;i<BT_PROTOCOL_COUNT;++i) {
    btProtocolLastSyncEpoch[i] = snapshot.protocolEpoch[i];
    if (!snapshot.protocolEpoch[i]) continue;
    bluetoothLocalTime((time_t)snapshot.protocolEpoch[i], local);
    btSuccessYear[i] = local.tm_year + 1900; btSuccessYday[i] = local.tm_yday;
  }
  btSyncLastYear = btSuccessYear[BT_PROTOCOL_BX5600_MIP];
  btSyncLastYday = btSuccessYday[BT_PROTOCOL_BX5600_MIP];
  for (int i=0;i<BT_WATCH_PROFILE_COUNT;++i) {
    if (!snapshot.profileEpoch[i] || snapshot.profileProtocol[i] != btProfileProtocol[i] ||
        !btProfileAddress[i].equalsIgnoreCase(snapshot.profileAddress[i])) continue;
    btProfileLastSyncEpoch[i] = snapshot.profileEpoch[i];
    btProfileLastSyncProtocol[i] = snapshot.profileProtocol[i];
    btProfileLastSyncAddress[i] = snapshot.profileAddress[i];
    bluetoothLocalTime((time_t)snapshot.profileEpoch[i], local);
    btProfileSuccessYear[i] = local.tm_year + 1900; btProfileSuccessYday[i] = local.tm_yday;
  }
  btHistorySaveStatus = "First-success daily snapshot restored; later events were RAM only";
}

static bool saveBluetoothHistoryNow(time_t epoch) {
  if (!btHistoryPersistEnabled) {
    btHistorySaveStatus = "Off: Bluetooth history stays in RAM only";
    return false;
  }
  if (!BtSyncHistory::saveDue(true, (int64_t)epoch, btHistorySavedDay, btHistoryAttemptDay)) {
    btHistorySaveStatus = "Daily save limit: subsequent sync results stay in RAM";
    return false;
  }
  btHistoryAttemptDay = BtSyncHistory::brisbaneDay((int64_t)epoch);
  BtSyncHistory::Snapshot snapshot{};
  // Explicit zeroing makes padding deterministic for the bounded binary CRC.
  memset(&snapshot, 0, sizeof(snapshot));
  snapshot.generation = btHistoryGeneration;
  snapshot.savedDay = btHistoryAttemptDay; snapshot.successEpoch = (int64_t)epoch;
  snapshot.lastProfile = btActiveProfile; snapshot.lastProtocol = btActiveProtocol;
  snapshot.connections = btConnectionAttempts; snapshot.ackedWrites = btWriteAcknowledgements;
  snapshot.notifications = btNotifications.load(); snapshot.responseErrors = btResponseErrors.load();
  for (int i=0;i<BT_PROTOCOL_COUNT;++i) snapshot.protocolEpoch[i] = btProtocolLastSyncEpoch[i];
  for (int i=0;i<BT_WATCH_PROFILE_COUNT;++i) {
    if (!btProfileLastSyncEpoch[i] || btProfileLastSyncProtocol[i] != btProfileProtocol[i] ||
        !btProfileAddress[i].equalsIgnoreCase(btProfileLastSyncAddress[i].c_str())) continue;
    snapshot.profileEpoch[i] = btProfileLastSyncEpoch[i];
    snapshot.profileProtocol[i] = btProfileLastSyncProtocol[i];
    strlcpy(snapshot.profileAddress[i], btProfileLastSyncAddress[i].c_str(), sizeof(snapshot.profileAddress[i]));
  }
  BtSyncHistory::seal(snapshot);
  if (!BtSyncHistory::valid(snapshot)) {
    btHistorySaveStatus = "History snapshot invalid; time delivered but no history saved";
    return false;
  }
  File file = LittleFS.open(BT_HISTORY_TEMP_FILE, "w");
  if (!file) { btHistorySaveStatus = "History save failed: temporary file unavailable; no automatic retry"; return false; }
  const size_t written = file.write(reinterpret_cast<const uint8_t *>(&snapshot), sizeof(snapshot));
  file.flush(); file.close();
  File check = LittleFS.open(BT_HISTORY_TEMP_FILE, "r");
  bool verified = written == sizeof(snapshot) && check && check.size() == sizeof(snapshot);
  uint8_t block[64];
  for (size_t offset = 0; verified && offset < sizeof(snapshot);) {
    const size_t remaining = sizeof(snapshot) - offset;
    const size_t count = remaining < sizeof(block) ? remaining : sizeof(block);
    verified = check.read(block, count) == count &&
               memcmp(block, reinterpret_cast<const uint8_t *>(&snapshot) + offset, count) == 0;
    offset += count;
  }
  if (check) check.close();
  if (!verified || !LittleFS.rename(BT_HISTORY_TEMP_FILE, BT_HISTORY_FILE)) {
    btHistorySaveStatus = "History save failed: prior snapshot retained; no automatic retry";
    return false;
  }
  btHistorySavedDay = snapshot.savedDay;
  btHistorySavedEpoch = (uint32_t)epoch;
  btHistorySnapshotGeneration = btHistoryGeneration;
  btHistorySaveStatus = "First successful sync today saved immediately";
  Serial.printf("BT: daily status snapshot saved (%u bytes); later syncs today stay in RAM\n", (unsigned)sizeof(snapshot));
  return true;
}

// UI configuration changes call writeConfigNow() and acknowledge success only
// after atomic flash replacement, so saved settings survive immediate restart.
// Required binding/schedule changes may still use the existing debounce.
// A failed save latches a RAM fault and stops all background retry writes.
// The next explicit successful user save clears that fault.
// V4.13 delivery history bypasses this path: its separate daily snapshot is
// committed immediately, and is never queued for recurring config retries.
// (CONFIG_SAVE_DEBOUNCE_MS/configDirty/configDirtyBecause are declared up
// near the other globals, above loop(), since loop() reads them directly
// and - unlike functions - plain variables/#defines aren't auto-forward-
// declared by the Arduino build system.)

static void loadWatchOptions(void) {
  for (int i=0;i<BT_WATCH_PROFILE_COUNT;++i) {
    btFeatureDesired[i]=CasioWatchFeatures::Desired{};
    btFeatureBoundAddress[i][0]='\0'; btFeatureBoundProtocol[i]=0;
    btFeatureStatus[i]="Off: time synchronization only";
  }
  if (!filesystemAvailable) return;
  CasioWatchOptions::Snapshot snapshot{};
  File file=LittleFS.open(WATCH_OPTIONS_FILE,"r");
  const bool exists=(bool)file;
  const bool valid=exists && file.size()==sizeof(snapshot) &&
      file.read(reinterpret_cast<uint8_t *>(&snapshot),sizeof(snapshot))==sizeof(snapshot) &&
      CasioWatchOptions::valid(snapshot);
  if (file) file.close();
  if (!valid) {
    if (exists) for (int i=0;i<BT_WATCH_PROFILE_COUNT;++i)
      btFeatureStatus[i]="Invalid watch options ignored; defaults Off; no startup write";
    return;
  }
  for (int i=0;i<BT_WATCH_PROFILE_COUNT;++i) {
    const auto &record=snapshot.profiles[i];
    if (record.protocol!=btProfileProtocol[i] ||
        !btProfileAddress[i].equalsIgnoreCase(record.address)) continue;
    btFeatureDesired[i]=CasioWatchOptions::decode(record);
    strlcpy(btFeatureBoundAddress[i],record.address,sizeof(btFeatureBoundAddress[i]));
    btFeatureBoundProtocol[i]=record.protocol;
    btFeatureStatus[i]=btFeatureDesired[i].enabled?"Saved choices; awaiting next watch sync":"Off: time synchronization only";
  }
}

static bool saveWatchOptions(void) {
  if (!filesystemAvailable) return false;
  CasioWatchOptions::Snapshot snapshot{};
  memset(&snapshot,0,sizeof(snapshot));
  for (int i=0;i<BT_WATCH_PROFILE_COUNT;++i)
    CasioWatchOptions::encode(btFeatureDesired[i],btFeatureBoundAddress[i],btFeatureBoundProtocol[i],snapshot.profiles[i]);
  CasioWatchOptions::seal(snapshot);
  if (!CasioWatchOptions::valid(snapshot)) return false;
  File file=LittleFS.open(WATCH_OPTIONS_TEMP_FILE,"w");
  if (!file) return false;
  const size_t written=file.write(reinterpret_cast<const uint8_t *>(&snapshot),sizeof(snapshot));
  file.flush(); file.close();
  File check=LittleFS.open(WATCH_OPTIONS_TEMP_FILE,"r");
  bool verified=written==sizeof(snapshot) && check && check.size()==sizeof(snapshot);
  uint8_t bytes[64];
  for (size_t offset=0;verified && offset<sizeof(snapshot);) {
    const size_t remaining=sizeof(snapshot)-offset;
    const size_t count=remaining<sizeof(bytes)?remaining:sizeof(bytes);
    verified=check.read(bytes,count)==count &&
             memcmp(bytes,reinterpret_cast<const uint8_t *>(&snapshot)+offset,count)==0;
    offset+=count;
  }
  if (check) check.close();
  return verified && LittleFS.rename(WATCH_OPTIONS_TEMP_FILE,WATCH_OPTIONS_FILE);
}

static bool tempFileMatches(const char *path, const char *expected, size_t length)
{
  File check = LittleFS.open(path, "r");
  if (!check) return false;
  bool valid = check.size() == length;
  uint8_t bytes[64];
  for (size_t offset = 0; valid && offset < length;) {
    const size_t count = (length - offset < sizeof(bytes)) ? length - offset : sizeof(bytes);
    valid = check.read(bytes, count) == count && memcmp(bytes, expected + offset, count) == 0;
    offset += count;
  }
  check.close();
  return valid;
}

static bool configSaveFailed(const char *reason)
{
  configDirty = false;
  configStorageFault = true;
  Serial.printf("Config save failed: %s; previous file retained, automatic retries disabled\n", reason);
  return false;
}

bool writeConfigNow(void) {
  configDirty=false;
  if (!filesystemAvailable) return configSaveFailed("storage unavailable");
  CasioConfigWriter record(storageSerializationBuffer,sizeof(storageSerializationBuffer));
  record.line(CasioConfigFormat::MAGIC);
  record.line(ssid); record.line(passwd); record.line(timezone_name.c_str()); record.number(wifiPowerMode);
  for (int i=0;i<BT_SYNC_SLOT_COUNT;++i) record.line(btSyncEnabled[i]?"1":"0");
  for (int i=0;i<BT_SYNC_SLOT_COUNT;++i) record.number(btSyncProtocol[i]);
  record.number(btManualProtocol);
  for (int i=0;i<BT_SYNC_SLOT_COUNT;++i) record.number(btSyncTimes[i]);
  for (int i=0;i<BT_SYNC_SLOT_COUNT;++i) record.number(btSyncProfile[i]);
  record.number(btManualProfile);
  for (int i=0;i<BT_WATCH_PROFILE_COUNT;++i) record.line(btProfileAddress[i].c_str());
  for (int i=0;i<BT_WATCH_PROFILE_COUNT;++i) record.line(btProfileName[i].c_str(),true);
  record.line(btAlwaysWaitEnabled?"1":"0");
  for (int i=0;i<BT_WATCH_PROFILE_COUNT;++i) record.number(btProfileProtocol[i]);
  record.line(btTimezoneName.c_str()); record.number(btTimeOffsetMinutes);
  record.line(activityLedEnabled.load()?"1":"0");
  for (int i=0;i<BT_WATCH_PROFILE_COUNT;++i) record.number(btFontMode[i]);
  record.line(btIdlePowerSaveEnabled?"1":"0"); record.line(btHistoryPersistEnabled?"1":"0");
  record.unsignedNumber(btHistoryGeneration);
  record.line(wifiAccessEnabled?"1":"0"); record.number(wifiAccessStart); record.number(wifiAccessEnd);
  record.line(wifiAccessTimezone.c_str()); record.line(crashDumpEnabled?"1":"0");
  if (!record.seal(CasioConfigFormat::FIELD_COUNT)) return configSaveFailed("invalid or oversized complete record");
  CasioConfigRecord candidate;
  const bool valid=candidate.parse(storageSerializationBuffer,record.size()) && validateSavedConfig(candidate);
  candidate.restoreVersionedNewlines();
  if (!valid) return configSaveFailed("invalid configuration fields");
  File file=LittleFS.open(CONFIG_TEMP_FILE,"w");
  if (!file) return configSaveFailed("temporary file unavailable");
  const size_t written=file.write(reinterpret_cast<const uint8_t *>(storageSerializationBuffer),record.size());
  file.flush(); file.close();
  if (written!=record.size() || !tempFileMatches(CONFIG_TEMP_FILE,storageSerializationBuffer,record.size()) ||
      !LittleFS.rename(CONFIG_TEMP_FILE,CONFIG_FILE)) return configSaveFailed("write/readback/rename");
  configStorageFault=false;
  Serial.println("CasioSync config saved atomically");
  return true;
}

void saveConfig(void)
{
  if (configStorageFault) return; // A failed commit never starts a periodic retry loop.
  configDirty = true;
  configDirtyBecause = millis();
}

static void servicePendingConfigSave(void)
{
  if (!configDirty || configStorageFault ||
      (millis() - configDirtyBecause) < CONFIG_SAVE_DEBOUNCE_MS) return;
  configDirty = false;
  writeConfigNow(); // One attempt; failure remains a RAM fault until explicit save.
}

void normalizeBluetoothSlots() {
  // Old configurations may contain overlapping Bluetooth windows. Preserve
  // their stored switches: the scheduler serializes them, and current API
  // validation prevents introducing another overlap during editing.
  for (int i=0;i<BT_SYNC_SLOT_COUNT;++i) {
    for (int j=0;j<i;++j) if (btSyncEnabled[j] &&
        btSyncEnabled[i] &&
        btCircularDistance(btSyncTimes[i],btSyncTimes[j]) <= BT_PREPARE_MINUTES+BT_WINDOW_AFTER_MINUTES+1)
      Serial.printf("BT: stored slots %d and %d overlap; enabled settings retained\n", j+1, i+1);
  }
}
// Wake before every enabled Bluetooth occurrence in its own watch timezone.
// Adaptive clock-trust wakes also operate when no automatic slot is enabled.
static bool shouldWifiBeOnForBtSchedule(void) {
  if (!clockTrusted()) return false;
  const time_t epoch = time(nullptr);
  struct tm local; bluetoothLocalTime(epoch, local);
  const int minute = btMinutesOfDay(local);
  constexpr int lead = 10;
  for (int i=0;i<BT_SYNC_SLOT_COUNT;++i) {
    if (!btSyncEnabled[i]) continue;
    const int start = (btSyncTimes[i] - lead + 1440) % 1440;
    const int elapsed = (minute - start + 1440) % 1440;
    if (elapsed <= lead + BT_WINDOW_AFTER_MINUTES) return true;
  }
  return false;
}

// Independent web-access civil time; never changes the global TZ or applies
// the Bluetooth watch offset.
static bool wifiAccessWindowOpen(void) {
  if (!wifiAccessEnabled) return false;
  time_t epoch = time(nullptr);
  if ((int64_t)epoch < 1577836800) return false;
  struct tm utc, local;
  gmtime_r(&epoch, &utc);
  const int offset = btBaseOffsetSeconds(wifiAccessTimezone) +
                     (btDstAtUtc(wifiAccessTimezone, utc) ? 3600 : 0);
  time_t adjusted = epoch + offset;
  gmtime_r(&adjusted, &local);
  return CasioWifiAccessWindow::containsMinute(local.tm_hour * 60 + local.tm_min,
                                              wifiAccessStart, wifiAccessEnd);
}

// Called from loop() every few seconds when wifiPowerMode == WIFI_POWER_SCHEDULED.
// Turns the WiFi radio fully on/off to match shouldWifiBeOnForBtSchedule(),
// with a mandatory on-window for the first WIFI_BOOT_ON_DURATION_MS after
// boot so the device is always reachable to be configured. Never runs while
// in AP configuration mode.
static bool wifiClockSyncWindowOpen(void)
{
  const uint64_t nowMs = (uint64_t)esp_timer_get_time() / 1000ULL;
  portENTER_CRITICAL(&clockMux);
  const uint32_t completed = clockNtpSyncCount;
  const bool rejected = clockNtpRejected;
  portEXIT_CRITICAL(&clockMux);
  if (wifiClockWakeActive) {
    if (completed != wifiClockWakeSyncCount && !rejected) {
      wifiClockWakeActive = false;
      wifiClockRetryAtMs = 0;
      wifiClockRetryDelayMs = 30000;
    } else if (nowMs - wifiClockWakeStartedMs >= WIFI_CLOCK_WAKE_TIMEOUT_MS) {
      wifiClockWakeActive = false;
      wifiClockRetryAtMs = nowMs + wifiClockRetryDelayMs;
      wifiClockRetryDelayMs = wifiClockRetryDelayMs < WIFI_RETRY_MAX_MS / 2
          ? wifiClockRetryDelayMs * 2 : WIFI_RETRY_MAX_MS;
    } else return true;
  }
  const uint32_t age = clockAgeSeconds();
  const uint32_t interval = ntpIntervalSec.load();
  const uint32_t wakeAge = interval > WIFI_CLOCK_WAKE_LEAD_SEC
      ? interval - WIFI_CLOCK_WAKE_LEAD_SEC : 0;
  if ((rejected || age == UINT32_MAX || age >= wakeAge) && nowMs >= wifiClockRetryAtMs) {
    wifiClockWakeActive = true;
    wifiClockWakeStartedMs = nowMs;
    wifiClockWakeSyncCount = completed;
    return true;
  }
  return false;
}

void updateWifiPowerManagement(void)
{
  const unsigned long now = millis();
  if (!wifiBootAccessComplete && now - bootMillis >= WIFI_BOOT_ON_DURATION_MS)
    wifiBootAccessComplete = true;
  static int appliedPowerMode = -1;
  if (WiFi.getMode() != WIFI_OFF && appliedPowerMode != wifiPowerMode) {
    if (WiFi.setSleep(wifiPowerMode != WIFI_POWER_ALWAYS_ON)) appliedPowerMode = wifiPowerMode;
  }
  if (ap_mode || !filesystemAvailable) return; // Setup/fault AP remains available.
  if (wifiConnectionPending) return; // A bounded association owns this wake.
  if (wifiPowerMode != WIFI_POWER_SCHEDULED) {
    if (!wifiRadioEnabled) { wifiRadioEnabled=true; ntpstart(); }
    if (WiFi.getMode() != WIFI_OFF) wifiPowerFault = false;
    return;
  }
  static unsigned long lastCheck = 0;
  if (now - lastCheck < 1000) return;
  lastCheck = now;
  if (wifiRecoveryWindowActive && now - wifiRecoveryStarted >= WIFI_BOOT_ON_DURATION_MS)
    wifiRecoveryWindowActive = false;
  const bool clockWake = wifiClockSyncWindowOpen();
  const bool wantOn = !wifiBootAccessComplete || wifiRecoveryWindowActive ||
      wifiAccessWindowOpen() || shouldWifiBeOnForBtSchedule() || clockWake;
  if (wantOn && !wifiRadioEnabled) {
    Serial.println("WiFi power-save: waking radio for sync or web-access window");
    wifiRadioEnabled = true;
    ntpstart();
  } else if (!wantOn && (wifiRadioEnabled || wifiPowerShutdownPending || WiFi.getMode() != WIFI_OFF)) {
    if (wifiRadioEnabled)
      Serial.println("WiFi power-save: sync/web-access windows closed, powering down radio");
    wifiRadioEnabled = false;
    (void)ntpstop();
  }
}

void checkWiFiConnection(void)
{
  const uint64_t nowMs = (uint64_t)esp_timer_get_time() / 1000ULL;
  if (!filesystemAvailable || strlen(ssid) == 0) {
    if (!ap_mode) startAPMode();
    return;
  }
  if (wifiPowerMode == WIFI_POWER_SCHEDULED && !wifiRadioEnabled && !ap_mode) {
    // Desired Off is separate from observed mode. Keep a surviving station
    // usable while the power manager retries its checked shutdown.
    if (wifiPowerShutdownPending && WiFi.status() == WL_CONNECTED) {
      if (!webServerStarted) initWebServer();
      if (!esp_sntp_enabled() && nowMs >= wifiNtpConfigureRetryAtMs) {
        if (configureNtpClient()) {
          wifiNtpConfigureRetryAtMs = 0;
          wifiNtpConfigureRetryDelayMs = 5000;
        } else {
          wifiNtpConfigureRetryAtMs = nowMs + wifiNtpConfigureRetryDelayMs;
          wifiNtpConfigureRetryDelayMs = wifiNtpConfigureRetryDelayMs < WIFI_RETRY_MAX_MS / 2
              ? wifiNtpConfigureRetryDelayMs * 2 : WIFI_RETRY_MAX_MS;
        }
      }
    }
    return;
  }
  if (WiFi.status() == WL_CONNECTED) {
    // Retain AP until STA association succeeds. Clock trust remains guarded
    // separately, so recovery never writes an untrusted watch time.
    if (wifiRadioEnabled) wifiPowerFault = false;
    if (ap_mode && !stopAPMode()) return;
    if (!webServerStarted) initWebServer();
    if (wifiConnectionPending) {
      // Association is complete even if SNTP initialization fails. Keeping
      // this pending forever would defeat the finite power-save wake budget.
      wifiConnectionPending = false;
      if (wifiConnectionAccessGrace) {
        wifiRecoveryStarted = millis();
        wifiRecoveryWindowActive = true;
      }
      Serial.printf("WiFi connected! Web server at http://%s\n", WiFi.localIP().toString().c_str());
    }
    wifi_connect_start = 0;
    wifiStaRetryAtMs = 0;
    wifiStaRetryDelayMs = 30000;
    if (!esp_sntp_enabled()) {
      if (nowMs < wifiNtpConfigureRetryAtMs) return;
      if (!configureNtpClient()) {
        wifiNtpConfigureRetryAtMs = nowMs + wifiNtpConfigureRetryDelayMs;
        wifiNtpConfigureRetryDelayMs = wifiNtpConfigureRetryDelayMs < WIFI_RETRY_MAX_MS / 2
            ? wifiNtpConfigureRetryDelayMs * 2 : WIFI_RETRY_MAX_MS;
        return;
      }
      wifiNtpConfigureRetryAtMs = 0;
      wifiNtpConfigureRetryDelayMs = 5000;
    }
    return;
  }
  if (wifiConnectionPending) {
    if (millis() - wifi_connect_start < WIFI_CONNECT_TIMEOUT) return;
    Serial.println("WiFi connection timeout; retaining setup AP with automatic station retries");
    startAPMode();
    wifiStaRetryAtMs = nowMs + wifiStaRetryDelayMs;
    wifiStaRetryDelayMs = wifiStaRetryDelayMs < WIFI_RETRY_MAX_MS / 2
        ? wifiStaRetryDelayMs * 2 : WIFI_RETRY_MAX_MS;
    return;
  }
  if (apStartPending || nowMs < wifiStaRetryAtMs) return;
  // A single association attempt has its own deadline. Calling reconnect
  // every poll would continuously interrupt association. AP+STA retains the
  // working setup network throughout retries after a router outage.
  if (ap_mode) beginWifiCredentialConnection();
  else {
    if (esp_sntp_enabled()) esp_sntp_stop();
    wifiConnectionPending = true;
    wifiConnectionAccessGrace = true;
    wifi_connect_start = millis();
    Serial.println("WiFi connection lost; starting bounded station recovery");
    WiFi.reconnect();
  }
}

void startAPMode(void)
{
  ap_mode = true;
  wifiConnectionPending = false;
  wifi_connect_start = 0;
  wifiRadioEnabled = true;
  wifiPowerShutdownPending = false;
  wifiPowerRetryAtMs = 0;
  wifiPowerRetryDelayMs = 1000;
  apStartPending = true;
  apStartAttemptMillis = millis();
  // Stopping an unstarted client can post to an uninitialized TCP/IP mailbox.
  if (esp_sntp_enabled()) esp_sntp_stop();
  if (webServerStarted) { server.stop(); webServerStarted=false; }
  // The netif MAC can still be all-zero until the asynchronous AP_START
  // event runs. Read the device's derived AP MAC independently of that event.
  uint8_t mac[6] = {};
  char ap_name[32];
  if (esp_read_mac(mac, ESP_MAC_WIFI_SOFTAP) == ESP_OK && !(mac[0] & 1) &&
      (mac[0] || mac[1] || mac[2] || mac[3] || mac[4] || mac[5])) {
    snprintf(ap_name, sizeof(ap_name), "%s_%02X%02X%02X",
             DEVICENAME_PREFIX, mac[3], mac[4], mac[5]);
  } else {
    snprintf(ap_name, sizeof(ap_name), "%s_Setup", DEVICENAME_PREFIX);
    Serial.println("AP device MAC unavailable; using CasioSync_Setup fallback");
  }
  if (!WiFi.mode(WIFI_AP)) {
    Serial.println("ERROR: AP WiFi driver startup failed; retry in 5 seconds");
    return;
  }
  // softAP waits for AP_START before configuring credentials. Explicitly
  // advertise on 2.4 GHz channel 1; do not claim success on an SDK error.
  if (!WiFi.softAP(ap_name, "12345678", 1, 0, 4) || !WiFi.AP.started()) {
    Serial.println("ERROR: AP start/configuration failed; retry in 5 seconds");
    return;
  }

  IPAddress IP = WiFi.softAPIP();
  if (uint32_t(IP) == 0) {
    Serial.println("ERROR: AP has no local IP; retry in 5 seconds");
    return;
  }
  apStartPending = false;
  wifiPowerFault = false; // A verified setup AP satisfies the new desired On state.
  Serial.printf("AP Mode started. SSID: %s, IP: %s\n", ap_name, IP.toString().c_str());

  initWebServer();
  Serial.println("Web server started");
}

void serviceAPStartup(void)
{
  if (!ap_mode || !apStartPending || wifiConnectionPending ||
      millis() - apStartAttemptMillis < AP_START_RETRY_MS) return;
  apStartAttemptMillis = millis();
  // Reset a failed/partial driver start so the next attempt gets a new
  // AP_START event. A healthy AP never enters this recovery path.
  if (!WiFi.mode(WIFI_OFF)) {
    Serial.println("ERROR: AP retry could not stop WiFi; retry in 5 seconds");
    return;
  }
  Serial.println("Retrying configuration AP startup");
  startAPMode();
}

bool stopAPMode(void)
{
  if (!WiFi.softAPdisconnect(true) || !WiFi.mode(WIFI_STA)) {
    Serial.println("AP mode transition failed; restoring configuration AP");
    startAPMode(); // AP.clear() may already have removed its credentials/interface.
    return false;
  }
  ap_mode = false;
  apStartPending = false;
  if (webServerStarted) { server.stop(); webServerStarted=false; }
  // Resume STA mode web server after connecting to Wi-Fi.
  WiFi.setSleep(wifiPowerMode != WIFI_POWER_ALWAYS_ON);
  Serial.println("AP mode stopped, web server continues on WiFi");
  return true;
}

static void beginWifiCredentialConnection(void)
{
  wifiRadioEnabled = true;
  wifiPowerShutdownPending = false;
  wifiPowerRetryAtMs = 0;
  wifiPowerRetryDelayMs = 1000;
  ntpsync = 0; // Clock holdover trust is independent of a fresh network reply.
  // Stopping an unstarted client can post to an uninitialized TCP/IP mailbox.
  if (esp_sntp_enabled()) esp_sntp_stop();
  if (strlen(ssid) == 0) { startAPMode(); return; }
  // Keep the configuration AP accessible until station association succeeds.
  if (!WiFi.mode(ap_mode ? WIFI_AP_STA : WIFI_STA)) {
    Serial.println("Could not start WiFi credential connection; restoring AP");
    startAPMode();
    wifiStaRetryAtMs = (uint64_t)esp_timer_get_time() / 1000ULL + wifiStaRetryDelayMs;
    wifiStaRetryDelayMs = wifiStaRetryDelayMs < WIFI_RETRY_MAX_MS / 2
        ? wifiStaRetryDelayMs * 2 : WIFI_RETRY_MAX_MS;
    return;
  }
  wifiPowerFault = false; // The driver acknowledged the desired powered-on mode.
  WiFi.setSleep(wifiPowerMode != WIFI_POWER_ALWAYS_ON);
  wifiConnectionPending = true;
  wifiConnectionAccessGrace = true;
  wifiNtpConfigureRetryAtMs = 0;
  wifiNtpConfigureRetryDelayMs = 5000;
  apStartPending = false;
  wifi_connect_start = millis();
  WiFi.begin(ssid, passwd);
  Serial.printf("Connecting to WiFi: %s (configuration AP retained until connected)\n", ssid);
}

static String bluetoothHistorySavedAt(void) {
  if (!btHistoryPersistEnabled || !btHistorySavedEpoch ||
      btHistorySnapshotGeneration != btHistoryGeneration) return "";
  struct tm local; bluetoothLocalTime((time_t)btHistorySavedEpoch, local);
  char date[24]; strftime(date, sizeof(date), "%Y-%m-%d %H:%M:%S", &local);
  return String(date);
}


static bool bluetoothSettingsMutable(void) {
  if (btBleBusy || btPairModeActive || btPairRequested) return false;
  // Manual selection controls the next explicit/passive window. An automatic
  // slot already has its own active profile/protocol and must keep listening.
  if (btWindowActive && btSyncActiveSlot < 0) stopBluetoothWindow();
  btManualSyncRequested = false;
  return true;
}

static bool bluetoothSlotSettingsMutable(void) {
  // Validation must not cancel a window before the remaining checks succeed.
  return !btBleBusy && !btPairModeActive && !btPairRequested;
}

static const char* bluetoothStateText(void) {
  if (btShutdownRequested.load()) return "Bluetooth recovery pending";
  if (btBleBusy) return btPhase;
  if (btPairRequested || btPairModeActive) return "Pairing";
  if (btManualSyncRequested) return "Waiting for watch";
  if (btWindowActive && btSyncActiveSlot >= 0) return "Automatic sync window active";
  if (btWindowActive) return btScan && btScan->isScanning() ? "Scanning" : "Waiting for watch";
  if (btAlwaysWaitEnabled && btProfileAddress[btManualProfile].length() != 17) return "No watch paired";
  return btPhase;
}

// Shared bounded response storage is used only by the single HTTP loop task.
// Send its bytes directly; WebServer's const-char send overload creates a String.
static char apiResponseBuffer[8192];
static void sendBoundedJson(CasioJsonWriter& json, int code = 200) {
  if (!json.ok()) {
    server.send(503, "application/json", "{\"status\":\"error\",\"message\":\"Response capacity exceeded\"}");
    return;
  }
  server.setContentLength(json.size());
  server.send(code, "application/json", String());
  server.sendContent(json.data(), json.size());
}

static CasioWatchFeatures::Caps profileFeatureCapabilities(int profile) {
  if (profile<0 || profile>=BT_WATCH_PROFILE_COUNT || btProfileAddress[profile].length()!=17)
    return CasioWatchFeatures::Caps{};
  return CasioWatchFeatures::capabilities(btProfileName[profile].c_str(),btProfileName[profile].length());
}
static void appendFeatureDesired(CasioJsonWriter &json,const CasioWatchFeatures::Desired &d) {
  json.append("{\"enabled\":").boolean(d.enabled);
  json.key("alarms_enabled").boolean(d.alarmsEnabled);
  json.key("alarms").append("[");
  for (size_t i=0;i<CasioWatchFeatures::kAlarmCount;++i) {
    if (i) json.append(",");
    json.append("{\"enabled\":").boolean(d.alarms[i].enabled);
    json.key("hour").number(d.alarms[i].hour);
    json.key("minute").number(d.alarms[i].minute).append("}");
  }
  json.append("]");
  json.key("hourly_chime").number(d.hourlyChime);
  json.key("timer_enabled").boolean(d.timerEnabled); json.key("timer_seconds").number(d.timerSeconds);
  json.key("basic_mask").number(d.basicMask); json.key("time_format_24").boolean(d.timeFormat24);
  json.key("button_tone").boolean(d.buttonTone); json.key("auto_light").boolean(d.autoLight);
  json.key("power_saving").boolean(d.powerSaving); json.key("long_light").boolean(d.longLight);
  json.key("date_day_first").boolean(d.dateDayFirst); json.key("language").number(d.language);
  json.key("auto_adjust_enabled").boolean(d.autoAdjustEnabled); json.key("auto_adjust").boolean(d.autoAdjust);
  json.key("auto_adjust_minute").number(d.autoAdjustMinute).append("}");
}

static void appendBluetoothProfiles(CasioJsonWriter& json) {
  json.key("bt_profiles").append("[");
  for (int i = 0; i < BT_WATCH_PROFILE_COUNT; ++i) {
    if (i) json.append(",");
    json.append("{\"id\":").number(i);
    json.key("bound").boolean(btProfileAddress[i].length() == 17);
    json.key("name").quoted(btProfileName[i].c_str());
    json.key("address").quoted(btProfileAddress[i].c_str());
    json.key("protocol").number(btProfileProtocol[i]);
    json.key("font_mode").number(static_cast<int>(btFontMode[i]));
    json.key("done_today").boolean(btProfileDoneToday(i));
    const auto& battery = btBatteryReadings[i];
    const bool available = btProfileProtocol[i] == BT_PROTOCOL_BX5600_MIP &&
                           battery.matches(btProfileAddress[i].c_str());
    json.key("battery_percent");
    if (available) json.number(battery.percent); else json.append("null");
    char readAt[24] = "";
    if (available) {
      struct tm local; bluetoothLocalTime(battery.sampledUtc, local);
      strftime(readAt, sizeof(readAt), "%Y-%m-%d %H:%M:%S", &local);
    }
    json.key("battery_read_at").quoted(readAt);
    const char* status = btProfileAddress[i].length() != 17
      ? "Pair a GW-BX5600 to read its battery"
      : btProfileProtocol[i] != BT_PROTOCOL_BX5600_MIP
        ? "Unavailable: selected protocol has no validated battery reading"
        : btBatteryStatuses[i];
    json.key("battery_status").quoted(status);
    const auto caps=profileFeatureCapabilities(i);
    json.key("feature_desired"); appendFeatureDesired(json,btFeatureDesired[i]);
    json.key("feature_capabilities").append("{\"basic_mask\":").number(caps.basicMask);
    json.key("alarms").boolean(caps.alarmCount>0); json.key("alarm_count").number(caps.alarmCount);
    json.key("hourly_chime").boolean(caps.hourlyChime); json.key("timer").boolean(caps.timer);
    json.key("timer_max_seconds").number(caps.timerMaxSeconds); json.key("auto_adjust").boolean(caps.autoAdjust).append("}");
    json.key("feature_status").quoted(btFeatureStatus[i]).append("}");
  }
  json.append("]");
}

static void appendRecentBluetoothSyncs(CasioJsonWriter& json) {
  const int profile = btManualProfile;
  const bool valid = profile >= 0 && profile < BT_WATCH_PROFILE_COUNT;
  json.key("bt_recent_sync_profile").number(valid ? profile : -1);
  json.key("bt_recent_syncs").append("[");
  if (valid) {
    // The HTTP and sync-result paths share loopTask ownership. Reconcile a
    // changed/removed binding before exposing any old watch's RAM history.
    btRecentSyncs.bind(profile, btProfileAddress[profile].c_str(), btProfileProtocol[profile]);
    const size_t count = btRecentSyncs.count(profile);
    for (size_t i = 0; i < count; ++i) {
      const auto* entry = btRecentSyncs.latest(profile, i);
      if (!entry) break;
      if (i) json.append(",");
      char date[24] = "";
      if (entry->utcEpoch) {
        struct tm local;
        bluetoothLocalTime(static_cast<time_t>(entry->utcEpoch), local);
        strftime(date, sizeof(date), "%Y-%m-%d %H:%M:%S", &local);
      }
      json.append("{\"utc_epoch\":").number(entry->utcEpoch);
      json.key("date").quoted(date);
      json.key("protocol").number(entry->protocol);
      json.key("successful").boolean(entry->successful).append("}");
    }
  }
  json.append("]");
}

static void appendCommonSettings(CasioJsonWriter& json) {
  json.key("timezone").quoted(timezone_name.c_str());
  json.key("bt_timezone").quoted(btTimezoneName.c_str());
  json.key("bt_time_offset_minutes").number(btTimeOffsetMinutes);
  json.key("wifi_power_mode").number(wifiPowerMode);
  json.key("bt_day_complete").boolean(btSyncDayComplete);
  json.key("bt_manual_protocol").number(btManualProtocol);
  json.key("bt_manual_profile").number(btManualProfile);
  json.key("bt_active_protocol").number(btActiveProtocol);
  json.key("bt_active_profile").number(btActiveProfile);
  json.key("bt_last_sync_status").quoted(btLastSyncStatus.c_str());
  json.key("bt_last_sync_date").quoted(btLastSyncDate.c_str());
  json.key("bt_always_wait").boolean(btAlwaysWaitEnabled);
  json.key("activity_led_enabled").boolean(activityLedEnabled.load());
  json.key("bt_idle_power_save").boolean(btIdlePowerSaveEnabled);
  json.key("bt_font_status").quoted(btFontLastStatus.c_str());
  json.key("bt_state").quoted(bluetoothStateText());
  json.key("bt_pairing").boolean(btPairModeActive || btPairRequested);
  json.key("bt_history_persist").boolean(btHistoryPersistEnabled);
  char savedAt[24] = "";
  if (btHistoryPersistEnabled && btHistorySavedEpoch && btHistorySnapshotGeneration == btHistoryGeneration) {
    struct tm local; bluetoothLocalTime(static_cast<time_t>(btHistorySavedEpoch), local);
    strftime(savedAt, sizeof(savedAt), "%Y-%m-%d %H:%M:%S", &local);
  }
  json.key("bt_history_saved_at").quoted(savedAt);
  json.key("bt_history_save_status").quoted(btHistorySaveStatus.c_str());
  json.key("bt_last_sync_epoch").number(btLastSyncEpoch.load());
  json.key("bt_last_outcome_successful").boolean(btLastOutcomeSuccessful.load());
  json.key("wifi_access_enabled").boolean(wifiAccessEnabled);
  json.key("wifi_access_start").number(wifiAccessStart);
  json.key("wifi_access_end").number(wifiAccessEnd);
  json.key("wifi_access_timezone").quoted(wifiAccessTimezone.c_str());
  json.key("wifi_access_active").boolean(wifiAccessWindowOpen());
  json.key("crash_dump_enabled").boolean(crashDumpEnabled);
  json.key("crash_dump_available").boolean(RadioCrashDumpGate::available());
  json.key("filesystem_available").boolean(filesystemAvailable);
  json.key("config_storage_fault").boolean(configStorageFault);
  json.key("firmware_version").quoted(FIRMWARE_VERSION);
  json.key("firmware_build").quoted(FIRMWARE_BUILD);
  appendBluetoothProfiles(json);
  appendRecentBluetoothSyncs(json);
  json.key("bt_times").append("[");
  for (int i = 0; i < BT_SYNC_SLOT_COUNT; ++i) {
    if (i) json.append(",");
    json.append("{\"minute\":").number(btSyncTimes[i]);
    json.key("enabled").boolean(btSyncEnabled[i]);
    json.key("protocol").number(btSyncProtocol[i]);
    json.key("profile").number(btSyncProfile[i]);
    json.key("done_today").boolean(btProfileDoneToday(btSyncProfile[i]));
    json.key("conflict").boolean(btOverlapsOtherEnabledSlot(i, btSyncTimes[i]));
    json.append("}");
  }
  json.append("]");
}

void initWebServer(void)
{
  if (webServerStarted) return;
  if (!webRoutesRegistered) {
  // Register routes only once. Restart listening after Wi-Fi sleep/AP switch.
  // Serve index page
  server.on("/", HTTP_GET, []() {
    sendIndexPage();
  });

  // A mount error never authorizes automatic formatting. Recovery is possible
  // only through the setup AP after the user explicitly confirms data loss.
  server.on("/api/storage/reset", HTTP_POST, []() {
    if (filesystemAvailable || !ap_mode) {
      server.send(409, "application/json", "{\"status\":\"error\",\"message\":\"Storage reset is restricted to a filesystem-fault setup AP\"}"); return;
    }
    if (!server.hasArg("confirm") || server.arg("confirm") != "ERASE_SAVED_SETTINGS") {
      server.send(400, "application/json", "{\"status\":\"error\",\"message\":\"Explicit confirmation of saved-settings erasure is required\"}"); return;
    }
    if (!LittleFS.format()) {
      server.send(500, "application/json", "{\"status\":\"error\",\"message\":\"Storage recovery failed; setup AP remains available\"}"); return;
    }
    server.send(200, "application/json", "{\"status\":\"ok\",\"message\":\"Saved settings erased; restarting into setup AP\"}");
    delay(200);
    ESP.restart();
  });

  server.on("/api/watch-settings",HTTP_POST,[]() {
    if (btBleBusy || btPairModeActive || btPairRequested) {
      server.send(409,"application/json","{\"status\":\"error\",\"message\":\"Watch transaction or pairing active; retry when it finishes\"}"); return;
    }
    if (!server.hasArg("plain")) {
      server.send(400,"application/json","{\"status\":\"error\",\"message\":\"Complete watch settings JSON required\"}"); return;
    }
    String body;
    if (!server.checkedArg("plain",body) || body.length()>2048) {
      server.send(400,"application/json","{\"status\":\"error\",\"message\":\"Watch settings payload unavailable or too large\"}"); return;
    }
    static StaticJsonDocument<3072> document; // HTTP handlers share one loopTask.
    document.clear();
    if (deserializeJson(document,body) || !document.is<JsonObject>() || document.overflowed()) {
      server.send(400,"application/json","{\"status\":\"error\",\"message\":\"Invalid watch settings JSON\"}"); return;
    }
    const JsonObjectConst object=document.as<JsonObjectConst>();
    auto integer=[&object](const char *key,int32_t lo,int32_t hi,int32_t &result) {
      const JsonVariantConst value=object[key];
      if (!value.is<int32_t>()) return false;
      result=value.as<int32_t>(); return result>=lo && result<=hi;
    };
    auto flag=[&object](const char *key,bool &result) {
      const JsonVariantConst value=object[key];
      if (!value.is<bool>()) return false;
      result=value.as<bool>(); return true;
    };
    CasioWatchFeatures::Desired desired{};
    int32_t profile, chime, timerSeconds, mask, language, adjustMinute;
    bool valid=integer("profile",0,BT_WATCH_PROFILE_COUNT-1,profile) &&
      flag("enabled",desired.enabled) && flag("alarms_enabled",desired.alarmsEnabled) &&
      integer("hourly_chime",-1,1,chime) && flag("timer_enabled",desired.timerEnabled) &&
      integer("timer_seconds",1,86400,timerSeconds) && integer("basic_mask",0,127,mask) &&
      flag("time_format_24",desired.timeFormat24) && flag("button_tone",desired.buttonTone) &&
      flag("auto_light",desired.autoLight) && flag("power_saving",desired.powerSaving) &&
      flag("long_light",desired.longLight) && flag("date_day_first",desired.dateDayFirst) &&
      integer("language",0,5,language) && flag("auto_adjust_enabled",desired.autoAdjustEnabled) &&
      flag("auto_adjust",desired.autoAdjust) && integer("auto_adjust_minute",0,59,adjustMinute);
    const JsonArrayConst alarms=object["alarms"].as<JsonArrayConst>();
    valid=valid && alarms.size()==CasioWatchFeatures::kAlarmCount;
    for (size_t i=0;valid && i<CasioWatchFeatures::kAlarmCount;++i) {
      const JsonObjectConst alarm=alarms[i].as<JsonObjectConst>();
      valid=!alarm.isNull() && alarm["enabled"].is<bool>() && alarm["hour"].is<int>() && alarm["minute"].is<int>();
      if (!valid) break;
      const int hour=alarm["hour"].as<int>(), minute=alarm["minute"].as<int>();
      valid=hour>=0 && hour<=23 && minute>=0 && minute<=59;
      if (valid) desired.alarms[i]={alarm["enabled"].as<bool>(),static_cast<uint8_t>(hour),static_cast<uint8_t>(minute)};
    }
    if (!valid) {
      server.send(400,"application/json","{\"status\":\"error\",\"message\":\"Invalid or incomplete watch options; no settings changed\"}"); return;
    }
    desired.hourlyChime=chime; desired.timerSeconds=timerSeconds; desired.basicMask=mask;
    desired.language=language; desired.autoAdjustMinute=adjustMinute;
    const auto caps=profileFeatureCapabilities(profile);
    if (desired.enabled && (btProfileAddress[profile].length()!=17 ||
        (desired.alarmsEnabled && !caps.alarmCount) || (desired.hourlyChime>=0 && !caps.hourlyChime) ||
        (desired.timerEnabled && (!caps.timer || desired.timerSeconds>caps.timerMaxSeconds)) ||
        (desired.basicMask & ~caps.basicMask) || (desired.autoAdjustEnabled && !caps.autoAdjust))) {
      server.send(400,"application/json","{\"status\":\"error\",\"message\":\"Pair a supported watch and choose only its available features\"}"); return;
    }
    const auto previous=btFeatureDesired[profile];
    char previousAddress[18]; memcpy(previousAddress,btFeatureBoundAddress[profile],sizeof(previousAddress));
    const uint8_t previousProtocol=btFeatureBoundProtocol[profile];
    btFeatureDesired[profile]=desired;
    strlcpy(btFeatureBoundAddress[profile],btProfileAddress[profile].c_str(),sizeof(btFeatureBoundAddress[profile]));
    btFeatureBoundProtocol[profile]=btProfileProtocol[profile];
    if (!saveWatchOptions()) {
      btFeatureDesired[profile]=previous;
      memcpy(btFeatureBoundAddress[profile],previousAddress,sizeof(previousAddress));
      btFeatureBoundProtocol[profile]=previousProtocol;
      server.send(500,"application/json","{\"status\":\"error\",\"message\":\"Watch options were not saved; previous choices retained\"}"); return;
    }
    btFeatureStatus[profile]=desired.enabled?"Choices saved; apply and verify during next watch sync":"Off: time synchronization only";
    server.send(200,"application/json","{\"status\":\"ok\"}");
  });

  // API endpoints
  server.on("/api/config", HTTP_GET, []() {
    CasioJsonWriter json(apiResponseBuffer, sizeof(apiResponseBuffer));
    json.append("{\"ssid\":").quoted(ssid);
    appendCommonSettings(json);
    json.append("}");
    sendBoundedJson(json);
  });

  server.on("/api/config", HTTP_POST, []() {
    if (server.hasArg("crash_dump_enabled")) {
      String value = server.arg("crash_dump_enabled");
      if (value != "0" && value != "1" && value != "true" && value != "false") {
        server.send(400,"application/json","{\"status\":\"error\",\"message\":\"Invalid crash-dump setting\"}"); return;
      }
      const bool enabled = value == "1" || value == "true";
      if (enabled && !RadioCrashDumpGate::available()) {
        server.send(503,"application/json","{\"status\":\"error\",\"message\":\"Crash-dump storage unavailable in this ESP32 core\"}"); return;
      }
      const bool previousEnabled = crashDumpEnabled;
      crashDumpEnabled = enabled;
      if (!writeConfigNow()) {
        crashDumpEnabled = previousEnabled; saveConfig();
        server.send(500,"application/json","{\"status\":\"error\",\"message\":\"Crash-dump setting could not be saved; previous value retained\"}"); return;
      }
      RadioCrashDumpGate::setEnabled(crashDumpEnabled);
      server.send(200,"application/json","{\"status\":\"ok\"}"); return;
    }
    if (server.hasArg("bt_history_persist")) {
      String value = server.arg("bt_history_persist");
      if (value != "0" && value != "1" && value != "true" && value != "false") {
        server.send(400,"application/json","{\"status\":\"error\",\"message\":\"Invalid Bluetooth history retention value\"}"); return;
      }
      const bool previousEnabled = btHistoryPersistEnabled;
      const uint32_t previousGeneration = btHistoryGeneration;
      const bool enabled = value == "1" || value == "true";
      if (!enabled && previousEnabled && btHistoryGeneration == UINT32_MAX) {
        server.send(400,"application/json","{\"status\":\"error\",\"message\":\"History generation exhausted; setting retained\"}"); return;
      }
      btHistoryPersistEnabled = enabled;
      // A disabled snapshot must never reappear after Off -> On -> reboot.
      // Config stores this invalidation; no history write/delete is needed.
      if (!enabled && previousEnabled) ++btHistoryGeneration;
      if (!writeConfigNow()) {
        btHistoryPersistEnabled = previousEnabled; btHistoryGeneration = previousGeneration;
        saveConfig();
        server.send(500,"application/json","{\"status\":\"error\",\"message\":\"History retention could not be saved; previous value retained\"}"); return;
      }
      btHistorySaveStatus = enabled ? "On: next eligible first-success snapshot will be saved"
                                   : "Off: Bluetooth history stays in RAM only";
      server.send(200,"application/json","{\"status\":\"ok\"}"); return;
    }
    if (server.hasArg("wifi_access_enabled") || server.hasArg("wifi_access_start") ||
        server.hasArg("wifi_access_end") || server.hasArg("wifi_access_timezone")) {
      if (!server.hasArg("wifi_access_enabled") || !server.hasArg("wifi_access_start") ||
          !server.hasArg("wifi_access_end") || !server.hasArg("wifi_access_timezone")) {
        server.send(400,"application/json","{\"status\":\"error\",\"message\":\"Complete daily Wi-Fi schedule required\"}"); return;
      }
      String value = server.arg("wifi_access_enabled");
      int start = server.arg("wifi_access_start").toInt();
      int end = server.arg("wifi_access_end").toInt();
      String zone = server.arg("wifi_access_timezone");
      if ((value != "0" && value != "1" && value != "true" && value != "false") ||
          server.arg("wifi_access_start") != String(start) || server.arg("wifi_access_end") != String(end) ||
          !CasioWifiAccessWindow::validMinutes(start, end) || !validTimezoneName(zone)) {
        server.send(400,"application/json","{\"status\":\"error\",\"message\":\"Invalid daily Wi-Fi schedule; start and end must differ\"}"); return;
      }
      const bool previousEnabled = wifiAccessEnabled;
      const int previousStart = wifiAccessStart, previousEnd = wifiAccessEnd, previousMode = wifiPowerMode;
      char previousZone[32];
      if (wifiAccessTimezone.length() >= sizeof(previousZone)) {
        server.send(503,"application/json","{\"status\":\"error\",\"message\":\"Wi-Fi access timezone unavailable; settings retained\"}"); return;
      }
      strlcpy(previousZone,wifiAccessTimezone.c_str(),sizeof(previousZone));
      const size_t reserveLength=wifiAccessTimezone.length()>zone.length()?wifiAccessTimezone.length():zone.length();
      if (!wifiAccessTimezone.reserve(reserveLength)) {
        server.send(503,"application/json","{\"status\":\"error\",\"message\":\"Not enough memory to save Wi-Fi access timezone; settings retained\"}"); return;
      }
      wifiAccessEnabled = value == "1" || value == "true";
      wifiAccessStart = start; wifiAccessEnd = end; wifiAccessTimezone = zone;
      if (wifiAccessEnabled) wifiPowerMode = WIFI_POWER_SCHEDULED;
      if (!writeConfigNow()) {
        wifiAccessEnabled = previousEnabled; wifiAccessStart = previousStart; wifiAccessEnd = previousEnd;
        wifiAccessTimezone = previousZone; wifiPowerMode = previousMode;
        saveConfig();
        server.send(500,"application/json","{\"status\":\"error\",\"message\":\"Wi-Fi schedule could not be saved; previous settings retained\"}"); return;
      }
      server.send(200,"application/json","{\"status\":\"ok\"}"); return;
    }
    if (server.hasArg("bt_font_profile") || server.hasArg("bt_font_mode")) {
      int profile = server.arg("bt_font_profile").toInt();
      int mode = server.arg("bt_font_mode").toInt();
      if (!server.hasArg("bt_font_profile") || !server.hasArg("bt_font_mode") ||
          server.arg("bt_font_profile") != String(profile) || server.arg("bt_font_mode") != String(mode) ||
          profile < 0 || profile >= BT_WATCH_PROFILE_COUNT || mode < 0 || mode > 2) {
        server.send(400,"application/json","{\"status\":\"error\",\"message\":\"Invalid watch font selection\"}"); return;
      }
      const uint8_t previous = btFontMode[profile];
      btFontMode[profile] = mode;
      if (!writeConfigNow()) {
        btFontMode[profile] = previous; saveConfig();
        server.send(500,"application/json","{\"status\":\"error\",\"message\":\"Watch font choice could not be saved; previous value retained\"}"); return;
      }
      server.send(200,"application/json","{\"status\":\"ok\"}"); return;
    }
    if (server.hasArg("bt_idle_power_save")) {
      String value = server.arg("bt_idle_power_save");
      if (value != "0" && value != "1" && value != "true" && value != "false") {
        server.send(400,"application/json","{\"status\":\"error\",\"message\":\"Invalid Bluetooth power-save value\"}"); return;
      }
      const bool previous = btIdlePowerSaveEnabled;
      btIdlePowerSaveEnabled = value == "1" || value == "true";
      if (!writeConfigNow()) {
        btIdlePowerSaveEnabled = previous; saveConfig();
        server.send(500,"application/json","{\"status\":\"error\",\"message\":\"Bluetooth power saving could not be saved; previous value retained\"}"); return;
      }
      server.send(200,"application/json","{\"status\":\"ok\"}"); return;
    }
    // LED changes do not interfere with a watch
    // transaction. Commit to flash before reporting that the switch is saved.
    if (server.hasArg("activity_led_enabled")) {
      String value = server.arg("activity_led_enabled");
      if (value != "0" && value != "1" && value != "true" && value != "false") {
        server.send(400,"application/json","{\"status\":\"error\",\"message\":\"Invalid activity LED value\"}");
        return;
      }
      const bool previousEnabled = activityLedEnabled.load();
      activityLedEnabled = value == "1" || value == "true";
      if (!writeConfigNow()) {
        activityLedEnabled = previousEnabled;
        saveConfig();
        server.send(500,"application/json","{\"status\":\"error\",\"message\":\"Activity LED setting could not be saved; previous value retained\"}");
        return;
      }
      server.send(200,"application/json","{\"status\":\"ok\"}");
      return;
    }
    // Settings can be updated independently.
    char previousSsid[sizeof(ssid)], previousPassword[sizeof(passwd)], previousDisplayZone[32];
    strlcpy(previousSsid,ssid,sizeof(previousSsid));
    strlcpy(previousPassword,passwd,sizeof(previousPassword));
    if (timezone_name.length() >= sizeof(previousDisplayZone)) {
      server.send(503,"application/json","{\"status\":\"error\",\"message\":\"Display time zone unavailable; settings retained\"}"); return;
    }
    strlcpy(previousDisplayZone,timezone_name.c_str(),sizeof(previousDisplayZone));
    const int previousPowerMode=wifiPowerMode;
    const bool previousAlwaysWait=btAlwaysWaitEnabled;
    const bool ssidRequested=server.hasArg("ssid"), passwordRequested=server.hasArg("password");
    const bool displayZoneRequested=server.hasArg("timezone");
    String requestedSsid, requestedPassword, requestedDisplayZone;
    if (ssidRequested && (!server.checkedArg("ssid",requestedSsid) || requestedSsid.length()>32 ||
        strlen(requestedSsid.c_str())!=requestedSsid.length() || requestedSsid.indexOf("\r")>=0 || requestedSsid.indexOf("\n")>=0)) {
      server.send(400,"application/json","{\"status\":\"error\",\"message\":\"SSID must be at most 32 UTF-8 bytes without line breaks\"}"); return;
    }
    if (passwordRequested && (!server.checkedArg("password",requestedPassword) || requestedPassword.length()>=sizeof(passwd) ||
        strlen(requestedPassword.c_str())!=requestedPassword.length() || requestedPassword.indexOf("\r")>=0 || requestedPassword.indexOf("\n")>=0)) {
      server.send(400,"application/json","{\"status\":\"error\",\"message\":\"Wi-Fi password must be at most 63 bytes without line breaks\"}"); return;
    }
    if (displayZoneRequested && (!server.checkedArg("timezone",requestedDisplayZone) || !validTimezoneName(requestedDisplayZone))) {
      server.send(400,"application/json","{\"status\":\"error\",\"message\":\"Unsupported display time zone\"}"); return;
    }
    int requestedPowerMode=previousPowerMode;
    bool requestedAlwaysWait=previousAlwaysWait;
    if (server.hasArg("wifi_power_mode")) {
      const String value=server.arg("wifi_power_mode");
      if (value!="0" && value!="1") {
        server.send(400,"application/json","{\"status\":\"error\",\"message\":\"Invalid Wi-Fi power mode\"}"); return;
      }
      requestedPowerMode=value=="1"?WIFI_POWER_SCHEDULED:WIFI_POWER_ALWAYS_ON;
    }
    if (server.hasArg("bt_always_wait")) {
      const String value=server.arg("bt_always_wait");
      if (value!="0" && value!="1" && value!="true" && value!="false") {
        server.send(400,"application/json","{\"status\":\"error\",\"message\":\"Invalid Always Wait value\"}"); return;
      }
      requestedAlwaysWait=value=="1" || value=="true";
    }
    const char *nextDisplayZone=displayZoneRequested?requestedDisplayZone.c_str():previousDisplayZone;
    const bool wifiChanged=(ssidRequested && strcmp(previousSsid,requestedSsid.c_str())) ||
                           (passwordRequested && requestedPassword.length()>0 && strcmp(previousPassword,requestedPassword.c_str()));

    // Stage both BT civil-time fields before changing any live BT setting.
    // Wi-Fi requests still reach their existing commit paths.
    const bool btZoneRequested = server.hasArg("bt_timezone");
    const bool btOffsetRequested = server.hasArg("bt_time_offset_minutes");
    char previousBtZone[32]; // All supported zone names fit, including NUL.
    if (btTimezoneName.length() >= sizeof(previousBtZone)) {
      server.send(503,"application/json","{\"status\":\"error\",\"message\":\"Bluetooth time zone unavailable; settings retained\"}"); return;
    }
    strlcpy(previousBtZone, btTimezoneName.c_str(), sizeof(previousBtZone));
    const int previousBtOffset = btTimeOffsetMinutes;
    String requestedBtZone;
    int requestedBtOffset = previousBtOffset;
    if (btZoneRequested) {
      if (!server.checkedArg("bt_timezone", requestedBtZone)) {
        server.send(503,"application/json","{\"status\":\"error\",\"message\":\"Not enough memory to read Bluetooth time zone; settings retained\"}"); return;
      }
      if (!validTimezoneName(requestedBtZone)) {
        server.send(400,"application/json","{\"status\":\"error\",\"message\":\"Unsupported Bluetooth time zone\"}"); return;
      }
    }
    if (btOffsetRequested) {
      String requestedOffset;
      if (!server.checkedArg("bt_time_offset_minutes", requestedOffset)) {
        server.send(503,"application/json","{\"status\":\"error\",\"message\":\"Not enough memory to read Bluetooth time offset; settings retained\"}"); return;
      }
      requestedBtOffset = requestedOffset.toInt();
      if (requestedOffset != String(requestedBtOffset) || requestedBtOffset < -720 || requestedBtOffset > 840) {
        server.send(400,"application/json","{\"status\":\"error\",\"message\":\"Invalid Bluetooth time offset\"}"); return;
      }
    }
    const char *nextBtZone = btZoneRequested ? requestedBtZone.c_str() : previousBtZone;
    const bool btTimeSettingsChanged = strcmp(nextBtZone, previousBtZone) != 0 ||
                                       requestedBtOffset != previousBtOffset;
    if (btTimeSettingsChanged && btBleBusy) {
      server.send(409,"application/json","{\"status\":\"error\",\"message\":\"Bluetooth transaction is active; retry time settings when it finishes\"}"); return;
    }
    const auto commitConfigWithBtTime = [&]() -> bool {
      const size_t oldDisplayLength=strlen(previousDisplayZone), nextDisplayLength=strlen(nextDisplayZone);
      if (!timezone_name.reserve(oldDisplayLength>nextDisplayLength?oldDisplayLength:nextDisplayLength))
        return configSaveFailed("Display time-zone allocation");

      if (btTimeSettingsChanged) {
        // Reserve once for both apply and rollback; neither assignment can
        // allocate after this succeeds. The rollback copy is fixed on stack.
        const size_t previousLength = strlen(previousBtZone);
        const size_t nextLength = strlen(nextBtZone);
        if (!btTimezoneName.reserve(previousLength > nextLength ? previousLength : nextLength))
          return configSaveFailed("Bluetooth time-zone allocation");
        btTimezoneName = nextBtZone;
        btTimeOffsetMinutes = requestedBtOffset;
      }
      if (ssidRequested) strlcpy(ssid,requestedSsid.c_str(),sizeof(ssid));
      if (passwordRequested && requestedPassword.length()>0) strlcpy(passwd,requestedPassword.c_str(),sizeof(passwd));
      timezone_name=nextDisplayZone;
      wifiPowerMode=requestedPowerMode; btAlwaysWaitEnabled=requestedAlwaysWait;
      if (!writeConfigNow()) {
        strlcpy(ssid,previousSsid,sizeof(ssid)); strlcpy(passwd,previousPassword,sizeof(passwd));
        timezone_name=previousDisplayZone; wifiPowerMode=previousPowerMode; btAlwaysWaitEnabled=previousAlwaysWait;

        if (btTimeSettingsChanged) {
          btTimezoneName = previousBtZone;
          btTimeOffsetMinutes = previousBtOffset;
        }
        return false;
      }
      if (strcmp(nextDisplayZone,previousDisplayZone)) applyTimezone();
      if (wifiChanged) wifiCredentialsReconnectPending=true;
      if (btTimeSettingsChanged) {
        // Only automatic windows are rearmed. An active one is stopped using
        // the existing host barrier, then reopened for the new BT civil time
        // on the next service pass. Manual/Pair/Always Wait stay intact.
        for (int i = 0; i < BT_SYNC_SLOT_COUNT; ++i) resetBluetoothSlotAttempt(i);
      }
      return true;
    };

    if (server.hasArg("bt_manual_protocol")) {
      int p = server.arg("bt_manual_protocol").toInt();
      if (server.arg("bt_manual_protocol") != String(p) || !validBtProtocol(p) ||
          !bluetoothSettingsMutable()) {
        server.send(409, "application/json", "{\"status\":\"error\",\"message\":\"invalid protocol or Bluetooth window is active\"}");
        return;
      }
      const uint8_t previousProtocol = btManualProtocol;
      btManualProtocol = (uint8_t)p;
      if (!commitConfigWithBtTime()) {
        btManualProtocol = previousProtocol; saveConfig();
        server.send(500,"application/json","{\"status\":\"error\",\"message\":\"Bluetooth setting could not be saved; previous value retained\"}"); return;
      }
      server.send(200, "application/json", "{\"status\":\"ok\"}");
      return;
    }
    if (server.hasArg("bt_manual_profile")) {
      int p=server.arg("bt_manual_profile").toInt();
      if (server.arg("bt_manual_profile") != String(p) || p<0 || p>=BT_WATCH_PROFILE_COUNT || !bluetoothSettingsMutable()) {
        server.send(409,"application/json","{\"status\":\"error\",\"message\":\"invalid/busy profile\"}");return;
      }
      const uint8_t previousProfile = btManualProfile;
      btManualProfile=(uint8_t)p;
      if (!commitConfigWithBtTime()) {
        btManualProfile = previousProfile; saveConfig();
        server.send(500,"application/json","{\"status\":\"error\",\"message\":\"Bluetooth setting could not be saved; previous value retained\"}"); return;
      }
      server.send(200,"application/json","{\"status\":\"ok\"}");return;
    }
    if (server.hasArg("bt_rebind_profile")) {
      // Legacy clients must use the explicit, transactional Pair Watch route.
      server.send(409,"application/json","{\"status\":\"error\",\"message\":\"Use Pair Watch; the existing binding is retained until replacement succeeds\"}");
      return;
    }
    if (server.hasArg("bt_slot")) {
      int slot = server.arg("bt_slot").toInt();
      if (server.arg("bt_slot") != String(slot) || slot < 0 || slot >= BT_SYNC_SLOT_COUNT) {
        server.send(400, "application/json", "{\"status\":\"error\",\"message\":\"invalid Bluetooth slot\"}");
        return;
      }
      if (server.hasArg("bt_slot_time")) {
        String requested=server.arg("bt_slot_time");
        int m=requested.toInt();
        if (requested != String(m) || m<0 || m>=1440 ||
            btOverlapsOtherEnabledSlot(slot,m) || !bluetoothSlotSettingsMutable()) {
          server.send(409,"application/json","{\"status\":\"error\",\"message\":\"Time invalid, busy, or overlaps another Bluetooth window\"}"); return;
        }
        const int previousTime = btSyncTimes[slot];
        btSyncTimes[slot] = m;
        if (!commitConfigWithBtTime()) {
          btSyncTimes[slot] = previousTime; saveConfig();
          server.send(500,"application/json","{\"status\":\"error\",\"message\":\"Bluetooth setting could not be saved; previous value retained\"}"); return;
        }
        if (previousTime != m) resetBluetoothSlotAttempt(slot);
        server.send(200,"application/json","{\"status\":\"ok\"}");return;
      }
      if (server.hasArg("bt_slot_profile")) {
        int p=server.arg("bt_slot_profile").toInt();
        if (server.arg("bt_slot_profile") != String(p) || p<0 || p>=BT_WATCH_PROFILE_COUNT || !bluetoothSlotSettingsMutable()) {
          server.send(409,"application/json","{\"status\":\"error\",\"message\":\"Invalid/busy watch profile\"}");return;
        }
        // One logical watch has one protocol across its enabled sync slots.
        for (int i=0;i<BT_SYNC_SLOT_COUNT;++i)
          if (i!=slot && btSyncEnabled[i] && btSyncProfile[i]==p &&
              btSyncProtocol[i]!=btSyncProtocol[slot]) {
            server.send(409,"application/json","{\"status\":\"error\",\"message\":\"Watch profile uses another protocol\"}");return;
          }
        const uint8_t previousProfile = btSyncProfile[slot];
        btSyncProfile[slot] = (uint8_t)p;
        if (!commitConfigWithBtTime()) {
          btSyncProfile[slot] = previousProfile; saveConfig();
          server.send(500,"application/json","{\"status\":\"error\",\"message\":\"Bluetooth setting could not be saved; previous value retained\"}"); return;
        }
        if (previousProfile != p) resetBluetoothSlotAttempt(slot);
        server.send(200,"application/json","{\"status\":\"ok\"}");return;
      }
      if (server.hasArg("bt_slot_protocol")) {
        int p = server.arg("bt_slot_protocol").toInt();
        if (server.arg("bt_slot_protocol") != String(p) || !validBtProtocol(p) ||
            !bluetoothSlotSettingsMutable()) {
          server.send(409, "application/json", "{\"status\":\"error\",\"message\":\"invalid protocol or Bluetooth window is active\"}");
          return;
        }
        for (int i=0;i<BT_SYNC_SLOT_COUNT;++i)
          if (i!=slot && btSyncEnabled[i] && btSyncProfile[i]==btSyncProfile[slot] &&
              btSyncProtocol[i]!=p) {
            server.send(409,"application/json","{\"status\":\"error\",\"message\":\"Watch profile uses another protocol\"}");return;
          }
        const uint8_t previousProtocol = btSyncProtocol[slot];
        btSyncProtocol[slot] = (uint8_t)p;
        if (!commitConfigWithBtTime()) {
          btSyncProtocol[slot] = previousProtocol; saveConfig();
          server.send(500,"application/json","{\"status\":\"error\",\"message\":\"Bluetooth setting could not be saved; previous value retained\"}"); return;
        }
        if (previousProtocol != p) resetBluetoothSlotAttempt(slot);
        server.send(200, "application/json", "{\"status\":\"ok\"}");
        return;
      }
      if (!server.hasArg("bt_slot_enabled")) {
        server.send(400, "application/json", "{\"status\":\"error\",\"message\":\"Bluetooth slot update missing enabled value\"}");
        return;
      }
      const String enabledValue=server.arg("bt_slot_enabled");
      if (enabledValue!="0" && enabledValue!="1" && enabledValue!="true" && enabledValue!="false") {
        server.send(400,"application/json","{\"status\":\"error\",\"message\":\"Invalid Bluetooth slot enabled value\"}"); return;
      }
      const bool en=enabledValue=="1" || enabledValue=="true";
      if (en && btOverlapsOtherEnabledSlot(slot,btSyncTimes[slot])) {
        server.send(409, "application/json",
                    "{\"status\":\"error\",\"message\":\"Bluetooth time overlaps another listening window\"}");
        return;
      }
      if (btBleBusy && btSyncActiveSlot == slot) {
        server.send(409,"application/json","{\"status\":\"error\",\"message\":\"Bluetooth transaction is active; retry when it finishes\"}");
        return;
      }
      const bool previousEnabled = btSyncEnabled[slot];
      btSyncEnabled[slot] = en;
      // A recurring listening switch must survive an immediate power cycle.
      // Acknowledge only after the atomic flash replacement has succeeded.
      if (!commitConfigWithBtTime()) {
        btSyncEnabled[slot] = previousEnabled;
        saveConfig();
        server.send(500,"application/json","{\"status\":\"error\",\"message\":\"Bluetooth setting could not be saved; previous value retained\"}");
        return;
      }
      if (previousEnabled != en || !en) resetBluetoothSlotAttempt(slot);
      server.send(200, "application/json", "{\"status\":\"ok\"}");
      return;
    }


    if (!commitConfigWithBtTime()) {
      server.send(500,"application/json",btTimeSettingsChanged
        ? "{\"status\":\"error\",\"message\":\"Settings not saved to flash; previous Bluetooth time settings retained. Retry Save before restarting\"}"
        : "{\"status\":\"error\",\"message\":\"Settings not saved to flash; previous settings retained\"}");
      return;
    }

    server.send(200, "application/json", "{\"status\":\"ok\"}");

  });

  // Primary status endpoint reports the display and Bluetooth civil clocks.
  server.on("/api/status", HTTP_GET, []() {
    const time_t utcNow = time(nullptr);
    struct tm local; localtime_r(&utcNow, &local);
    char localTime[16], localDate[16];
    strftime(localTime, sizeof(localTime), "%H:%M:%S", &local);
    strftime(localDate, sizeof(localDate), "%Y-%m-%d", &local);
    struct tm btTm; bluetoothLocalTime(utcNow, btTm);
    char btTime[32]; strftime(btTime, sizeof(btTime), "%Y-%m-%d %H:%M:%S", &btTm);
    CasioJsonWriter json(apiResponseBuffer, sizeof(apiResponseBuffer));
    json.append("{\"time\":").quoted(localTime);
    json.key("date").quoted(localDate);
    json.key("bt_time").quoted(btTime);
    json.key("bt_local_time").quoted(btTime);
    appendCommonSettings(json);
    portENTER_CRITICAL(&clockMux);
    const double drift = ntpDriftPpm;
    portEXIT_CRITICAL(&clockMux);
    json.key("ntp_interval").number(ntpIntervalSec.load());
    json.key("ntp_drift_ppm").real(drift);
    json.key("clock_state").quoted(clockConfidence());
    json.key("wifi_connected").boolean(WiFi.status() == WL_CONNECTED);
    const String wifiIp = WiFi.localIP().toString(), apIp = WiFi.softAPIP().toString();
    json.key("wifi_ip").quoted(wifiIp.c_str());
    json.key("ap_mode").boolean(ap_mode);
    json.key("ap_ip").quoted(apIp.c_str());
    json.key("uptime_sec").number(monotonicUptimeSeconds());
    const uint32_t age = clockAgeSeconds();
    json.key("ntp_age_sec").number(age == UINT32_MAX ? -1 : static_cast<int64_t>(age));
    json.key("clock_error_est_sec").real(clockEstimatedError());
    json.key("heap_free").number(ESP.getFreeHeap());
    json.key("littlefs_total").number(filesystemAvailable ? LittleFS.totalBytes() : 0);
    json.key("littlefs_used").number(filesystemAvailable ? LittleFS.usedBytes() : 0);
    json.key("bt_connection_attempts").number(btConnectionAttempts);
    json.key("bt_acked_writes").number(btWriteAcknowledgements);
    json.key("bt_response_errors").number(btResponseErrors.load());
    json.append("}");
    sendBoundedJson(json);
  });

  server.on("/api/diagnostics", HTTP_GET, []() {
    DynamicJsonDocument d(4096);
    if (!d.capacity()) { server.send(503,"application/json","{\"status\":\"error\",\"message\":\"Insufficient heap for diagnostics\"}"); return; }
    d["reset_reason"]=(int)esp_reset_reason();
    d["heap_max_alloc"]=ESP.getMaxAllocHeap();
    d["loop_stack_min_free"]=uxTaskGetStackHighWaterMark(nullptr);
    d["loop_stack_min_free_observed"]=applicationLoopStackMinimum();
    d["led_stack_min_free"]=activityLedStackMinimum();
    d["monitor_stack_min_free"]=safetyMonitorStackMinimum();
    d["nimble_host_stack_min_free"]=bluetoothHostStackMinimum();
    d["loop_heartbeat_age_ms"]=applicationLoopAgeMs();
    d["firmware"]=FIRMWARE_VERSION;
    d["uptime_sec"]=monotonicUptimeSeconds();
    d["firmware_build"]=FIRMWARE_BUILD;
    d["filesystem_available"]=filesystemAvailable;
    d["config_storage_fault"]=configStorageFault;
    d["heap_free"]=ESP.getFreeHeap();
    d["heap_min_free"]=ESP.getMinFreeHeap();
    d["clock_state"]=clockConfidence();
    d["ntp_age_sec"]=clockAgeSeconds()==UINT32_MAX?-1:(int32_t)clockAgeSeconds();
    portENTER_CRITICAL(&clockMux);
    uint32_t syncCountSnapshot = clockNtpSyncCount;
    uint32_t rejectedCountSnapshot = clockNtpRejectedCount;
    const uint8_t candidateReplySnapshot = clockNtpCandidateReplyCount;
    const uint32_t reacquisitionSnapshot = clockNtpReacquisitionCount;
    double driftBoundSnapshot = clockDriftBoundPpm;
    portEXIT_CRITICAL(&clockMux);
    d["ntp_sync_count"]=syncCountSnapshot;
    d["ntp_rejected_count"]=rejectedCountSnapshot;
    d["ntp_candidate_replies"]=candidateReplySnapshot;
    d["ntp_reacquisitions"]=reacquisitionSnapshot;
    d["clock_drift_bound_ppm"]=driftBoundSnapshot;
    d["clock_error_est_sec"]=clockEstimatedError();
    d["ntp_interval_sec"]=ntpIntervalSec.load();
    d["wifi_connected"]=WiFi.status()==WL_CONNECTED;
    d["wifi_power_requested"]=wifiRadioEnabled;
    d["wifi_power_observed"]=WiFi.getMode()!=WIFI_OFF;
    d["wifi_power_fault"]=wifiPowerFault;
    d["wifi_power_fault_count"]=wifiPowerFaultCount;
    d["wifi_shutdown_pending"]=wifiPowerShutdownPending;
    d["wifi_ip"]=WiFi.localIP().toString();
    d["ap_mode"]=ap_mode;
    d["ap_ip"]=WiFi.softAPIP().toString();
    d["wifi_access_enabled"]=wifiAccessEnabled;
    d["wifi_access_start"]=wifiAccessStart;
    d["wifi_access_end"]=wifiAccessEnd;
    d["wifi_access_timezone"]=wifiAccessTimezone;
    d["wifi_access_active"]=wifiAccessWindowOpen();
    d["bt_controller_off"]=esp_bt_controller_get_status()==ESP_BT_CONTROLLER_STATUS_IDLE;
    d["bt_state"]=bluetoothStateText();
    d["bt_always_wait"]=btAlwaysWaitEnabled;
    d["bt_last_sync_date"]=btLastSyncDate;
    d["bt_last_sync_status"]=btLastSyncStatus;
    d["bt_last_sync_epoch"]=btLastSyncEpoch.load();
    d["bt_last_outcome_successful"]=btLastOutcomeSuccessful.load();
    d["bt_history_persist"]=btHistoryPersistEnabled;
    d["bt_history_saved_at"]=bluetoothHistorySavedAt();
    d["bt_history_save_status"]=btHistorySaveStatus;
    d["crash_dump_enabled"]=crashDumpEnabled;
    d["crash_dump_available"]=RadioCrashDumpGate::available();
    d["bt_window_active"]=btWindowActive.load();
    d["bt_pair_mode"]=btPairModeActive || btPairRequested;
    d["bt_connection_attempts"]=btConnectionAttempts;
    d["bt_acked_writes"]=btWriteAcknowledgements;
    d["bt_notifications"]=btNotifications.load();
    d["bt_response_errors"]=btResponseErrors.load();
    d["bt_delivery_evidence"]=btDeliveryEvidence;
    d["littlefs_total"]=filesystemAvailable ? LittleFS.totalBytes() : 0;
    d["littlefs_used"]=filesystemAvailable ? LittleFS.usedBytes() : 0;
    const size_t expected = measureJson(d);
    if (d.overflowed() || expected >= sizeof(apiResponseBuffer)) { server.send(503,"application/json","{\"status\":\"error\",\"message\":\"Diagnostics response capacity exceeded\"}"); return; }
    const size_t written = serializeJson(d, apiResponseBuffer, sizeof(apiResponseBuffer));
    if (written != expected) { server.send(503,"application/json","{\"status\":\"error\",\"message\":\"Diagnostics serialization failed\"}"); return; }
    server.setContentLength(written);
    server.send(200, "application/json", String());
    server.sendContent(apiResponseBuffer, written);
  });

  server.on("/api/settings", HTTP_POST, []() {
    if (!server.hasArg("bt_always_wait")) {
      server.send(400,"application/json","{\"status\":\"error\",\"message\":\"Missing Always Wait setting\"}"); return;
    }
    String v=server.arg("bt_always_wait");
    if (v!="0" && v!="1" && v!="true" && v!="false") {
      server.send(400,"application/json","{\"status\":\"error\",\"message\":\"Invalid Always Wait value\"}"); return;
    }
    const bool previousAlwaysWait = btAlwaysWaitEnabled;
    btAlwaysWaitEnabled=(v=="1" || v=="true");
    if (!writeConfigNow()) {
      btAlwaysWaitEnabled = previousAlwaysWait; saveConfig();
      server.send(500,"application/json","{\"status\":\"error\",\"message\":\"Always Wait could not be saved; previous value retained\"}"); return;
    }
    if (!btAlwaysWaitEnabled && btPersistentWaitActive && !btBleBusy) {
      stopBluetoothWindow(); setBluetoothPhase("Idle");
    }
    server.send(200,"application/json","{\"status\":\"ok\"}");
  });

  server.on("/api/bluetooth-pair", HTTP_POST, []() {
    if (!clockTrusted()) {
      server.send(503,"application/json","{\"status\":\"error\",\"message\":\"No trusted NTP clock yet. Synchronize NTP first.\"}"); return;
    }
    if (btPairRequested || btPairModeActive) {
      server.send(200,"application/json","{\"status\":\"ok\",\"state\":\"Pairing\",\"message\":\"Pairing window already active\"}"); return;
    }
    if (btBleBusy) {
      CasioJsonWriter json(apiResponseBuffer, sizeof(apiResponseBuffer));
      json.append("{\"status\":\"error\",\"message\":").quoted(bluetoothStateText()).append("}");
      sendBoundedJson(json, 409); return;
    }
    if (!validBtProtocol(btManualProtocol) || btManualProfile>=BT_WATCH_PROFILE_COUNT) {
      server.send(400,"application/json","{\"status\":\"error\",\"message\":\"Invalid watch profile or protocol\"}"); return;
    }
    stopBluetoothWindow();
    btManualSyncRequested=false;
    btPairRequested=true;
    btLastSyncStatus=String("Pairing Watch ")+(btManualProfile+1)+": put the watch into pairing mode";
    server.send(200,"application/json","{\"status\":\"ok\",\"state\":\"Pairing\",\"message\":\"Pairing window opened; previous binding retained until time delivery succeeds\"}");
  });

  server.on("/api/bluetooth-sync", HTTP_POST, []() {
    if (!clockTrusted()) {
      server.send(503,"application/json","{\"status\":\"error\",\"message\":\"No trusted NTP clock yet. Synchronize NTP first.\"}"); return;
    }
    if (btPairRequested || btPairModeActive) {
      server.send(409,"application/json","{\"status\":\"error\",\"state\":\"Pairing\",\"message\":\"Pairing is active; finish pairing before Sync Now\"}"); return;
    }
    if (btProfileAddress[btManualProfile].length()!=17 || btProfileProtocol[btManualProfile]!=btManualProtocol) {
      server.send(409,"application/json","{\"status\":\"error\",\"message\":\"Pair Watch first for the selected profile and protocol\"}"); return;
    }
    // If a GATT transaction is finishing, queue the retry; otherwise next loop
    // stops/reopens the current passive/manual/automatic window safely.
    btManualSyncRequested=true;
    if (!btBleBusy) btLastSyncStatus="Waiting for watch";
    CasioJsonWriter json(apiResponseBuffer, sizeof(apiResponseBuffer));
    json.append("{\"status\":\"ok\",\"state\":").quoted(bluetoothStateText());
    json.key("message").quoted("Manual sync window will restart safely").append("}");
    sendBoundedJson(json);
  });

  // Request an immediate SNTP client restart from the web interface.
  server.on("/api/ntp-sync", HTTP_POST, []() {
    if (WiFi.status() != WL_CONNECTED) {
      server.send(503, "application/json",
                  "{\"status\":\"error\",\"message\":\"Wi-Fi is not connected\"}");
      return;
    }
    // A first-boot AP or failed/late association may never have initialized
    // SNTP. Restarting a stopped client silently does nothing in the SDK.
    if (esp_sntp_enabled()) {
      if (!sntp_restart()) {
        server.send(503,"application/json","{\"status\":\"error\",\"message\":\"NTP restart failed; retry synchronization\"}"); return;
      }
    } else if (!configureNtpClient()) {
      server.send(503,"application/json","{\"status\":\"error\",\"message\":\"NTP client could not be started; retry synchronization\"}"); return;
    }
    Serial.println("NTP sync requested from web UI");
    server.send(200, "application/json",
                "{\"status\":\"ok\",\"message\":\"NTP synchronization requested\"}");
  });

  webRoutesRegistered=true;
  }
  server.begin(); webServerStarted=true;
}

static const uint8_t INDEX_HTML_GZ[] PROGMEM = {
  0x1f, 0x8b, 0x08, 0x00, 0x00, 0x00, 0x00, 0x00, 0x02, 0x03, 0xe4, 0xbd, 0xd9, 0x96, 0xdb, 0x48, 0x96, 0x20, 0xf8, 0xae,
  0xaf, 0x80, 0x28, 0x85, 0x48, 0x96, 0x48, 0x3a, 0xc1, 0xdd, 0x49, 0xd1, 0x7d, 0x14, 0x92, 0x22, 0x43, 0x53, 0x52, 0x28,
  0x46, 0xae, 0xc8, 0xa8, 0x4a, 0xa5, 0x5a, 0x02, 0x09, 0xd0, 0x1d, 0x29, 0x92, 0x60, 0x11, 0xa4, 0x2f, 0xe9, 0xe2, 0x39,
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  0xf8, 0xff, 0x75, 0xb1, 0x5a, 0x1e, 0x3e, 0xf9, 0x07, 0x97, 0x9f, 0x1f, 0xef, 0x3b, 0xb8, 0x01, 0x00,
};

static void sendIndexPage(void)
{
  server.sendHeader("Content-Encoding", "gzip");
  server.sendHeader("Cache-Control", "no-cache");
  server.send_P(200, PSTR("text/html"), (PGM_P)INDEX_HTML_GZ, sizeof(INDEX_HTML_GZ));
}
//...................................................................
// End of file
// Firmware Version: V0.1 R1
